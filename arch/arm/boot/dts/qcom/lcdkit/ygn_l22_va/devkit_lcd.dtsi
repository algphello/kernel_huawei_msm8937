/*---------------------------------------------------------------------------
 * This file is autogenerated file using huawei LCD parser. Please do not edit it.
 * Update input XML file to add a new entry or update variable in this file
 * Parser location: vendor/huawei/chipset_common/devkit/lcdkit/tools 
 *---------------------------------------------------------------------------*/


#include "ygn_l22_va_auo_otm1901a_5p2_1080p_video_default.dtsi"
#include "ygn_l22_va_tcl_ili9881c_5p2_720p_video.dtsi"
#include "ygn_l22_va_txd_hx8394f_5p2_720p_video.dtsi"