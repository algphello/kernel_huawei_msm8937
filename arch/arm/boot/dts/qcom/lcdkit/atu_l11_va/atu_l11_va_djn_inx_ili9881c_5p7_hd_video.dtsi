/* Copyright (c) 2013, The Linux Foundation. All rights reserved.
 *
 * This program is free software; you can redistribute it and/or modify
 * it under the terms of the GNU General Public License version 2 and
 * only version 2 as published by the Free Software Foundation.
 *
 * This program is distributed in the hope that it will be useful,
 * but WITHOUT ANY WARRANTY; without even the implied warranty of
 * MERCHANTABILITY or FITNESS FOR A PARTICULAR PURPOSE.  See the
 * GNU General Public License for more details.
 */

/*-------------------------------------------------------------------------
 * This file is autogenerated file using gcdb parser. Please do not edit it.
 * Update input XML file to add a new entry or update variable in this file
 * VERSION = 1.1
 *-----------------------------------------------------------------------*/
/ {
	dsi_atu_l11_va_djn_inx_ili9881c_5p7_hd_video: lcdkit_atu_l11_va_djn_inx_ili9881c_5p7_hd_video {
		compatible = "djn_inx_ili9881c_5p7_hd_video";
		hw,lcdkit-panel-name = "DJN_ILI9881C 5P7 VIDEO INX 720 x 1440";
		hw,lcdkit-panel-type = <0x01>;
		hw,lcdkit-panel-xres = <720>;
		hw,lcdkit-panel-yres = <1440>;
		hw,lcdkit-panel-width = <67>;
		hw,lcdkit-panel-height = <135>;
		hw,lcdkit-panel-on-command = [39 01 00 00 00 00 04 FF 98 81 03
						39 01 00 00 00 00 02 01 00
						39 01 00 00 00 00 02 02 00
						39 01 00 00 00 00 02 03 53
						39 01 00 00 00 00 02 04 53
						39 01 00 00 00 00 02 05 13
						39 01 00 00 00 00 02 06 04
						39 01 00 00 00 00 02 07 02
						39 01 00 00 00 00 02 08 02
						39 01 00 00 00 00 02 09 00
						39 01 00 00 00 00 02 0a 00
						39 01 00 00 00 00 02 0b 00
						39 01 00 00 00 00 02 0c 00
						39 01 00 00 00 00 02 0d 00
						39 01 00 00 00 00 02 0e 00
						39 01 00 00 00 00 02 0f 00
						39 01 00 00 00 00 02 10 00
						39 01 00 00 00 00 02 11 00
						39 01 00 00 00 00 02 12 00
						39 01 00 00 00 00 02 13 00
						39 01 00 00 00 00 02 14 00
						39 01 00 00 00 00 02 15 00
						39 01 00 00 00 00 02 16 00
						39 01 00 00 00 00 02 17 00
						39 01 00 00 00 00 02 18 00
						39 01 00 00 00 00 02 19 00
						39 01 00 00 00 00 02 1a 00
						39 01 00 00 00 00 02 1b 00
						39 01 00 00 00 00 02 1c 00
						39 01 00 00 00 00 02 1d 00
						39 01 00 00 00 00 02 1e C0
						39 01 00 00 00 00 02 1f 80
						39 01 00 00 00 00 02 20 02
						39 01 00 00 00 00 02 21 09
						39 01 00 00 00 00 02 22 00
						39 01 00 00 00 00 02 23 00
						39 01 00 00 00 00 02 24 00
						39 01 00 00 00 00 02 25 00
						39 01 00 00 00 00 02 26 00
						39 01 00 00 00 00 02 27 00
						39 01 00 00 00 00 02 28 55
						39 01 00 00 00 00 02 29 03
						39 01 00 00 00 00 02 2a 00
						39 01 00 00 00 00 02 2b 00
						39 01 00 00 00 00 02 2c 00
						39 01 00 00 00 00 02 2d 00
						39 01 00 00 00 00 02 2e 00
						39 01 00 00 00 00 02 2f 00
						39 01 00 00 00 00 02 30 00
						39 01 00 00 00 00 02 31 00
						39 01 00 00 00 00 02 32 00
						39 01 00 00 00 00 02 33 00
						39 01 00 00 00 00 02 34 03
						39 01 00 00 00 00 02 35 00
						39 01 00 00 00 00 02 36 05
						39 01 00 00 00 00 02 37 00
						39 01 00 00 00 00 02 38 3C
						39 01 00 00 00 00 02 39 00
						39 01 00 00 00 00 02 3a 00
						39 01 00 00 00 00 02 3b 00
						39 01 00 00 00 00 02 3c 00
						39 01 00 00 00 00 02 3d 00
						39 01 00 00 00 00 02 3e 00
						39 01 00 00 00 00 02 3f 00
						39 01 00 00 00 00 02 40 00
						39 01 00 00 00 00 02 41 00
						39 01 00 00 00 00 02 42 00
						39 01 00 00 00 00 02 43 00
						39 01 00 00 00 00 02 44 00
						39 01 00 00 00 00 02 50 01
						39 01 00 00 00 00 02 51 23
						39 01 00 00 00 00 02 52 45
						39 01 00 00 00 00 02 53 67
						39 01 00 00 00 00 02 54 89
						39 01 00 00 00 00 02 55 ab
						39 01 00 00 00 00 02 56 01
						39 01 00 00 00 00 02 57 23
						39 01 00 00 00 00 02 58 45
						39 01 00 00 00 00 02 59 67
						39 01 00 00 00 00 02 5a 89
						39 01 00 00 00 00 02 5b ab
						39 01 00 00 00 00 02 5c cd
						39 01 00 00 00 00 02 5d ef
						39 01 00 00 00 00 02 5e 01
						39 01 00 00 00 00 02 5f 14
						39 01 00 00 00 00 02 60 15
						39 01 00 00 00 00 02 61 0C
						39 01 00 00 00 00 02 62 0D
						39 01 00 00 00 00 02 63 0E
						39 01 00 00 00 00 02 64 0F
						39 01 00 00 00 00 02 65 10
						39 01 00 00 00 00 02 66 11
						39 01 00 00 00 00 02 67 08
						39 01 00 00 00 00 02 68 02
						39 01 00 00 00 00 02 69 0A
						39 01 00 00 00 00 02 6a 02
						39 01 00 00 00 00 02 6b 02
						39 01 00 00 00 00 02 6c 02
						39 01 00 00 00 00 02 6d 02
						39 01 00 00 00 00 02 6e 02
						39 01 00 00 00 00 02 6f 02
						39 01 00 00 00 00 02 70 02
						39 01 00 00 00 00 02 71 02
						39 01 00 00 00 00 02 72 06
						39 01 00 00 00 00 02 73 02
						39 01 00 00 00 00 02 74 02
						39 01 00 00 00 00 02 75 14
						39 01 00 00 00 00 02 76 15
						39 01 00 00 00 00 02 77 11
						39 01 00 00 00 00 02 78 10
						39 01 00 00 00 00 02 79 0f
						39 01 00 00 00 00 02 7a 0e
						39 01 00 00 00 00 02 7b 0d
						39 01 00 00 00 00 02 7c 0c
						39 01 00 00 00 00 02 7d 06
						39 01 00 00 00 00 02 7e 02
						39 01 00 00 00 00 02 7f 0A
						39 01 00 00 00 00 02 80 02
						39 01 00 00 00 00 02 81 02
						39 01 00 00 00 00 02 82 02
						39 01 00 00 00 00 02 83 02
						39 01 00 00 00 00 02 84 02
						39 01 00 00 00 00 02 85 02
						39 01 00 00 00 00 02 86 02
						39 01 00 00 00 00 02 87 02
						39 01 00 00 00 00 02 88 08
						39 01 00 00 00 00 02 89 02
						39 01 00 00 00 00 02 8A 02
						39 01 00 00 00 00 04 FF 98 81 04
						39 01 00 00 00 00 02 6C 15
						39 01 00 00 00 00 02 6E 2F
						39 01 00 00 00 00 02 6F 35
						39 01 00 00 00 00 02 3A 24
						39 01 00 00 00 00 02 8D 1E
						39 01 00 00 00 00 02 87 BA
						39 01 00 00 00 00 02 26 76
						39 01 00 00 00 00 02 B2 D1
						39 01 00 00 00 00 02 88 0B
						39 01 00 00 00 00 02 33 14
						39 01 00 00 00 00 02 35 1F
						39 01 00 00 00 00 02 38 01
						39 01 00 00 00 00 02 39 00
						39 01 00 00 00 00 02 00 00
						39 01 00 00 00 00 04 FF 98 81 01
						39 01 00 00 00 00 02 22 0A
						39 01 00 00 00 00 02 31 00
						39 01 00 00 00 00 02 53 75
						39 01 00 00 00 00 02 55 7E
						39 01 00 00 00 00 02 50 D1
						39 01 00 00 00 00 02 51 CC
						39 01 00 00 00 00 02 60 1F
						39 01 00 00 00 00 02 61 00
						39 01 00 00 00 00 02 62 20
						39 01 00 00 00 00 02 63 00
						39 01 00 00 00 00 02 2E F0
						39 01 00 00 00 00 02 A0 00
						39 01 00 00 00 00 02 A1 10
						39 01 00 00 00 00 02 A2 1E
						39 01 00 00 00 00 02 A3 12
						39 01 00 00 00 00 02 A4 15
						39 01 00 00 00 00 02 A5 29
						39 01 00 00 00 00 02 A6 1F
						39 01 00 00 00 00 02 A7 1F
						39 01 00 00 00 00 02 A8 6E
						39 01 00 00 00 00 02 A9 1C
						39 01 00 00 00 00 02 AA 26
						39 01 00 00 00 00 02 AB 52
						39 01 00 00 00 00 02 AC 18
						39 01 00 00 00 00 02 AD 17
						39 01 00 00 00 00 02 AE 4C
						39 01 00 00 00 00 02 AF 23
						39 01 00 00 00 00 02 B0 28
						39 01 00 00 00 00 02 B1 46
						39 01 00 00 00 00 02 B2 58
						39 01 00 00 00 00 02 B3 3F
						39 01 00 00 00 00 02 C0 00
						39 01 00 00 00 00 02 C1 10
						39 01 00 00 00 00 02 C2 1E
						39 01 00 00 00 00 02 C3 12
						39 01 00 00 00 00 02 C4 15
						39 01 00 00 00 00 02 C5 29
						39 01 00 00 00 00 02 C6 1F
						39 01 00 00 00 00 02 C7 1F
						39 01 00 00 00 00 02 C8 6E
						39 01 00 00 00 00 02 C9 1C
						39 01 00 00 00 00 02 CA 26
						39 01 00 00 00 00 02 CB 52
						39 01 00 00 00 00 02 CC 18
						39 01 00 00 00 00 02 CD 17
						39 01 00 00 00 00 02 CE 4C
						39 01 00 00 00 00 02 CF 23
						39 01 00 00 00 00 02 D0 28
						39 01 00 00 00 00 02 D1 46
						39 01 00 00 00 00 02 D2 58
						39 01 00 00 00 00 02 D3 3F
						39 01 00 00 00 00 04 FF 98 81 02
						39 01 00 00 00 00 02 06 20
						39 01 00 00 00 00 02 07 00
						39 01 00 00 00 00 04 FF 98 81 00
						39 01 00 00 00 00 03 68 03 00
						39 01 00 00 00 00 02 53 2C
						39 01 00 00 00 00 02 55 00
						39 01 00 00 78 00 02 11 00
						39 01 00 00 14 00 02 29 00];
		hw,lcdkit-panel-on-command-state = "dsi_lp_mode";
		hw,lcdkit-panel-display-on-command = [05 01 00 00 78 00 02 11 00
                    05 01 00 00 14 00 02 29 00];
		hw,lcdkit-panel-off-command = [05 01 00 00 14 00 02 28 00
					05 01 00 00 78 00 02 10 00];
		hw,lcdkit-panel-off-command-state = "dsi_hs_mode";
		hw,lcdkit-panel-backlight-command = [39 01 00 00 00 00 03 51 00 00];
		hw,lcdkit-panel-backlight-command-state = "dsi_lp_mode";
		hw,lcdkit-panel-cabc-off-command = [15 01 00 00 0a 00 02 55 00];
		hw,lcdkit-panel-cabc-off-command-state = "dsi_lp_mode";
		hw,lcdkit-panel-cabc-ui-command = [15 01 00 00 0a 00 02 55 01
					15 01 00 00 0a 00 02 53 2C];
		hw,lcdkit-panel-cabc-ui-command-state = "dsi_lp_mode";
		hw,lcdkit-panel-cabc-still-command = [15 01 00 00 0a 00 02 55 02
					15 01 00 00 0a 00 02 53 2C];
		hw,lcdkit-panel-cabc-still-command-state = "dsi_lp_mode";
		hw,lcdkit-panel-cabc-moving-command = [15 01 00 00 0a 00 02 55 03
					15 01 00 00 0a 00 02 53 2C];
		hw,lcdkit-panel-cabc-moving-command-state = "dsi_lp_mode";
		hw,lcdkit-panel-cabc-support = <0>;
		hw,lcdkit-panel-dot-inversion-command = [39 01 00 00 00 00 04 ff 98 81 01
							   39 01 00 00 00 00 02 50 42
							   39 01 00 00 00 00 02 51 42
							   39 01 00 00 00 00 02 62 2F
							   39 01 00 00 00 00 02 63 10
  							   39 01 00 00 00 00 02 31 02
							   39 01 00 00 00 00 04 ff 98 81 00];
		hw,lcdkit-panel-dot-inversion-command-state = "dsi_lp_mode";
		hw,lcdkit-panel-column-inversion-command = [39 01 00 00 00 00 04 ff 98 81 01
    							  39 01 00 00 00 00 02 31 00
								  39 01 00 00 00 00 02 50 D1
								  39 01 00 00 00 00 02 51 CC
								  39 01 00 00 00 00 02 62 20
								  39 01 00 00 00 00 02 63 00
								  39 01 00 00 00 00 04 ff 98 81 00];
		hw,lcdkit-panel-column-inversion-command-state = "dsi_lp_mode";
		hw,lcdkit-panel-inversion-support = <1>;
		hw,lcdkit-panel-forword-scan-command = [39 01 00 00 00 00 04 ff 98 81 01
          39 01 00 00 00 00 02 22 09
		  39 01 00 00 00 00 04 ff 98 81 00];
		hw,lcdkit-panel-forword-scan-command-state = "dsi_lp_mode";
		hw,lcdkit-panel-revert-scan-command = [39 01 00 00 00 00 04 ff 98 81 01
          39 01 00 00 00 00 02 22 0a
		  39 01 00 00 00 00 04 ff 98 81 00];
		hw,lcdkit-panel-revert-scan-command-state = "dsi_lp_mode";
		hw,lcdkit-panel-scan-support = <1>;
		hw,lcdkit-panel-display-region-command = [];
		hw,lcdkit-panel-display-region-command-state = "dsi_lp_mode";
		hw,lcdkit-panel-display-region-support = <0>;
		hw,lcdkit-panel-checksum-enter-command = [];
		hw,lcdkit-panel-checksum-enter-command-state = "dsi_lp_mode";
		hw,lcdkit-panel-checksum-command = [];
		hw,lcdkit-panel-checksum-command-state = "dsi_lp_mode";
		hw,lcdkit-panel-checksum-exit-command = [];
		hw,lcdkit-panel-checksum-exit-command-state = "dsi_lp_mode";
		hw,lcdkit-panel-checksum-value = [];
		hw,lcdkit-panel-checksum-support = <0>;
		hw,lcdkit-panel-esd-reg-command = [06 01 00 01 0a 00 01 0a];
		hw,lcdkit-panel-esd-reg-command-state = "dsi_lp_mode";
		hw,lcdkit-panel-esd-value = [9c];
		hw,lcdkit-panel-esd-support = <1>;
		hw,lcdkit-panel-check-reg-command = [06 01 00 00 0a 00 01 0a];
		hw,lcdkit-panel-check-reg-value = [9c];
		hw,lcdkit-panel-check-reg-command-state = "dsi_lp_mode";
		hw,lcdkit-panel-check-reg-support = <1>;
		hw,lcdkit-panel-mipi-detect-command = [];
		hw,lcdkit-panel-mipi-detect-value = [];
		hw,lcdkit-panel-mipi-detect-mask = [];
		hw,lcdkit-panel-mipi-detect-command-state = "dsi_lp_mode";
		hw,lcdkit-panel-mipi-detect-support = <0>;
		hw,lcdkit-panel-shutdown-sleep-support = <0>;
		hw,lcdkit-dsi-bpp = <24>;
		hw,lcdkit-panel-cmd-type = <0>;
		hw,lcdkit-pixel-packing = <0>;
		hw,lcdkit-underflow-color = <0x00>;
		hw,lcdkit-border-color = <0>;
		hw,lcdkit-panel-orientation = <0>;
		hw,lcdkit-brightness-max-level = <1023>;
		hw,lcdkit-bl-min-level = <7>;
		hw,lcdkit-bl-max-level = <1023>;
		hw,lcdkit-interleave-mode = <0>;
		hw,lcdkit-te-check-enable;
		hw,lcdkit-te-using-te-pin;
		hw,lcdkit-h-sync-pulse = <1>;
		hw,lcdkit-bllp-power-mode;
		hw,lcdkit-bllp-eof-power-mode;
		hw,lcdkit-traffic-mode = "burst_mode";
		hw,lcdkit-te-dcs-command = <1>;
		hw,lcdkit-te-pin-select = <1>;
		hw,lcdkit-virtual-channel-id = <0>;
		hw,lcdkit-color-order = "rgb_swap_rgb";
		hw,lcdkit-lane-0-state;
		hw,lcdkit-lane-1-state;
		hw,lcdkit-lane-2-state;
		hw,lcdkit-h-left-border = <0>;
		hw,lcdkit-h-right-border = <0>;
		hw,lcdkit-v-top-border = <0>;
		hw,lcdkit-v-bottom-border = <0>;
		hw,lcdkit-panel-framerate = <60>;
		hw,lcdkit-panel-clockrate = <667000000>;
		hw,lcdkit-panel-timings = [B4 2A 1C 00 54 58 20 2E 20 03 04 00];
		hw,lcdkit-t-clk-pre = <0x23>;
		hw,lcdkit-t-clk-post = <0x03>;
		hw,lcdkit-tx-eot-append;
		hw,lcdkit-stream = <0>;
		hw,lcdkit-lp11-init;
		hw,lcdkit-mdp-trigger = "none";
		hw,lcdkit-dma-trigger = "trigger_sw";
		hw,lcdkit-bl-pmic-control-type = "bl_ctrl_dcs";
		qcom,panel-supply-entries = <&dsi_panel_pwr_supply>;
		hw,lcdkit-lane-map = "lane_map_0123";
		hw,lcdkit-delay-before-bl = <0>;
		hw,lcdkit-mipi-regulator-mode = <1>;
		qcom,suspend-ulps-enabled;
		hw,lcdkit-delay-af-rst-off = <20>;
		hw,lcdkit-delay-af-blic-init = <0>;
		hw,lcdkit-bl-level-limit-percent = <100>;
		hw,lcdkit-use-second-ic-for-esd = <0>;
		hw,lcdkit-esd-check-num = <3>;
		hw,lcdkit-h-back-porch = <30>;
		hw,lcdkit-h-front-porch = <183>;
		hw,lcdkit-h-pulse-width = <20>;
		hw,lcdkit-v-back-porch = <6>;
		hw,lcdkit-v-pulse-width = <2>;
		hw,lcdkit-v-front-porch = <12>;
		hw,lcdkit-h-sync-skew = <0>;
		hw,lcdkit-lcd-type = <0>;
		hw,lcdkit-panel-pt-test-support = <1>;
		hw,lcdkit-bias-power-ctrl-mode = <0x04>;
		hw,lcdkit-iovcc-power-ctrl-mode = <0x01>;
		hw,lcdkit-vci-power-ctrl-mode = <0x01>;
		hw,lcdkit-id0-gpio = <59>;
		hw,lcdkit-id1-gpio = <48>;
		hw,lcdkit-reset-gpio = <60>;
		hw,lcdkit-te-gpio = <0>;
		hw,lcdkit-vsp-gpio = <124>;
		hw,lcdkit-vsn-gpio = <127>;
		hw,lcdkit-iovcc-gpio = <0>;
		hw,lcdkit-vci-gpio = <0>;
		hw,lcdkit-bl-gpio = <98>;
		hw,lcdkit-iovcc-on-is-need-reset = <0>;
		hw,lcdkit-vsn-on-is-need-reset = <0>;
		hw,lcdkit-lcd-vsp = <5500000>;
		hw,lcdkit-lcd-vsn = <5500000>;
		hw,lcdkit-lcd-rst-first-high = <2>;
		hw,lcdkit-lcd-rst-low = <2>;
		hw,lcdkit-lcd-rst-second-high = <10>;
		hw,lcdkit-delay-af-vci-on = <0>;
		hw,lcdkit-delay-af-iovcc-on = <0>;
		hw,lcdkit-delay-af-bias-on = <0>;
		hw,lcdkit-delay-af-vsp-on = <2>;
		hw,lcdkit-delay-af-vsn-on = <2>;
		hw,lcdkit-delay-af-lp11 = <0>;
		hw,lcdkit-delay-af-tp-reset = <25>;
		hw,lcdkit-delay-af-vsn-off = <2>;
		hw,lcdkit-delay-af-vsp-off = <2>;
		hw,lcdkit-delay-af-bias-off = <0>;
		hw,lcdkit-delay-af-iovcc-off = <0>;
		hw,lcdkit-delay-af-vci-off = <0>;
		hw,lcdkit-panel-off-reset-high = <0>;
		hw_sm5109,lcdkit-bias-type = <0x0c>;
		hw_sm5109,lcdkit-bias-vpos-reg = <0x00>;
		hw_sm5109,lcdkit-bias-vneg-reg = <0x01>;
		hw_sm5109,lcdkit-bias-vpos-val = <0x31>;
		hw_sm5109,lcdkit-bias-vneg-val = <0x11>;
		hw_sm5109,lcdkit-bias-vpos-mask = <0x3f>;
		hw_sm5109,lcdkit-bias-vneg-mask = <0x1f>;
		hw_sm5109,lcdkit-bias-state-reg = <0x03>;
		hw_sm5109,lcdkit-bias-state-val = <0x43>;
		hw_sm5109,lcdkit-bias-state-mask = <0x43>;
		hw_ocp2131,lcdkit-bias-type = <0x06>;
		hw_ocp2131,lcdkit-bias-vpos-reg = <0x00>;
		hw_ocp2131,lcdkit-bias-vneg-reg = <0x01>;
		hw_ocp2131,lcdkit-bias-vpos-val = <0x11>;
		hw_ocp2131,lcdkit-bias-vneg-val = <0x11>;
		hw_ocp2131,lcdkit-bias-vpos-mask = <0x1f>;
		hw_ocp2131,lcdkit-bias-vneg-mask = <0x1f>;
		hw_ocp2131,lcdkit-bias-state-reg = <0x00>;
		hw_ocp2131,lcdkit-bias-state-val = <0x00>;
		hw_ocp2131,lcdkit-bias-state-mask = <0x00>;
    };
};