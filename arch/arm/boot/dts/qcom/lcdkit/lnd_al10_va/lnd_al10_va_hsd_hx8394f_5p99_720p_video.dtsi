/* Copyright (c) 2013, The Linux Foundation. All rights reserved.
 *
 * This program is free software; you can redistribute it and/or modify
 * it under the terms of the GNU General Public License version 2 and
 * only version 2 as published by the Free Software Foundation.
 *
 * This program is distributed in the hope that it will be useful,
 * but WITHOUT ANY WARRANTY; without even the implied warranty of
 * MERCHANTABILITY or FITNESS FOR A PARTICULAR PURPOSE.  See the
 * GNU General Public License for more details.
 */

/*-------------------------------------------------------------------------
 * This file is autogenerated file using gcdb parser. Please do not edit it.
 * Update input XML file to add a new entry or update variable in this file
 * VERSION = 1.1
 *-----------------------------------------------------------------------*/
/ {
	dsi_lnd_al10_va_hsd_hx8394f_5p99_720p_video: lcdkit_lnd_al10_va_hsd_hx8394f_5p99_720p_video {
		compatible = "hsd-hx8394f-5p99-720p-video";
		hw,lcdkit-panel-name = "HSD_HX8394F 5P99 VIDEO TFT 720 x 1440";
		hw,lcdkit-panel-type = <0x01>;
		hw,lcdkit-panel-xres = <720>;
		hw,lcdkit-panel-yres = <1440>;
		hw,lcdkit-panel-width = <68>;
		hw,lcdkit-panel-height = <136>;
		hw,lcdkit-panel-on-command = [39 01 00 00 00 00 04 B9 FF 83 94
			39 01 00 00 00 00 0B B1 48 13 73 09 32 84 71 51 4D 2F
			39 01 00 00 00 00 07 BA 63 03 68 6B B2 C0
			39 01 00 00 00 00 06 B2 00 80 78 0C 07
			39 01 00 00 00 00 16 B4 04 63 04 63 04 63 01 0C 7C 55 00 3F 01 6B 01 6B 01 6B 01 0C 7C
			39 01 00 00 00 00 22 D3 00 00 00 00 3C 1C 00 00 32 10 09 00 09 32 15 AD 05 AD 32 00 00 00 00 37 03 0B 0B 37 00 00 00 0C 40
			39 01 00 00 00 00 2D D5 19 19 18 18 1B 1B 1A 1A 00 01 02 03 04 05 06 07 20 21 18 18 18 18 18 18 18 18 18 18 18 18 24 25 18 18 18 18 18 18 18 18 18 18 18 18
			39 01 00 00 00 00 2D D6 18 18 19 19 1B 1B 1A 1A 07 06 05 04 03 02 01 00 25 24 18 18 18 18 18 18 18 18 18 18 18 18 21 20 18 18 18 18 18 18 18 18 18 18 18 18
			39 01 00 00 00 00 3B E0 00 09 13 18 1B 1E 21 1F 3E 4C 5B 57 5F 70 74 78 85 88 84 94 A7 51 4F 56 5C 5D 65 75 7F 00 09 13 18 1B 1E 21 1F 3E 4B 59 57 5F 70 74 78 85 86 82 8F 9D 4F 4F 51 56 5E 67 76 7F
			39 01 00 00 00 00 02 CC 0B
			39 01 00 00 00 00 03 C0 1F 31
			39 01 00 00 00 00 02 D4 02
			39 01 00 00 00 00 02 BD 01
			39 01 00 00 00 00 02 B1 00
			39 01 00 00 00 00 02 BD 00
			39 01 00 00 00 00 02 D2 66
			39 01 00 00 00 00 02 C6 ED
			39 01 00 00 00 00 02 BD 00
			39 01 00 00 00 00 2C C1 01 00 08 10 18 20 26 2E 35 3D 44 4A 51 58 5F 67 6F 78 80 88 90 99 A0 A8 B0 B8 C1 CA D3 DB E3 EC F5 FF 00 07 47 FB 15 36 EE BB C0
			39 01 00 00 00 00 02 BD 01
			39 01 00 00 00 00 2B C1 00 08 10 18 21 27 30 37 3F 46 4C 54 5B 62 6A 72 7A 83 8B 93 9B A2 AA B2 BA C3 CC D4 DC E4 ED F6 FF 1B 33 48 06 C0 BB D7 A0 C0
			39 01 00 00 00 00 02 BD 02
			39 01 00 00 00 00 2B C1 00 08 10 18 21 28 30 38 40 46 4D 55 5C 63 6C 74 7D 85 8D 95 9E A5 AD B6 BE C7 D0 D8 E0 E8 F0 F8 FF 1B 0A 39 62 1B 7C A2 01 C0
			39 01 00 00 00 00 02 BD 00
			39 01 00 00 00 00 02 35 00
			39 01 00 00 78 00 02 11 00
			39 01 00 00 14 00 02 29 00];
		hw,lcdkit-panel-on-command-state = "dsi_lp_mode";
		hw,lcdkit-panel-display-on-command = [05 01 00 00 78 00 02 11 00
			05 01 00 00 14 00 02 29 00];
		hw,lcdkit-panel-off-command = [05 01 00 00 32 00 02 28 00
			05 01 00 00 78 00 02 10 00];
		hw,lcdkit-panel-off-command-state = "dsi_hs_mode";
		hw,lcdkit-panel-backlight-command = [39 01 00 00 00 00 02 51 00];
		hw,lcdkit-panel-backlight-command-state = "dsi_lp_mode";
		hw,lcdkit-panel-cabc-support = <0>;
		hw,lcdkit-panel-dot-inversion-command = [39 01 00 00 00 00 06 B2 01 80 78 0C 07];
		hw,lcdkit-panel-dot-inversion-command-state = "dsi_lp_mode";
		hw,lcdkit-panel-column-inversion-command = [39 01 00 00 00 00 06 B2 00 80 78 0C 07];
		hw,lcdkit-panel-column-inversion-command-state = "dsi_lp_mode";
		hw,lcdkit-panel-inversion-support = <1>;
		hw,lcdkit-panel-forword-scan-command = [39 01 00 00 00 00 02 CC 07];
		hw,lcdkit-panel-forword-scan-command-state = "dsi_lp_mode";
		hw,lcdkit-panel-revert-scan-command = [39 01 00 00 00 00 02 CC 0B];
		hw,lcdkit-panel-revert-scan-command-state = "dsi_lp_mode";
		hw,lcdkit-panel-scan-support = <1>;
		hw,lcdkit-panel-display-region-support = <0>;
		hw,lcdkit-panel-checksum-support = <0>;
		hw,lcdkit-panel-esd-reg-command = [14 01 00 00 0a 00 01 0a
				     14 01 00 00 0a 00 01 d9
				     14 01 00 00 0a 00 01 0E];
		hw,lcdkit-panel-esd-reg-command-state = "dsi_lp_mode";
		hw,lcdkit-panel-esd-value = [1c 80 80];
		hw,lcdkit-panel-esd-support = <1>;
		hw,lcdkit-panel-check-reg-command = [14 01 00 00 0a 00 01 0a];
		hw,lcdkit-panel-check-reg-value = [1c];
		hw,lcdkit-panel-check-reg-command-state = "dsi_lp_mode";
		hw,lcdkit-panel-check-reg-support = <1>;
		hw,lcdkit-panel-mipi-detect-support = <0>;
		hw,lcdkit-panel-shutdown-sleep-support = <0>;
		hw,lcdkit-dsi-bpp = <24>;
		hw,lcdkit-panel-cmd-type = <0>;
		hw,lcdkit-pixel-packing = <0>;
		hw,lcdkit-underflow-color = <0x00>;
		hw,lcdkit-border-color = <0>;
		hw,lcdkit-panel-orientation = <0>;
		hw,lcdkit-brightness-max-level = <4095>;
		hw,lcdkit-bl-min-level = <24>;
		hw,lcdkit-bl-max-level = <4095>;
		hw,lcdkit-interleave-mode = <0>;
		hw,lcdkit-h-sync-pulse = <1>;
		hw,lcdkit-bllp-power-mode;
		hw,lcdkit-bllp-eof-power-mode;
		hw,lcdkit-traffic-mode = "burst_mode";
		hw,lcdkit-te-dcs-command = <0>;
		hw,lcdkit-te-pin-select = <0>;
		hw,lcdkit-virtual-channel-id = <0>;
		hw,lcdkit-color-order = "rgb_swap_rgb";
		hw,lcdkit-lane-0-state;
		hw,lcdkit-lane-1-state;
		hw,lcdkit-lane-2-state;
		hw,lcdkit-lane-3-state;
		hw,lcdkit-h-left-border = <0>;
		hw,lcdkit-h-right-border = <0>;
		hw,lcdkit-v-top-border = <0>;
		hw,lcdkit-v-bottom-border = <0>;
		hw,lcdkit-panel-framerate = <60>;
		hw,lcdkit-panel-clockrate = <433060000>;
		hw,lcdkit-panel-timings = [7A 1A 12 00 40 42 16 1E 14 03 04 00];
		hw,lcdkit-t-clk-pre = <0x26>;
		hw,lcdkit-t-clk-post = <0x04>;
		hw,lcdkit-tx-eot-append;
		hw,lcdkit-stream = <0>;
		hw,lcdkit-lp11-init;
		hw,lcdkit-mdp-trigger = "none";
		hw,lcdkit-dma-trigger = "trigger_sw";
		hw,lcdkit-bl-pmic-control-type = "bl_ctrl_wled";
		qcom,panel-supply-entries = <&dsi_panel_pwr_supply>;
		hw,lcdkit-lane-map = "lane_map_0123";
		hw,lcdkit-delay-before-bl = <0>;
		hw,lcdkit-mipi-regulator-mode = <1>;
		hw,lcdkit-bl-en-gpio = <0>;
		hw,lcdkit-delay-af-rst-off = <20>;
		hw,lcdkit-delay-af-blic-init = <0>;
		hw,lcdkit-bl-level-limit-percent = <100>;
		hw,lcdkit-use-second-ic-for-esd = <0>;
		hw,lcdkit-esd-check-num = <3>;
		hw,lcdkit-h-back-porch = <40>;
		hw,lcdkit-h-front-porch = <40>;
		hw,lcdkit-h-pulse-width = <20>;
		hw,lcdkit-v-back-porch = <16>;
		hw,lcdkit-v-pulse-width = <2>;
		hw,lcdkit-v-front-porch = <9>;
		hw,lcdkit-h-sync-skew = <0>;
		hw,lcdkit-lcd-type = <0>;
		hw,lcdkit-panel-pt-test-support = <1>;
		hw,lcdkit-bias-power-ctrl-mode = <0x01>;
		hw,lcdkit-iovcc-power-ctrl-mode = <0x01>;
		hw,lcdkit-vci-power-ctrl-mode = <0x01>;
		hw,lcdkit-id0-gpio = <59>;
		hw,lcdkit-id1-gpio = <48>;
		hw,lcdkit-reset-gpio = <60>;
		hw,lcdkit-te-gpio = <0>;
		hw,lcdkit-vsp-gpio = <0>;
		hw,lcdkit-vsn-gpio = <0>;
		hw,lcdkit-iovcc-gpio = <0>;
		hw,lcdkit-vci-gpio = <0>;
		hw,lcdkit-bl-gpio = <0>;
		hw,lcdkit-iovcc-on-is-need-reset = <0>;
		hw,lcdkit-vsn-on-is-need-reset = <0>;
		hw,lcdkit-lcd-vsp = <5500000>;
		hw,lcdkit-lcd-vsn = <5500000>;
		hw,lcdkit-lcd-rst-first-high = <2>;
		hw,lcdkit-lcd-rst-low = <2>;
		hw,lcdkit-lcd-rst-second-high = <15>;
		hw,lcdkit-delay-af-vci-on = <0>;
		hw,lcdkit-delay-af-iovcc-on = <0>;
		hw,lcdkit-delay-af-bias-on = <0>;
		hw,lcdkit-delay-af-vsp-on = <3>;
		hw,lcdkit-delay-af-vsn-on = <3>;
		hw,lcdkit-delay-af-lp11 = <0>;
		hw,lcdkit-delay-af-tp-reset = <25>;
		hw,lcdkit-delay-af-vsn-off = <3>;
		hw,lcdkit-delay-af-vsp-off = <5>;
		hw,lcdkit-delay-af-bias-off = <0>;
		hw,lcdkit-delay-af-iovcc-off = <0>;
		hw,lcdkit-delay-af-vci-off = <0>;
		hw,lcdkit-panel-off-reset-high = <0>;
    };
};