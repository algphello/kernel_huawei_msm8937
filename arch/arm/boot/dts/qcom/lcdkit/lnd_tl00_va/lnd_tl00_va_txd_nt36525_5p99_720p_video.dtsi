/* Copyright (c) 2013, The Linux Foundation. All rights reserved.
 *
 * This program is free software; you can redistribute it and/or modify
 * it under the terms of the GNU General Public License version 2 and
 * only version 2 as published by the Free Software Foundation.
 *
 * This program is distributed in the hope that it will be useful,
 * but WITHOUT ANY WARRANTY; without even the implied warranty of
 * MERCHANTABILITY or FITNESS FOR A PARTICULAR PURPOSE.  See the
 * GNU General Public License for more details.
 */

/*-------------------------------------------------------------------------
 * This file is autogenerated file using gcdb parser. Please do not edit it.
 * Update input XML file to add a new entry or update variable in this file
 * VERSION = 1.1
 *-----------------------------------------------------------------------*/
/ {
	dsi_lnd_tl00_va_txd_nt36525_5p99_720p_video: lcdkit_lnd_tl00_va_txd_nt36525_5p99_720p_video {
		compatible = "txd-nt36525-5p99-720p-video";
		hw,lcdkit-panel-name = "TXD_NT36525 5P99 VIDEO TFT 720 x 1440";
		hw,lcdkit-panel-type = <0x01>;
		hw,lcdkit-panel-xres = <720>;
		hw,lcdkit-panel-yres = <1440>;
		hw,lcdkit-panel-width = <68>;
		hw,lcdkit-panel-height = <136>;
		hw,lcdkit-panel-on-command = [29 01 00 00 00 00 02 FF 20
			29 01 00 00 00 00 02 FB 01
			29 01 00 00 00 00 02 01 55
			29 01 00 00 00 00 02 03 55
			29 01 00 00 00 00 02 05 B1
			29 01 00 00 00 00 02 07 73
			29 01 00 00 00 00 02 08 CB
			29 01 00 00 00 00 02 0E 91
			29 01 00 00 00 00 02 0F 69
			29 01 00 00 00 00 02 69 A9
			29 01 00 00 00 00 02 94 C0
			29 01 00 00 00 00 02 95 13
			29 01 00 00 00 00 02 96 13
			29 01 00 00 00 00 02 FF 24
			29 01 00 00 00 00 02 FB 01
			29 01 00 00 00 00 02 93 0A
			29 01 00 00 00 00 02 94 0A
			29 01 00 00 00 00 02 00 04
			29 01 00 00 00 00 02 01 05
			29 01 00 00 00 00 02 02 00
			29 01 00 00 00 00 02 03 00
			29 01 00 00 00 00 02 04 08
			29 01 00 00 00 00 02 05 18
			29 01 00 00 00 00 02 06 19
			29 01 00 00 00 00 02 07 0C
			29 01 00 00 00 00 02 08 0D
			29 01 00 00 00 00 02 09 0E
			29 01 00 00 00 00 02 0A 0F
			29 01 00 00 00 00 02 0B 10
			29 01 00 00 00 00 02 0C 11
			29 01 00 00 00 00 02 16 04
			29 01 00 00 00 00 02 17 05
			29 01 00 00 00 00 02 18 00
			29 01 00 00 00 00 02 19 00
			29 01 00 00 00 00 02 1A 08
			29 01 00 00 00 00 02 1B 18
			29 01 00 00 00 00 02 1C 19
			29 01 00 00 00 00 02 1D 0C
			29 01 00 00 00 00 02 1E 0D
			29 01 00 00 00 00 02 1F 0E
			29 01 00 00 00 00 02 20 0F
			29 01 00 00 00 00 02 21 10
			29 01 00 00 00 00 02 22 11
			29 01 00 00 00 00 02 2F 04
			29 01 00 00 00 00 02 30 32
			29 01 00 00 00 00 02 33 32
			29 01 00 00 00 00 02 34 04
			29 01 00 00 00 00 02 37 44
			29 01 00 00 00 00 02 39 00
			29 01 00 00 00 00 02 3A 10
			29 01 00 00 00 00 02 3B A3
			29 01 00 00 00 00 02 3D 52
			29 01 00 00 00 00 02 3F 41
			29 01 00 00 00 00 02 40 00
			29 01 00 00 00 00 02 43 41
			29 01 00 00 00 00 02 44 06
			29 01 00 00 00 00 02 47 44
			29 01 00 00 00 00 02 49 00
			29 01 00 00 00 00 02 4A 10
			29 01 00 00 00 00 02 4B A3
			29 01 00 00 00 00 02 4C 51
			29 01 00 00 00 00 02 4D 12
			29 01 00 00 00 00 02 4E 34
			29 01 00 00 00 00 02 4F 56
			29 01 00 00 00 00 02 51 65
			29 01 00 00 00 00 02 52 43
			29 01 00 00 00 00 02 53 21
			29 01 00 00 00 00 02 55 43
			29 01 00 00 00 00 02 56 46
			29 01 00 00 00 00 02 5A 10
			29 01 00 00 00 00 02 5B A3
			29 01 00 00 00 00 02 5E 06
			29 01 00 00 00 00 02 5F 00
			29 01 00 00 00 00 02 92 C0
			29 01 00 00 00 00 02 76 00
			29 01 00 00 00 00 02 77 00
			29 01 00 00 00 00 02 78 00
			29 01 00 00 00 00 02 79 00
			29 01 00 00 00 00 02 7A 20
			29 01 00 00 00 00 02 7B 3C
			29 01 00 00 00 00 02 7C 00
			29 01 00 00 00 00 02 7D 00
			29 01 00 00 00 00 02 7E 08
			29 01 00 00 00 00 02 87 02
			29 01 00 00 00 00 02 AB 00
			29 01 00 00 00 00 02 AC 00
			29 01 00 00 00 00 02 AD 00
			29 01 00 00 00 00 02 AF 04
			29 01 00 00 00 00 02 B0 05
			29 01 00 00 00 00 02 B1 BB
			29 01 00 00 00 00 02 60 80
			29 01 00 00 00 00 02 61 68
			29 01 00 00 00 00 02 64 11
			29 01 00 00 00 00 02 C4 77
			29 01 00 00 00 00 02 C5 A0
			29 01 00 00 00 00 02 FF 25
			29 01 00 00 00 00 02 FB 01
			29 01 00 00 00 00 02 0A 82
			29 01 00 00 00 00 02 0B BE
			29 01 00 00 00 00 02 0C 01
			29 01 00 00 00 00 02 17 82
			29 01 00 00 00 00 02 18 06
			29 01 00 00 00 00 02 19 0F
			29 01 00 00 00 00 02 1E 00
			29 01 00 00 00 00 02 1F 10
			29 01 00 00 00 00 02 20 A3
			29 01 00 00 00 00 02 23 05
			29 01 00 00 00 00 02 24 BB
			29 01 00 00 00 00 02 25 00
			29 01 00 00 00 00 02 26 10
			29 01 00 00 00 00 02 27 A3
			29 01 00 00 00 00 02 2A 05
			29 01 00 00 00 00 02 2B BB
			29 01 00 00 00 00 02 2D 80
			29 01 00 00 00 00 02 2F 50
			29 01 00 00 00 00 02 30 10
			29 01 00 00 00 00 02 31 00
			29 01 00 00 00 00 02 32 00
			29 01 00 00 00 00 02 33 10
			29 01 00 00 00 00 02 34 A3
			29 01 00 00 00 00 02 37 05
			29 01 00 00 00 00 02 38 BB
			29 01 00 00 00 00 02 40 10
			29 01 00 00 00 00 02 41 80
			29 01 00 00 00 00 02 42 10
			29 01 00 00 00 00 02 43 A3
			29 01 00 00 00 00 02 46 05
			29 01 00 00 00 00 02 47 BB
			29 01 00 00 00 00 02 4A 00
			29 01 00 00 00 00 02 4B 10
			29 01 00 00 00 00 02 4C A3
			29 01 00 00 00 00 02 4D 10
			29 01 00 00 00 00 02 4E A3
			29 01 00 00 00 00 02 4F 10
			29 01 00 00 00 00 02 50 A3
			29 01 00 00 00 00 02 53 05
			29 01 00 00 00 00 02 54 BB
			29 01 00 00 00 00 02 55 05
			29 01 00 00 00 00 02 56 BB
			29 01 00 00 00 00 02 58 00
			29 01 00 00 00 00 02 59 00
			29 01 00 00 00 00 02 5A 60
			29 01 00 00 00 00 02 5B 80
			29 01 00 00 00 00 02 5C 00
			29 01 00 00 00 00 02 5D 10
			29 01 00 00 00 00 02 5E A3
			29 01 00 00 00 00 02 5F 10
			29 01 00 00 00 00 02 60 A3
			29 01 00 00 00 00 02 61 10
			29 01 00 00 00 00 02 62 A3
			29 01 00 00 00 00 02 65 05
			29 01 00 00 00 00 02 66 BB
			29 01 00 00 00 00 02 6B 07
			29 01 00 00 00 00 02 6C 4A
			29 01 00 00 00 00 02 6D 94
			29 01 00 00 00 00 02 6E 0D
			29 01 00 00 00 00 02 6F 17
			29 01 00 00 00 00 02 70 54
			29 01 00 00 00 00 02 71 8A
			29 01 00 00 00 00 02 72 17
			29 01 00 00 00 00 02 73 0D
			29 01 00 00 00 00 02 78 00
			29 01 00 00 00 00 02 79 05
			29 01 00 00 00 00 02 7A 00
			29 01 00 00 00 00 02 7B B0
			29 01 00 00 00 00 02 7C 00
			29 01 00 00 00 00 02 7D 05
			29 01 00 00 00 00 02 7E 00
			29 01 00 00 00 00 02 7F B0
			29 01 00 00 00 00 02 FF 26
			29 01 00 00 00 00 02 FB 01
			29 01 00 00 00 00 02 04 4B
			29 01 00 00 00 00 02 06 01
			29 01 00 00 00 00 02 0C 0B
			29 01 00 00 00 00 02 0D 01
			29 01 00 00 00 00 02 0E 02
			29 01 00 00 00 00 02 0F 06
			29 01 00 00 00 00 02 10 07
			29 01 00 00 00 00 02 12 00
			29 01 00 00 00 00 02 13 2A
			29 01 00 00 00 00 02 14 80
			29 01 00 00 00 00 02 16 81
			29 01 00 00 00 00 02 19 0E
			29 01 00 00 00 00 02 1A 6A
			29 01 00 00 00 00 02 1B 0D
			29 01 00 00 00 00 02 1C D2
			29 01 00 00 00 00 02 1D 00
			29 01 00 00 00 00 02 1E C0
			29 01 00 00 00 00 02 1F C0
			29 01 00 00 00 00 02 24 01
			29 01 00 00 00 00 02 25 C0
			29 01 00 00 00 00 02 26 66
			29 01 00 00 00 00 02 27 66
			29 01 00 00 00 00 02 28 66
			29 01 00 00 00 00 02 29 06
			29 01 00 00 00 00 02 2F 00
			29 01 00 00 00 00 02 30 C0
			29 01 00 00 00 00 02 31 11
			29 01 00 00 00 00 02 32 11
			29 01 00 00 00 00 02 34 05
			29 01 00 00 00 00 02 35 C0
			29 01 00 00 00 00 02 36 11
			29 01 00 00 00 00 02 37 78
			29 01 00 00 00 00 02 38 66
			29 01 00 00 00 00 02 39 06
			29 01 00 00 00 00 02 3F 06
			29 01 00 00 00 00 02 40 C0
			29 01 00 00 00 00 02 41 66
			29 01 00 00 00 00 02 42 66
			29 01 00 00 00 00 02 43 06
			29 01 00 00 00 00 02 58 E1
			29 01 00 00 00 00 02 59 E1
			29 01 00 00 00 00 02 5A E1
			29 01 00 00 00 00 02 5B E1
			29 01 00 00 00 00 02 5C 00
			29 01 00 00 00 00 02 5D 00
			29 01 00 00 00 00 02 5E 06
			29 01 00 00 00 00 02 5F 66
			29 01 00 00 00 00 02 60 66
			29 01 00 00 00 00 02 61 06
			29 01 00 00 00 00 02 63 10
			29 01 00 00 00 00 02 64 A3
			29 01 00 00 00 00 02 65 10
			29 01 00 00 00 00 02 66 A3
			29 01 00 00 00 00 02 67 10
			29 01 00 00 00 00 02 68 A3
			29 01 00 00 00 00 02 6B 00
			29 01 00 00 00 00 02 6C 00
			29 01 00 00 00 00 02 6D 00
			29 01 00 00 00 00 02 6F 04
			29 01 00 00 00 00 02 70 05
			29 01 00 00 00 00 02 71 DC
			29 01 00 00 00 00 02 73 10
			29 01 00 00 00 00 02 74 A3
			29 01 00 00 00 00 02 77 05
			29 01 00 00 00 00 02 78 DC
			29 01 00 00 00 00 02 7A 10
			29 01 00 00 00 00 02 7B A3
			29 01 00 00 00 00 02 7E 05
			29 01 00 00 00 00 02 7F DC
			29 01 00 00 00 00 02 82 10
			29 01 00 00 00 00 02 83 A3
			29 01 00 00 00 00 02 84 10
			29 01 00 00 00 00 02 85 A3
			29 01 00 00 00 00 02 86 10
			29 01 00 00 00 00 02 87 A3
			29 01 00 00 00 00 02 8A 05
			29 01 00 00 00 00 02 8B DC
			29 01 00 00 00 00 02 8C 00
			29 01 00 00 00 00 02 8D 00
			29 01 00 00 00 00 02 8E 01
			29 01 00 00 00 00 02 8F 00
			29 01 00 00 00 00 02 90 00
			29 01 00 00 00 00 02 91 00
			29 01 00 00 00 00 02 92 05
			29 01 00 00 00 00 02 93 A0
			29 01 00 00 00 00 02 94 00
			29 01 00 00 00 00 02 95 00
			29 01 00 00 00 00 02 96 00
			29 01 00 00 00 00 02 99 18
			29 01 00 00 00 00 02 9A 06
			29 01 00 00 00 00 02 9B 17
			29 01 00 00 00 00 02 9C 6E
			29 01 00 00 00 00 02 FF 27
			29 01 00 00 00 00 02 FB 01
			29 01 00 00 00 00 02 96 03
			29 01 00 00 00 00 02 97 15
			29 01 00 00 00 00 02 98 11
			29 01 00 00 00 00 02 99 3F
			29 01 00 00 00 00 02 9B 3F
			29 01 00 00 00 00 02 9D 25
			29 01 00 00 00 00 02 9E 55
			29 01 00 00 00 00 02 9F 05
			29 01 00 00 00 00 02 B3 C6
			29 01 00 00 00 00 02 FF 23
			29 01 00 00 00 00 02 FB 01
			29 01 00 00 00 00 02 12 A2
			29 01 00 00 00 00 02 15 81
			29 01 00 00 00 00 02 16 0A
			29 01 00 00 00 00 02 FF 20
			29 01 00 00 00 00 02 FB 01
			29 01 00 00 00 00 11 B0 00 00 00 14 00 32 00 4A 00 5E 00 70 00 81 00 90
			29 01 00 00 00 00 11 B1 00 9E 00 CD 00 F1 01 2B 01 56 01 9C 01 D2 01 D4
			29 01 00 00 00 00 11 B2 02 08 02 3E 02 65 02 93 02 BF 02 F0 03 01 03 13
			29 01 00 00 00 00 0D B3 03 34 03 50 03 72 03 9A 03 CA 03 DC
			29 01 00 00 00 00 11 B4 00 00 00 14 00 32 00 4A 00 5E 00 70 00 81 00 90
			29 01 00 00 00 00 11 B5 00 9E 00 CD 00 F1 01 2B 01 56 01 9C 01 D2 01 D4
			29 01 00 00 00 00 11 B6 02 08 02 3E 02 65 02 93 02 BF 02 F0 03 01 03 13
			29 01 00 00 00 00 0D B7 03 34 03 50 03 72 03 9A 03 CA 03 DC
			29 01 00 00 00 00 11 B8 00 00 00 14 00 32 00 4A 00 5E 00 70 00 81 00 90
			29 01 00 00 00 00 11 B9 00 9E 00 CD 00 F1 01 2B 01 56 01 9C 01 D2 01 D4
			29 01 00 00 00 00 11 BA 02 08 02 3E 02 65 02 93 02 BF 02 F0 03 01 03 13
			29 01 00 00 00 00 0D BB 03 34 03 50 03 72 03 9A 03 CA 03 DC
			29 01 00 00 00 00 02 FF 21
			29 01 00 00 00 00 02 FB 01
			29 01 00 00 00 00 11 B0 00 00 00 14 00 32 00 4A 00 5E 00 70 00 81 00 90
			29 01 00 00 00 00 11 B1 00 9E 00 CD 00 F1 01 2B 01 56 01 9C 01 D2 01 D4
			29 01 00 00 00 00 11 B2 02 08 02 3E 02 65 02 93 02 BF 02 F0 03 01 03 13
			29 01 00 00 00 00 0D B3 03 34 03 50 03 72 03 9A 03 CA 03 DC
			29 01 00 00 00 00 11 B4 00 00 00 14 00 32 00 4A 00 5E 00 70 00 81 00 90
			29 01 00 00 00 00 11 B5 00 9E 00 CD 00 F1 01 2B 01 56 01 9C 01 D2 01 D4
			29 01 00 00 00 00 11 B6 02 08 02 3E 02 65 02 93 02 BF 02 F0 03 01 03 13
			29 01 00 00 00 00 0D B7 03 34 03 50 03 72 03 9A 03 CA 03 DC
			29 01 00 00 00 00 11 B8 00 00 00 14 00 32 00 4A 00 5E 00 70 00 81 00 90
			29 01 00 00 00 00 11 B9 00 9E 00 CD 00 F1 01 2B 01 56 01 9C 01 D2 01 D4
			29 01 00 00 00 00 11 BA 02 08 02 3E 02 65 02 93 02 BF 02 F0 03 01 03 13
			29 01 00 00 00 00 0D BB 03 34 03 50 03 72 03 9A 03 CA 03 DC
			29 01 00 00 00 00 02 FF 10
			29 01 00 00 00 00 02 FB 01
			29 01 00 00 00 00 02 35 01
			29 01 00 00 00 00 02 B0 01
			29 01 00 00 64 00 02 11 00
			29 01 00 00 28 00 02 29 00];
		hw,lcdkit-panel-on-command-state = "dsi_lp_mode";
		hw,lcdkit-panel-display-on-command = [29 01 00 00 64 00 02 11 00
				29 01 00 00 28 00 02 29 00];
		hw,lcdkit-panel-off-command = [29 01 00 00 14 00 02 28 00
				29 01 00 00 78 00 02 10 00];
		hw,lcdkit-panel-off-command-state = "dsi_hs_mode";
		hw,lcdkit-panel-backlight-command = [39 01 00 00 00 00 02 51 00];
		hw,lcdkit-panel-backlight-command-state = "dsi_lp_mode";
		hw,lcdkit-panel-cabc-off-command = [15 01 00 00 0a 00 02 55 00];
		hw,lcdkit-panel-cabc-off-command-state = "dsi_lp_mode";
		hw,lcdkit-panel-cabc-ui-command = [15 01 00 00 0a 00 02 55 01
				  15 01 00 00 0a 00 02 53 2C];
		hw,lcdkit-panel-cabc-ui-command-state = "dsi_lp_mode";
		hw,lcdkit-panel-cabc-still-command = [15 01 00 00 0a 00 02 55 02
				     15 01 00 00 0a 00 02 53 2C];
		hw,lcdkit-panel-cabc-still-command-state = "dsi_lp_mode";
		hw,lcdkit-panel-cabc-moving-command = [15 01 00 00 0a 00 02 55 03
				      15 01 00 00 0a 00 02 53 2C];
		hw,lcdkit-panel-cabc-moving-command-state = "dsi_lp_mode";
		hw,lcdkit-panel-cabc-support = <0>;
		hw,lcdkit-panel-dot-inversion-command = [29 01 00 00 00 00 02 ff 24
			29 01 00 00 00 00 02 fb 01
			29 01 00 00 00 00 02 9b 01
			29 01 00 00 00 00 02 ff 10];
		hw,lcdkit-panel-dot-inversion-command-state = "dsi_lp_mode";
		hw,lcdkit-panel-column-inversion-command = [29 01 00 00 00 00 02 ff 24
			29 01 00 00 00 00 02 fb 01
			29 01 00 00 00 00 02 9b 0f
			29 01 00 00 00 00 02 ff 10];
		hw,lcdkit-panel-column-inversion-command-state = "dsi_lp_mode";
		hw,lcdkit-panel-inversion-support = <1>;
		hw,lcdkit-panel-forword-scan-command = [29 01 00 00 00 00 02 36 03];
		hw,lcdkit-panel-forword-scan-command-state = "dsi_lp_mode";
		hw,lcdkit-panel-revert-scan-command = [29 01 00 00 00 00 02 36 00];
		hw,lcdkit-panel-revert-scan-command-state = "dsi_lp_mode";
		hw,lcdkit-panel-scan-support = <1>;
		hw,lcdkit-panel-display-region-support = <0>;
		hw,lcdkit-panel-checksum-support = <0>;
		hw,lcdkit-panel-esd-reg-command = [06 01 00 00 0a 00 01 0a];
		hw,lcdkit-panel-esd-reg-command-state = "dsi_lp_mode";
		hw,lcdkit-panel-esd-value = [9c];
		hw,lcdkit-panel-esd-support = <1>;
		hw,lcdkit-panel-check-reg-command = [06 01 00 00 0a 00 01 0a];
		hw,lcdkit-panel-check-reg-value = [9c];
		hw,lcdkit-panel-check-reg-command-state = "dsi_lp_mode";
		hw,lcdkit-panel-check-reg-support = <1>;
		hw,lcdkit-panel-mipi-detect-support = <0>;
		hw,lcdkit-panel-shutdown-sleep-support = <0>;
		hw,lcdkit-dsi-bpp = <24>;
		hw,lcdkit-panel-cmd-type = <0>;
		hw,lcdkit-pixel-packing = <0>;
		hw,lcdkit-underflow-color = <0x00>;
		hw,lcdkit-border-color = <0>;
		hw,lcdkit-panel-orientation = <0>;
		hw,lcdkit-brightness-max-level = <4095>;
		hw,lcdkit-bl-min-level = <24>;
		hw,lcdkit-bl-max-level = <4095>;
		hw,lcdkit-interleave-mode = <0>;
		hw,lcdkit-h-sync-pulse = <1>;
		hw,lcdkit-bllp-power-mode;
		hw,lcdkit-bllp-eof-power-mode;
		hw,lcdkit-traffic-mode = "burst_mode";
		hw,lcdkit-te-dcs-command = <0>;
		hw,lcdkit-te-pin-select = <0>;
		hw,lcdkit-virtual-channel-id = <0>;
		hw,lcdkit-color-order = "rgb_swap_rgb";
		hw,lcdkit-lane-0-state;
		hw,lcdkit-lane-1-state;
		hw,lcdkit-lane-2-state;
		hw,lcdkit-lane-3-state;
		hw,lcdkit-h-left-border = <0>;
		hw,lcdkit-h-right-border = <0>;
		hw,lcdkit-v-top-border = <0>;
		hw,lcdkit-v-bottom-border = <0>;
		hw,lcdkit-panel-framerate = <60>;
		hw,lcdkit-panel-clockrate = <430990000>;
		hw,lcdkit-panel-timings = [7A 1A 12 00 3E 42 16 1E 14 03 04 00];
		hw,lcdkit-t-clk-pre = <0x26>;
		hw,lcdkit-t-clk-post = <0x04>;
		hw,lcdkit-tx-eot-append;
		hw,lcdkit-stream = <0>;
		hw,lcdkit-lp11-init;
		hw,lcdkit-mdp-trigger = "none";
		hw,lcdkit-dma-trigger = "trigger_sw";
		hw,lcdkit-bl-pmic-control-type = "bl_ctrl_wled";
		qcom,panel-supply-entries = <&dsi_panel_pwr_supply>;
		hw,lcdkit-lane-map = "lane_map_0123";
		hw,lcdkit-delay-before-bl = <0>;
		hw,lcdkit-mipi-regulator-mode = <1>;
		hw,lcdkit-bl-en-gpio = <0>;
		hw,lcdkit-delay-af-rst-off = <20>;
		hw,lcdkit-delay-af-blic-init = <0>;
		hw,lcdkit-bl-level-limit-percent = <100>;
		hw,lcdkit-use-second-ic-for-esd = <0>;
		hw,lcdkit-esd-check-num = <3>;
		hw,lcdkit-h-back-porch = <40>;
		hw,lcdkit-h-front-porch = <40>;
		hw,lcdkit-h-pulse-width = <20>;
		hw,lcdkit-v-back-porch = <8>;
		hw,lcdkit-v-pulse-width = <2>;
		hw,lcdkit-v-front-porch = <10>;
		hw,lcdkit-h-sync-skew = <0>;
		hw,lcdkit-lcd-type = <2>;
		hw,lcdkit-panel-pt-test-support = <1>;
		hw,lcdkit-bias-power-ctrl-mode = <0x01>;
		hw,lcdkit-iovcc-power-ctrl-mode = <0x01>;
		hw,lcdkit-vci-power-ctrl-mode = <0x01>;
		hw,lcdkit-id0-gpio = <59>;
		hw,lcdkit-id1-gpio = <48>;
		hw,lcdkit-reset-gpio = <60>;
		hw,lcdkit-te-gpio = <0>;
		hw,lcdkit-vsp-gpio = <0>;
		hw,lcdkit-vsn-gpio = <0>;
		hw,lcdkit-iovcc-gpio = <0>;
		hw,lcdkit-vci-gpio = <0>;
		hw,lcdkit-bl-gpio = <0>;
		hw,lcdkit-iovcc-on-is-need-reset = <0>;
		hw,lcdkit-vsn-on-is-need-reset = <0>;
		hw,lcdkit-lcd-vsp = <6000000>;
		hw,lcdkit-lcd-vsn = <6000000>;
		hw,lcdkit-lcd-rst-first-high = <3>;
		hw,lcdkit-lcd-rst-low = <3>;
		hw,lcdkit-lcd-rst-second-high = <10>;
		hw,lcdkit-delay-af-vci-on = <0>;
		hw,lcdkit-delay-af-iovcc-on = <0>;
		hw,lcdkit-delay-af-bias-on = <0>;
		hw,lcdkit-delay-af-vsp-on = <1>;
		hw,lcdkit-delay-af-vsn-on = <10>;
		hw,lcdkit-delay-af-lp11 = <0>;
		hw,lcdkit-delay-af-tp-reset = <25>;
		hw,lcdkit-delay-af-vsn-off = <3>;
		hw,lcdkit-delay-af-vsp-off = <5>;
		hw,lcdkit-delay-af-bias-off = <0>;
		hw,lcdkit-delay-af-iovcc-off = <0>;
		hw,lcdkit-delay-af-vci-off = <0>;
		hw,lcdkit-panel-off-reset-high = <1>;
    };
};