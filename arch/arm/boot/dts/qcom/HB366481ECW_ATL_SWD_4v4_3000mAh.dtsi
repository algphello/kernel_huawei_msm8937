
qcom,HB366481ECW_ATL_SWD_4v4_3000mAh {
	/* #3092326_Huawei_London_sunwoda3000mAh_averaged_MasterSlave_Sept20th2017*/
	qcom,max-voltage-uv = <4400000>;
	qcom,nom-batt-capacity-mah = <3000>;
	qcom,batt-id-kohm = <39>;
	qcom,battery-beta = <3435>;
	qcom,battery-type = "HB366481ECW_ATL_SWD_4v4_3000mAh";
	qcom,fg-cc-cv-threshold-mv = <4380>;
	qcom,chg-rslow-comp-c1 = <2771527>;
	qcom,chg-rslow-comp-c2 = <3256055>;
	qcom,chg-rs-to-rslow = <1180850>;
	qcom,chg-rslow-comp-thr = <0x99>;
	qcom,checksum = <0x3D1E>;
	qcom,gui-version = "PMI8950GUI - 2.0.0.16";
	qcom,fg-profile-data = [
		 DE 83 AC 7C 
		 F4 80 E9 76 
		 50 83 92 61 
		 6B 7A 93 85 
		 53 82 83 98 
		 7D B6 55 C2 
		 52 0F 36 88 
		 C4 84 46 88 
		 DC 7E 46 83 
		 B4 72 27 7C 
		 65 6A 1E 81 
		 D8 A1 02 C5 
		 C4 D1 68 0E 
		 7E 0B C4 5A 
		 14 70 B2 FD 
		 08 2C 4C 3E 
		 97 38 00 00 
		 0C 4C 75 30 
		 C6 42 00 00 
		 00 00 00 00 
		 00 00 00 00 
		 3D 71 25 70 
		 58 6A 01 89 
		 FA 75 50 69 
		 5B 64 CC 7A 
		 5B 74 E2 61 
		 93 6E 19 A1 
		 21 1C 68 3E 
		 67 A0 71 0C 
		 28 00 FF 36 
		 F0 11 30 03 
		 00 00 00 0C 
	];
};
