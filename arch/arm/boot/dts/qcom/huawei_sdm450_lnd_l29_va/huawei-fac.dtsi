/{
		huawei_fac_info {
		compatible = "huawei,hw_fac_info";
		fac,product_name = "LND-L29";
		fac,hardware_ver = "HL2LNDM";
		fac,software_ver = "LND_L29_VA";
		fac,simcard_adapt = "support";
		status = "ok";
	};
};
