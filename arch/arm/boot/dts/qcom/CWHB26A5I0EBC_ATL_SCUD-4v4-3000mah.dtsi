cw,HB26A5I0EBC_ATL_SCUD-4v4-3000mah {
    cw,batt-id-kohm = <110>;
    cw,battery-type = "HB26A5I0EBC_ATL_SCUD-4v4-3000mah";
    cw,colum = <4>;
    cw,raw = <64>;
    cw,nom_cap_uah = <3000000>;
    cw,model_data =
    <0x17 0xDF 0x67 0x6D 0x6D 0x6B 0x67 0x64
    0x62 0x61 0x5E 0x58 0x59 0x55 0x48 0x3F
    0x36 0x2F 0x26 0x24 0x27 0x2F 0x42 0x4B
    0x2D 0x4F 0x0B 0x85 0x20 0x40 0x52 0x65
    0x6D 0x67 0x67 0x66 0x3D 0x1A 0x73 0x42
    0x0D 0x3D 0x2C 0x4A 0x81 0x96 0x99 0x14
    0x58 0x77 0x95 0xC5 0x80 0x42 0x5B 0x70
    0x28 0x00 0x64 0xA5 0xB5 0xC1 0x00 0xFF >,
    <0x17 0xA0 0x68 0x6C 0x6B 0x68 0x65 0x62
    0x60 0x5F 0x5B 0x58 0x57 0x51 0x45 0x3D
    0x33 0x2D 0x25 0x24 0x27 0x30 0x42 0x49
    0x2E 0x55 0x0B 0x85 0x20 0x40 0x52 0x65
    0x6D 0x67 0x67 0x66 0x3D 0x1A 0x73 0x42
    0x0D 0x3B 0x2C 0x4A 0x81 0x96 0x99 0x14
    0x58 0x77 0x95 0xC5 0x80 0x42 0x5B 0x70
    0x34 0x00 0x64 0xA5 0xB5 0xC1 0x01 0xFF >,
    <0x17 0x21 0x69 0x69 0x66 0x63 0x60 0x5F
    0x5D 0x5B 0x56 0x56 0x53 0x49 0x41 0x36
    0x30 0x28 0x23 0x23 0x28 0x32 0x42 0x46
    0x2F 0x61 0x0B 0x85 0x20 0x40 0x52 0x65
    0x6D 0x67 0x67 0x66 0x3D 0x1A 0x73 0x42
    0x0D 0x39 0x2C 0x4A 0x81 0x96 0x99 0x14
    0x58 0x77 0x95 0xC5 0x80 0x42 0x5B 0x70
    0x3E 0x00 0x64 0xA5 0xB5 0xC1 0x02 0xFF >,
    <0x15 0x65 0x5B 0x58 0x57 0x57 0x54 0x52
    0x4F 0x4F 0x4D 0x45 0x3C 0x32 0x2D 0x27
    0x21 0x1E 0x1F 0x22 0x27 0x39 0x42 0x33
    0x36 0x84 0x0B 0x85 0x20 0x40 0x52 0x65
    0x6D 0x67 0x67 0x66 0x3D 0x1A 0x73 0x42
    0x0D 0x34 0x2C 0x4A 0x81 0x96 0x99 0x14
    0x58 0x77 0x95 0xC5 0x80 0x42 0x5B 0x70
    0x50 0x00 0x64 0xA5 0xB5 0xC1 0x03 0xFF >;
cw,model_data_hltherm =
    <0x18 0x42 0x63 0x6D 0x6F 0x70 0x6B 0x69
    0x63 0x64 0x64 0x59 0x5B 0x5B 0x4E 0x42
    0x3A 0x33 0x29 0x24 0x27 0x2E 0x41 0x4E
    0x2F 0x49 0x08 0xB4 0x20 0x40 0x52 0x65
    0x6D 0x67 0x67 0x66 0x3D 0x1A 0x73 0x42
    0x0D 0x42 0x28 0x47 0x81 0x96 0x99 0x14
    0x58 0x77 0x95 0xC5 0x80 0x36 0x51 0xFF
    0x3A 0x00 0x64 0xA5 0xB5 0xC1 0x58 0xC9 >,
    <0x18 0x42 0x63 0x6D 0x6F 0x70 0x6B 0x69
    0x63 0x64 0x64 0x59 0x5B 0x5B 0x4E 0x42
    0x3A 0x33 0x29 0x24 0x27 0x2E 0x41 0x4E
    0x2F 0x49 0x08 0xB4 0x20 0x40 0x52 0x65
    0x6D 0x67 0x67 0x66 0x3D 0x1A 0x73 0x42
    0x0D 0x42 0x28 0x47 0x81 0x96 0x99 0x14
    0x58 0x77 0x95 0xC5 0x80 0x36 0x51 0xFF
    0x3A 0x00 0x64 0xA5 0xB5 0xC1 0x58 0xC9 >,
    <0x18 0x42 0x63 0x6D 0x6F 0x70 0x6B 0x69
    0x63 0x64 0x64 0x59 0x5B 0x5B 0x4E 0x42
    0x3A 0x33 0x29 0x24 0x27 0x2E 0x41 0x4E
    0x2F 0x49 0x08 0xB4 0x20 0x40 0x52 0x65
    0x6D 0x67 0x67 0x66 0x3D 0x1A 0x73 0x42
    0x0D 0x42 0x28 0x47 0x81 0x96 0x99 0x14
    0x58 0x77 0x95 0xC5 0x80 0x36 0x51 0xFF
    0x3A 0x00 0x64 0xA5 0xB5 0xC1 0x58 0xC9 >,
    <0x18 0x42 0x63 0x6D 0x6F 0x70 0x6B 0x69
    0x63 0x64 0x64 0x59 0x5B 0x5B 0x4E 0x42
    0x3A 0x33 0x29 0x24 0x27 0x2E 0x41 0x4E
    0x2F 0x49 0x08 0xB4 0x20 0x40 0x52 0x65
    0x6D 0x67 0x67 0x66 0x3D 0x1A 0x73 0x42
    0x0D 0x42 0x28 0x47 0x81 0x96 0x99 0x14
    0x58 0x77 0x95 0xC5 0x80 0x36 0x51 0xFF
    0x3A 0x00 0x64 0xA5 0xB5 0xC1 0x58 0xC9 >;
};