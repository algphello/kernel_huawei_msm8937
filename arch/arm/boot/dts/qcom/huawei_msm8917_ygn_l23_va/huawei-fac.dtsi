/{
		huawei_fac_info {
		compatible = "huawei,hw_fac_info";
		fac,product_name = "YGN-L23";
		fac,hardware_ver = "HL1YNGM";
		fac,software_ver = "YGN_L23_VA";
		fac,simcard_adapt = "support";
		status = "ok";
	};
};
