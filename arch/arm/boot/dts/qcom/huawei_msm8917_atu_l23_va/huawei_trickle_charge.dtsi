huawei_trickle_charge {
    ic = <2>;
    time_out_s = <900>;
    led_on_ms = <500>;
    led_off_ms = <2000>;
    sdp_iin_ma = <500>;
    dcp_iin_ma = <1500>;
    sdp_ichg_ma = <1000>;
    dcp_ichg_ma = <2000>;
    dpm_th_mv = <0>;
    bootup_volt_mv = <3450>;
    bootup_volt_no_chg = <3500>;
    led_control_mode = <1>;
    led_red_exist = <1>;
    led_blue_exist = <0>;
    led_green_exist = <1>;
    led_red_init_sts = <0>;
    led_blue_init_sts = <1>;
    led_green_init_sts = <0>;
    led_red_gpio = <-1>;
    led_green_gpio = <-1>;
    led_blue_gpio = <-1>;
    led_on_val = <0x2>;
    led_off_val = <0x0>;
    slave_addr = <0x6A>;
    blsp_qup_irq_reg = <128>;
    blsp_qup_base_reg = <0x78B6000>;
    scl_gpio = <7>;
    sda_gpio = <6>;
    func = <3>;
    if_clk = "blsp1_qup2_ahb_iface_clk";
    qup_clk = "gcc_blsp1_qup2_i2c_apps_clk";
};