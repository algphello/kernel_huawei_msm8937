#include "huawei-sensors.dtsi"
#include "huawei-biasic.dtsi"
#include "huawei-vibrate.dtsi"
#include "huawei-gpio-led.dtsi"
#include "huawei-battery.dtsi"
#include "huawei-tp.dtsi"
//#include "huawei-lcd.dtsi"
#include "huawei-camera.dtsi"
#include "huawei-usb.dtsi"
#include "huawei-audio.dtsi"
//#include "huawei-fingerprint.dtsi"
#include "huawei-fac.dtsi"
#include "huawei_dev_detect-va.dtsi"
#include "huawei-wifi.dtsi"
#include "huawei-keypad.dtsi"
#include "huawei-thermal.dtsi"
#include "huawei-bt.dtsi"
#include "huawei-fm.dtsi"