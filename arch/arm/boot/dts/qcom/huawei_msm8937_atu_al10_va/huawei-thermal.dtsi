/*remove qcom bcl*/
&soc {
    /delete-node/ qcom,bcl;
};

/{
    huawei_msm_thermal: huawei_msm_thermal {
        compatible = "huawei-thermal";
        status = "ok";
        qcom,cpu-thermal-vadc = <&huawei_mpp4_adc>;
        switch-mode= <0>;
        file-node = "msm_thermal";
        voltage-list =
        <1760 1757 1754 1751 1747 1744 1740 1736 1731 1727
         1722 1716 1711 1705 1699 1693 1686 1679 1672 1664
         1656 1648 1639 1630 1620 1610 1599 1588 1577 1565
         1553 1540 1527 1514 1500 1485 1470 1455 1439 1423
         1406 1389 1372 1354 1335 1317 1298 1279 1259 1239
         1219 1198 1178 1157 1136 1115 1093 1072 1050 1029
         1007 986 964 943 921 900 879 858 837 816
         796 775 755 736 716 697 678 659 641 623
         605 588 571 555 538 523 507 492 477 463
         449 435 422 409 396 384 372 360 349 338
         327 317 307 297 288 279 270 261 253 245
         237 230 222 215 209 202 196 189 183 178
         172 167 161 156 151 147 142 138 133 129
         125 121 118 114 111 107 104 101 98 95
         92 89 87 84 81 79 77 74 72 70
         68 66 64 62 61 59 57 56 54 52
         51 50 48 47 46 44>;
        voltage-temp-num = <166>;
    };
    huawei_pa_thermal: huawei_pa_thermal {
        compatible = "huawei-thermal";
        status = "ok";
        qcom,cpu-thermal-vadc = <&huawei_pa_adc>;
        file-node = "pa_thermal";
    };
};
