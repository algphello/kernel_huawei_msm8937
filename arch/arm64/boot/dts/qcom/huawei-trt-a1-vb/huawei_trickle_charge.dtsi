huawei_trickle_charge {
    ic = <0>;
    time_out_s = <900>;
    led_on_ms = <500>;
    led_off_ms = <2000>;
    sdp_iin_ma = <500>;
    dcp_iin_ma = <1500>;
    sdp_ichg_ma = <500>;
    dcp_ichg_ma = <2000>;
    dpm_th_mv = <0>;
    bootup_volt_mv = <3450>;
    bootup_volt_no_chg = <3400>;
    led_red_exist = <1>;
    led_blue_exist = <1>;
    led_green_exist = <1>;
    led_red_init_sts = <0>;
    led_blue_init_sts = <0>;
    led_green_init_sts = <0>;
    led_red_gpio = <128>;
    led_green_gpio = <125>;
    led_blue_gpio = <126>;
    led_on_val = <0x2>;
    led_off_val = <0x0>;
};