qcom,HB366481ECW_ATL_Scud_4v4_3000mAh {
	/* 3092429_Huawei_London_Scud_3000mAh_averaged_MasterSlave_Sept5th2017*/
	qcom,max-voltage-uv = <4400000>;
	qcom,nom-batt-capacity-mah = <3000>;
	qcom,batt-id-kohm = <110>;
	qcom,battery-beta = <3435>;
	qcom,battery-type = "HB366481ECW_ATL_Scud_4v4_3000mAh";
	qcom,fg-cc-cv-threshold-mv = <4380>;
	qcom,chg-rslow-comp-c1 = <2806949>;
	qcom,chg-rslow-comp-c2 = <3267878>;
	qcom,chg-rs-to-rslow = <1295829>;
	qcom,chg-rslow-comp-thr = <0x99>;
	qcom,checksum = <0x3C47>;
	qcom,gui-version = "PMI8950GUI - 2.0.0.16";
	qcom,fg-profile-data = [
		 EE 83 52 7D 
		 84 81 18 7C 
		 53 83 AC 5A 
		 DF 7B D6 86 
		 26 82 47 9A 
		 90 BD C5 CA 
		 5C 0E D6 83 
		 18 7C 98 80 
		 70 76 4F 83 
		 9C 70 AB 61 
		 B9 7D 52 82 
		 8E 99 D2 BC 
		 AB C9 65 0D 
		 75 0B A5 5A 
		 14 70 B2 FD 
		 00 3C CC 3F 
		 8E 3A 00 00 
		 CE 46 60 32 
		 44 22 00 00 
		 00 00 00 00 
		 00 00 00 00 
		 CB 69 7F 69 
		 07 81 AE 8B 
		 D8 75 7F 68 
		 2D 70 98 83 
		 E8 75 63 68 
		 00 00 00 00 
		 23 21 58 27 
		 3E A0 71 0C 
		 28 00 FF 36 
		 F0 11 30 03 
		 00 00 00 0C 
	];
};
