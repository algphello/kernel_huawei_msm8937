/{
		huawei_fac_info {
		compatible = "huawei,hw_fac_info";
		fac,product_name = "LND-L21";
		fac,hardware_ver = "HL1LDNM";
		fac,software_ver = "LND_L21B_VA";
		fac,simcard_adapt = "support";
		status = "ok";
	};
};
