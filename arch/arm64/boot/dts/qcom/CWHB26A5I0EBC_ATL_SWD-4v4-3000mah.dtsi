cw,HB26A5I0EBC_ATL_SWD-4v4-3000mah {
    cw,batt-id-kohm = <39>;
    cw,battery-type = "HB26A5I0EBC_ATL_SWD-4v4-3000mah";
    cw,colum = <4>;
    cw,raw = <64>;
    cw,nom_cap_uah = <3000000>;
    cw,model_data =
    <0x17 0xDF 0x65 0x69 0x6D 0x6C 0x67 0x65
    0x63 0x63 0x5E 0x59 0x59 0x50 0x47 0x41
    0x3A 0x30 0x29 0x22 0x25 0x31 0x42 0x4D
    0x26 0x54 0x0B 0x85 0x1E 0x3C 0x4B 0x5B
    0x66 0x66 0x66 0x66 0x3E 0x1B 0x75 0x42
    0x10 0x3F 0x1D 0x4C 0x87 0x94 0x97 0x1A
    0x5A 0x79 0x95 0xC4 0x60 0x42 0x62 0x70
    0x25 0x00 0x64 0xA5 0xB5 0xC1 0x00 0xFF >,
    <0x17 0xA0 0x66 0x69 0x6B 0x69 0x65 0x63
    0x62 0x60 0x5B 0x58 0x56 0x4D 0x45 0x3F
    0x37 0x2E 0x27 0x22 0x25 0x32 0x42 0x4B
    0x28 0x5A 0x0B 0x85 0x1E 0x3C 0x4B 0x5B
    0x66 0x66 0x66 0x66 0x3E 0x1B 0x75 0x42
    0x10 0x3D 0x1D 0x4C 0x87 0x94 0x97 0x1A
    0x5A 0x79 0x95 0xC4 0x60 0x42 0x62 0x70
    0x31 0x00 0x64 0xA5 0xB5 0xC1 0x01 0xFF >,
    <0x17 0x21 0x66 0x69 0x67 0x63 0x61 0x5F
    0x5F 0x5B 0x57 0x55 0x50 0x47 0x41 0x39
    0x31 0x2A 0x24 0x21 0x27 0x34 0x42 0x47
    0x2A 0x66 0x0B 0x85 0x1E 0x3C 0x4B 0x5B
    0x66 0x66 0x66 0x66 0x3E 0x1B 0x75 0x42
    0x10 0x3B 0x1D 0x4C 0x87 0x94 0x97 0x1A
    0x5A 0x79 0x95 0xC4 0x60 0x42 0x62 0x70
    0x3E 0x00 0x64 0xA5 0xB5 0xC1 0x02 0xFF >,
    <0x15 0x65 0x5A 0x5A 0x57 0x58 0x55 0x52
    0x4F 0x4F 0x48 0x43 0x3B 0x35 0x2F 0x28
    0x23 0x1E 0x1D 0x21 0x2A 0x38 0x44 0x2F
    0x36 0x86 0x0B 0x85 0x1E 0x3C 0x4B 0x5B
    0x66 0x66 0x66 0x66 0x3E 0x1B 0x75 0x42
    0x10 0x37 0x1D 0x4C 0x87 0x94 0x97 0x1A
    0x5A 0x79 0x95 0xC4 0x60 0x42 0x62 0x70
    0x4D 0x00 0x64 0xA5 0xB5 0xC1 0x03 0xFF >;
cw,model_data_hltherm =
    <0x18 0x42 0x63 0x69 0x6D 0x70 0x6C 0x69
    0x64 0x66 0x65 0x5A 0x5C 0x57 0x4B 0x43
    0x3F 0x33 0x2D 0x22 0x25 0x30 0x41 0x50
    0x27 0x4F 0x08 0xB4 0x1E 0x3C 0x4B 0x5B
    0x66 0x66 0x66 0x66 0x3E 0x1B 0x75 0x42
    0x10 0x41 0x2A 0x4C 0x87 0x94 0x97 0x15
    0x5A 0x79 0x95 0xC4 0x60 0x38 0x57 0xFF
    0x36 0x00 0x64 0xA5 0xB5 0xC1 0x58 0xC1 >,
    <0x18 0x42 0x63 0x69 0x6D 0x70 0x6C 0x69
    0x64 0x66 0x65 0x5A 0x5C 0x57 0x4B 0x43
    0x3F 0x33 0x2D 0x22 0x25 0x30 0x41 0x50
    0x27 0x4F 0x08 0xB4 0x1E 0x3C 0x4B 0x5B
    0x66 0x66 0x66 0x66 0x3E 0x1B 0x75 0x42
    0x10 0x41 0x2A 0x4C 0x87 0x94 0x97 0x15
    0x5A 0x79 0x95 0xC4 0x60 0x38 0x57 0xFF
    0x36 0x00 0x64 0xA5 0xB5 0xC1 0x58 0xC1 >,
    <0x18 0x42 0x63 0x69 0x6D 0x70 0x6C 0x69
    0x64 0x66 0x65 0x5A 0x5C 0x57 0x4B 0x43
    0x3F 0x33 0x2D 0x22 0x25 0x30 0x41 0x50
    0x27 0x4F 0x08 0xB4 0x1E 0x3C 0x4B 0x5B
    0x66 0x66 0x66 0x66 0x3E 0x1B 0x75 0x42
    0x10 0x41 0x2A 0x4C 0x87 0x94 0x97 0x15
    0x5A 0x79 0x95 0xC4 0x60 0x38 0x57 0xFF
    0x36 0x00 0x64 0xA5 0xB5 0xC1 0x58 0xC1 >,
    <0x18 0x42 0x63 0x69 0x6D 0x70 0x6C 0x69
    0x64 0x66 0x65 0x5A 0x5C 0x57 0x4B 0x43
    0x3F 0x33 0x2D 0x22 0x25 0x30 0x41 0x50
    0x27 0x4F 0x08 0xB4 0x1E 0x3C 0x4B 0x5B
    0x66 0x66 0x66 0x66 0x3E 0x1B 0x75 0x42
    0x10 0x41 0x2A 0x4C 0x87 0x94 0x97 0x15
    0x5A 0x79 0x95 0xC4 0x60 0x38 0x57 0xFF
    0x36 0x00 0x64 0xA5 0xB5 0xC1 0x58 0xC1 >;

};
