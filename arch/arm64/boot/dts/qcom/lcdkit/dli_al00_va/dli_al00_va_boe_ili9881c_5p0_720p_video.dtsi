/* Copyright (c) 2013, The Linux Foundation. All rights reserved.
 *
 * This program is free software; you can redistribute it and/or modify
 * it under the terms of the GNU General Public License version 2 and
 * only version 2 as published by the Free Software Foundation.
 *
 * This program is distributed in the hope that it will be useful,
 * but WITHOUT ANY WARRANTY; without even the implied warranty of
 * MERCHANTABILITY or FITNESS FOR A PARTICULAR PURPOSE.  See the
 * GNU General Public License for more details.
 */

/*-------------------------------------------------------------------------
 * This file is autogenerated file using gcdb parser. Please do not edit it.
 * Update input XML file to add a new entry or update variable in this file
 * VERSION = 1.1
 *-----------------------------------------------------------------------*/
/ {
	dsi_dli_al00_va_boe_ili9881c_5p0_720p_video: lcdkit_dli_al00_va_boe_ili9881c_5p0_720p_video {
		compatible = "dli_al00_va_boe_ili9881c_5p0_720p_video";
		hw,lcdkit-panel-name = "BOE_ILI9881C 5.0' VIDEO IPS 720 x 1280";
		hw,lcdkit-panel-type = <0x01>;
		hw,lcdkit-panel-xres = <720>;
		hw,lcdkit-panel-yres = <1280>;
		hw,lcdkit-panel-width = <68>;
		hw,lcdkit-panel-height = <121>;
		hw,lcdkit-panel-on-command = [39 01 00 00 00 00 04 FF 98 81 03
			39 01 00 00 00 00 02 01 00
			39 01 00 00 00 00 02 02 00
			39 01 00 00 00 00 02 03 73
			39 01 00 00 00 00 02 04 00
			39 01 00 00 00 00 02 05 00
			39 01 00 00 00 00 02 06 0C
			39 01 00 00 00 00 02 07 00
			39 01 00 00 00 00 02 08 00
			39 01 00 00 00 00 02 09 19
			39 01 00 00 00 00 02 0a 01
			39 01 00 00 00 00 02 0b 01
			39 01 00 00 00 00 02 0c 0B
			39 01 00 00 00 00 02 0d 01
			39 01 00 00 00 00 02 0e 01
			39 01 00 00 00 00 02 0f 26
			39 01 00 00 00 00 02 10 26
			39 01 00 00 00 00 02 11 00
			39 01 00 00 00 00 02 12 00
			39 01 00 00 00 00 02 13 02
			39 01 00 00 00 00 02 14 00
			39 01 00 00 00 00 02 15 00
			39 01 00 00 00 00 02 16 00
			39 01 00 00 00 00 02 17 00
			39 01 00 00 00 00 02 18 00
			39 01 00 00 00 00 02 19 00
			39 01 00 00 00 00 02 1a 00
			39 01 00 00 00 00 02 1b 00
			39 01 00 00 00 00 02 1c 00
			39 01 00 00 00 00 02 1d 00
			39 01 00 00 00 00 02 1e 44
			39 01 00 00 00 00 02 1f C0
			39 01 00 00 00 00 02 20 0A
			39 01 00 00 00 00 02 21 03
			39 01 00 00 00 00 02 22 0A
			39 01 00 00 00 00 02 23 00
			39 01 00 00 00 00 02 24 8C
			39 01 00 00 00 00 02 25 8C
			39 01 00 00 00 00 02 26 00
			39 01 00 00 00 00 02 27 00
			39 01 00 00 00 00 02 28 3B
			39 01 00 00 00 00 02 29 03
			39 01 00 00 00 00 02 2a 00
			39 01 00 00 00 00 02 2b 00
			39 01 00 00 00 00 02 2c 00
			39 01 00 00 00 00 02 2d 00
			39 01 00 00 00 00 02 2e 00
			39 01 00 00 00 00 02 2f 00
			39 01 00 00 00 00 02 30 00
			39 01 00 00 00 00 02 31 00
			39 01 00 00 00 00 02 32 00
			39 01 00 00 00 00 02 33 00
			39 01 00 00 00 00 02 34 00
			39 01 00 00 00 00 02 35 00
			39 01 00 00 00 00 02 36 00
			39 01 00 00 00 00 02 37 00
			39 01 00 00 00 00 02 38 00
			39 01 00 00 00 00 02 39 00
			39 01 00 00 00 00 02 3a 00
			39 01 00 00 00 00 02 3b 00
			39 01 00 00 00 00 02 3c 00
			39 01 00 00 00 00 02 3d 00
			39 01 00 00 00 00 02 3e 00
			39 01 00 00 00 00 02 3f 00
			39 01 00 00 00 00 02 40 00
			39 01 00 00 00 00 02 41 00
			39 01 00 00 00 00 02 42 00
			39 01 00 00 00 00 02 43 00
			39 01 00 00 00 00 02 44 00
			39 01 00 00 00 00 02 50 01
			39 01 00 00 00 00 02 51 23
			39 01 00 00 00 00 02 52 45
			39 01 00 00 00 00 02 53 67
			39 01 00 00 00 00 02 54 89
			39 01 00 00 00 00 02 55 ab
			39 01 00 00 00 00 02 56 01
			39 01 00 00 00 00 02 57 23
			39 01 00 00 00 00 02 58 45
			39 01 00 00 00 00 02 59 67
			39 01 00 00 00 00 02 5a 89
			39 01 00 00 00 00 02 5b ab
			39 01 00 00 00 00 02 5c cd
			39 01 00 00 00 00 02 5d ef
			39 01 00 00 00 00 02 5e 11
			39 01 00 00 00 00 02 5f 02
			39 01 00 00 00 00 02 60 00
			39 01 00 00 00 00 02 61 0C
			39 01 00 00 00 00 02 62 0D
			39 01 00 00 00 00 02 63 0E
			39 01 00 00 00 00 02 64 0F
			39 01 00 00 00 00 02 65 02
			39 01 00 00 00 00 02 66 02
			39 01 00 00 00 00 02 67 02
			39 01 00 00 00 00 02 68 02
			39 01 00 00 00 00 02 69 02
			39 01 00 00 00 00 02 6a 02
			39 01 00 00 00 00 02 6b 02
			39 01 00 00 00 00 02 6c 02
			39 01 00 00 00 00 02 6d 02
			39 01 00 00 00 00 02 6e 05
			39 01 00 00 00 00 02 6f 05
			39 01 00 00 00 00 02 70 05
			39 01 00 00 00 00 02 71 05
			39 01 00 00 00 00 02 72 01
			39 01 00 00 00 00 02 73 06
			39 01 00 00 00 00 02 74 07
			39 01 00 00 00 00 02 75 02
			39 01 00 00 00 00 02 76 00
			39 01 00 00 00 00 02 77 0C
			39 01 00 00 00 00 02 78 0D
			39 01 00 00 00 00 02 79 0E
			39 01 00 00 00 00 02 7a 0F
			39 01 00 00 00 00 02 7b 02
			39 01 00 00 00 00 02 7c 02
			39 01 00 00 00 00 02 7d 02
			39 01 00 00 00 00 02 7e 02
			39 01 00 00 00 00 02 7f 02
			39 01 00 00 00 00 02 80 02
			39 01 00 00 00 00 02 81 02
			39 01 00 00 00 00 02 82 02
			39 01 00 00 00 00 02 83 02
			39 01 00 00 00 00 02 84 05
			39 01 00 00 00 00 02 85 05
			39 01 00 00 00 00 02 86 05
			39 01 00 00 00 00 02 87 05
			39 01 00 00 00 00 02 88 01
			39 01 00 00 00 00 02 89 06
			39 01 00 00 00 00 02 8A 07
			39 01 00 00 00 00 04 FF 98 81 04
			39 01 00 00 00 00 02 6C 15
			39 01 00 00 00 00 02 6E 1a
			39 01 00 00 00 00 02 6F A5
			39 01 00 00 00 00 02 3a 24
			39 01 00 00 00 00 02 8D 1F
			39 01 00 00 00 00 02 87 BA
			39 01 00 00 00 00 02 26 76
			39 01 00 00 00 00 02 B2 D1
			39 01 00 00 00 00 04 FF 98 81 01
			39 01 00 00 00 00 02 22 0A
			39 01 00 00 00 00 02 31 00
			39 01 00 00 00 00 02 40 33
			39 01 00 00 00 00 02 42 33
			39 01 00 00 00 00 02 50 A6
			39 01 00 00 00 00 02 51 A6
			39 01 00 00 00 00 02 53 55
			39 01 00 00 00 00 02 55 55
			39 01 00 00 00 00 02 60 06
			39 01 00 00 00 00 02 61 01
			39 01 00 00 00 00 02 62 19
			39 01 00 00 00 00 02 63 10
			39 01 00 00 00 00 02 A0 08
			39 01 00 00 00 00 02 A1 16
			39 01 00 00 00 00 02 A2 20
			39 01 00 00 00 00 02 A3 13
			39 01 00 00 00 00 02 A4 14
			39 01 00 00 00 00 02 A5 26
			39 01 00 00 00 00 02 A6 18
			39 01 00 00 00 00 02 A7 1C
			39 01 00 00 00 00 02 A8 6B
			39 01 00 00 00 00 02 A9 1C
			39 01 00 00 00 00 02 AA 27
			39 01 00 00 00 00 02 AB 66
			39 01 00 00 00 00 02 AC 19
			39 01 00 00 00 00 02 AD 16
			39 01 00 00 00 00 02 AE 4C
			39 01 00 00 00 00 02 AF 22
			39 01 00 00 00 00 02 B0 27
			39 01 00 00 00 00 02 B1 56
			39 01 00 00 00 00 02 B2 66
			39 01 00 00 00 00 02 B3 39
			39 01 00 00 00 00 02 C0 08
			39 01 00 00 00 00 02 C1 16
			39 01 00 00 00 00 02 C2 20
			39 01 00 00 00 00 02 C3 13
			39 01 00 00 00 00 02 C4 14
			39 01 00 00 00 00 02 C5 26
			39 01 00 00 00 00 02 C6 18
			39 01 00 00 00 00 02 C7 1C
			39 01 00 00 00 00 02 C8 6B
			39 01 00 00 00 00 02 C9 1C
			39 01 00 00 00 00 02 CA 27
			39 01 00 00 00 00 02 CB 66
			39 01 00 00 00 00 02 CC 19
			39 01 00 00 00 00 02 CD 16
			39 01 00 00 00 00 02 CE 4C
			39 01 00 00 00 00 02 CF 22
			39 01 00 00 00 00 02 D0 27
			39 01 00 00 00 00 02 D1 56
			39 01 00 00 00 00 04 FF 98 81 00
            39 01 00 00 78 00 02 11 00
            39 01 00 00 0A 00 02 29 00];
		hw,lcdkit-panel-on-command-state = "dsi_lp_mode";
		hw,lcdkit-panel-display-on-command = [39 01 00 00 78 00 02 11 00
                39 01 00 00 0A 00 02 29 00];
		hw,lcdkit-panel-off-command = [05 01 00 00 0A 00 02 28 00
                05 01 00 00 78 00 02 10 00];
		hw,lcdkit-panel-off-command-state = "dsi_hs_mode";
		hw,lcdkit-panel-backlight-command = [39 01 00 00 00 00 02 51 00];
		hw,lcdkit-panel-backlight-command-state = "dsi_lp_mode";
		hw,lcdkit-panel-cabc-off-command = [15 01 00 00 0a 00 02 55 00];
		hw,lcdkit-panel-cabc-off-command-state = "dsi_lp_mode";
		hw,lcdkit-panel-cabc-ui-command = [15 01 00 00 0a 00 02 55 01
                    15 01 00 00 0a 00 02 53 24];
		hw,lcdkit-panel-cabc-ui-command-state = "dsi_lp_mode";
		hw,lcdkit-panel-cabc-still-command = [15 01 00 00 0a 00 02 55 02
                    15 01 00 00 0a 00 02 53 2C];
		hw,lcdkit-panel-cabc-still-command-state = "dsi_lp_mode";
		hw,lcdkit-panel-cabc-moving-command = [15 01 00 00 0a 00 02 55 03
                    15 01 00 00 0a 00 02 53 2C];
		hw,lcdkit-panel-cabc-moving-command-state = "dsi_lp_mode";
		hw,lcdkit-panel-cabc-support = <0>;
		hw,lcdkit-panel-dot-inversion-command = [29 01 00 00 00 00 03 c2 00 00];
		hw,lcdkit-panel-dot-inversion-command-state = "dsi_lp_mode";
		hw,lcdkit-panel-column-inversion-command = [29 01 00 00 00 00 03 c2 00 f0];
		hw,lcdkit-panel-column-inversion-command-state = "dsi_lp_mode";
		hw,lcdkit-panel-inversion-support = <0>;
		hw,lcdkit-panel-forword-scan-command = [15 01 00 00 00 00 02 36 00];
		hw,lcdkit-panel-forword-scan-command-state = "dsi_lp_mode";
		hw,lcdkit-panel-revert-scan-command = [15 01 00 00 00 00 02 36 c0];
		hw,lcdkit-panel-revert-scan-command-state = "dsi_lp_mode";
		hw,lcdkit-panel-scan-support = <0>;
		hw,lcdkit-panel-display-region-command = [];
		hw,lcdkit-panel-display-region-command-state = "dsi_lp_mode";
		hw,lcdkit-panel-display-region-support = <0>;
		hw,lcdkit-panel-checksum-enter-command = [];
		hw,lcdkit-panel-checksum-enter-command-state = "dsi_lp_mode";
		hw,lcdkit-panel-checksum-command = [];
		hw,lcdkit-panel-checksum-command-state = "dsi_lp_mode";
		hw,lcdkit-panel-checksum-exit-command = [];
		hw,lcdkit-panel-checksum-exit-command-state = "dsi_lp_mode";
		hw,lcdkit-panel-checksum-value = [];
		hw,lcdkit-panel-checksum-support = <0>;
		hw,lcdkit-panel-esd-reg-command = [06 01 00 00 0a 00 01 0a 9c];
		hw,lcdkit-panel-esd-reg-command-state = "dsi_lp_mode";
		hw,lcdkit-panel-esd-value = [9c];
		hw,lcdkit-panel-esd-support = <1>;
		hw,lcdkit-panel-check-reg-command = [06 01 00 00 0a 00 01 0a];
		hw,lcdkit-panel-check-reg-value = [1c];
		hw,lcdkit-panel-check-reg-command-state = "dsi_lp_mode";
		hw,lcdkit-panel-check-reg-support = <0>;
		hw,lcdkit-panel-mipi-detect-command = [];
		hw,lcdkit-panel-mipi-detect-value = [];
		hw,lcdkit-panel-mipi-detect-mask = [];
		hw,lcdkit-panel-mipi-detect-command-state = "dsi_lp_mode";
		hw,lcdkit-panel-mipi-detect-support = <0>;
		hw,lcdkit-panel-shutdown-sleep-support = <0>;
		hw,lcdkit-dsi-bpp = <24>;
		hw,lcdkit-panel-cmd-type = <0>;
		hw,lcdkit-pixel-packing = <0>;
		hw,lcdkit-underflow-color = <0x00>;
		hw,lcdkit-border-color = <0>;
		hw,lcdkit-panel-orientation = <0>;
		hw,lcdkit-brightness-max-level = <4095>;
		hw,lcdkit-bl-min-level = <41>;
		hw,lcdkit-bl-max-level = <4095>;
		hw,lcdkit-interleave-mode = <0>;
		hw,lcdkit-h-sync-pulse = <1>;
		hw,lcdkit-hbp-power-mode = <>;
		hw,lcdkit-bllp-power-mode;
		hw,lcdkit-bllp-eof-power-mode;
		hw,lcdkit-traffic-mode = "burst_mode";
		hw,lcdkit-te-dcs-command = <0>;
		hw,lcdkit-te-pin-select = <0>;
		hw,lcdkit-virtual-channel-id = <0>;
		hw,lcdkit-color-order = "rgb_swap_rgb";
		hw,lcdkit-lane-0-state;
		hw,lcdkit-lane-1-state;
		hw,lcdkit-lane-2-state;
		hw,lcdkit-lane-3-state;
		hw,lcdkit-h-left-border = <0>;
		hw,lcdkit-h-right-border = <0>;
		hw,lcdkit-v-top-border = <0>;
		hw,lcdkit-v-bottom-border = <0>;
		hw,lcdkit-panel-framerate = <60>;
		hw,lcdkit-panel-clockrate = <500000000>;
		hw,lcdkit-panel-timings = [8C 1E 14 00 44 4A 18 22 18 03 04 00];
		hw,lcdkit-t-clk-pre = <0x1C>;
		hw,lcdkit-t-clk-post = <0x04>;
		hw,lcdkit-tx-eot-append;
		hw,lcdkit-stream = <0>;
		hw,lcdkit-lp11-init;
		hw,lcdkit-mdp-trigger = "none";
		hw,lcdkit-dma-trigger = "trigger_sw";
		hw,lcdkit-bl-pmic-control-type = "bl_ctrl_wled";
		qcom,panel-supply-entries = <&dsi_panel_pwr_supply>;
		hw,lcdkit-lane-map = "lane_map_0123";
		hw,lcdkit-delay-before-bl = <0>;
		hw,lcdkit-mipi-regulator-mode = <1>;
		hw,lcdkit-delay-af-rst-off = <20>;
		hw,lcdkit-delay-af-blic-init = <0>;
		hw,lcdkit-bl-level-limit-percent = <100>;
		hw,lcdkit-use-second-ic-for-esd = <0>;
		hw,lcdkit-esd-check-num = <3>;
		hw,lcdkit-h-back-porch = <195>;
		hw,lcdkit-h-front-porch = <100>;
		hw,lcdkit-h-pulse-width = <28>;
		hw,lcdkit-v-back-porch = <20>;
		hw,lcdkit-v-pulse-width = <4>;
		hw,lcdkit-v-front-porch = <28>;
		hw,lcdkit-h-sync-skew = <0>;
		hw,lcdkit-lcd-type = <0>;
		hw,lcdkit-panel-pt-test-support = <0>;
		hw,lcdkit-bias-power-ctrl-mode = <0x02>;
		hw,lcdkit-iovcc-power-ctrl-mode = <0x01>;
		hw,lcdkit-vci-power-ctrl-mode = <0x01>;
		hw,lcdkit-id0-gpio = <36>;
		hw,lcdkit-id1-gpio = <61>;
		hw,lcdkit-reset-gpio = <60>;
		hw,lcdkit-te-gpio = <0>;
		hw,lcdkit-vsp-gpio = <93>;
		hw,lcdkit-vsn-gpio = <94>;
		hw,lcdkit-iovcc-gpio = <0>;
		hw,lcdkit-vci-gpio = <0>;
		hw,lcdkit-bl-gpio = <98>;
		hw,lcdkit-iovcc-on-is-need-reset = <1>;
		hw,lcdkit-vsn-on-is-need-reset = <1>;
		hw,lcdkit-lcd-vsp = <5500000>;
		hw,lcdkit-lcd-vsn = <5500000>;
		hw,lcdkit-lcd-rst-first-high = <5>;
		hw,lcdkit-lcd-rst-low = <10>;
		hw,lcdkit-lcd-rst-second-high = <50>;
		hw,lcdkit-delay-af-vci-on = <0>;
		hw,lcdkit-delay-af-iovcc-on = <0>;
		hw,lcdkit-delay-af-bias-on = <0>;
		hw,lcdkit-delay-af-vsp-on = <5>;
		hw,lcdkit-delay-af-vsn-on = <1>;
		hw,lcdkit-delay-af-lp11 = <0>;
		hw,lcdkit-delay-af-tp-reset = <25>;
		hw,lcdkit-delay-af-vsn-off = <5>;
		hw,lcdkit-delay-af-vsp-off = <1>;
		hw,lcdkit-delay-af-bias-off = <0>;
		hw,lcdkit-delay-af-iovcc-off = <0>;
		hw,lcdkit-delay-af-vci-off = <0>;
		hw,lcdkit-panel-off-reset-high = <0>;
    };
};