/* Copyright (c) 2013, The Linux Foundation. All rights reserved.
 *
 * This program is free software; you can redistribute it and/or modify
 * it under the terms of the GNU General Public License version 2 and
 * only version 2 as published by the Free Software Foundation.
 *
 * This program is distributed in the hope that it will be useful,
 * but WITHOUT ANY WARRANTY; without even the implied warranty of
 * MERCHANTABILITY or FITNESS FOR A PARTICULAR PURPOSE.  See the
 * GNU General Public License for more details.
 */

/*-------------------------------------------------------------------------
 * This file is autogenerated file using gcdb parser. Please do not edit it.
 * Update input XML file to add a new entry or update variable in this file
 * VERSION = 1.1
 *-----------------------------------------------------------------------*/
/ {
	dsi_sla_l23_va_txd_ili9881cs_5p0_720p_video: lcdkit_sla_l23_va_txd_ili9881cs_5p0_720p_video {
		compatible = "txd_ili9881c_5p0_720p_video";
		hw,lcdkit-panel-name = "TXD_ILI9881C 5.0' VIDEO TFT 720 x 1280";
		hw,lcdkit-panel-type = <0x01>;
		hw,lcdkit-panel-xres = <720>;
		hw,lcdkit-panel-yres = <1280>;
		hw,lcdkit-panel-width = <68>;
		hw,lcdkit-panel-height = <121>;
		hw,lcdkit-panel-on-command = [29 01 00 00 00 00 04 FF 98 81 03
							29 01 00 00 00 00 02 01 00
							29 01 00 00 00 00 02 02 00
							29 01 00 00 00 00 02 03 53
							29 01 00 00 00 00 02 04 13
							29 01 00 00 00 00 02 05 13
							29 01 00 00 00 00 02 06 06
							29 01 00 00 00 00 02 07 00
							29 01 00 00 00 00 02 08 04
							29 01 00 00 00 00 02 09 00
							29 01 00 00 00 00 02 0a 00
							29 01 00 00 00 00 02 0b 00
							29 01 00 00 00 00 02 0C 00
							29 01 00 00 00 00 02 0D 00
							29 01 00 00 00 00 02 0E 00
							29 01 00 00 00 00 02 0f 00
							29 01 00 00 00 00 02 10 00
							29 01 00 00 00 00 02 11 00
							29 01 00 00 00 00 02 12 00
							29 01 00 00 00 00 02 13 00
							29 01 00 00 00 00 02 14 00
							29 01 00 00 00 00 02 15 00
							29 01 00 00 00 00 02 16 00
							29 01 00 00 00 00 02 17 00
							29 01 00 00 00 00 02 18 00
							29 01 00 00 00 00 02 19 00
							29 01 00 00 00 00 02 1A 00
							29 01 00 00 00 00 02 1B 00
							29 01 00 00 00 00 02 1C 00
							29 01 00 00 00 00 02 1D 00
							29 01 00 00 00 00 02 1E C0
							29 01 00 00 00 00 02 1F 80
							29 01 00 00 00 00 02 20 04
							29 01 00 00 00 00 02 21 0B
							29 01 00 00 00 00 02 22 00
							29 01 00 00 00 00 02 23 00
							29 01 00 00 00 00 02 24 00
							29 01 00 00 00 00 02 25 00
							29 01 00 00 00 00 02 26 00
							29 01 00 00 00 00 02 27 00
							29 01 00 00 00 00 02 28 55
							29 01 00 00 00 00 02 29 03
							29 01 00 00 00 00 02 2A 00
							29 01 00 00 00 00 02 2B 00
							29 01 00 00 00 00 02 2C 00
							29 01 00 00 00 00 02 2D 00
							29 01 00 00 00 00 02 2E 00
							29 01 00 00 00 00 02 2F 00
							29 01 00 00 00 00 02 30 00
							29 01 00 00 00 00 02 31 00
							29 01 00 00 00 00 02 32 00
							29 01 00 00 00 00 02 33 00
							29 01 00 00 00 00 02 34 04
							29 01 00 00 00 00 02 35 05
							29 01 00 00 00 00 02 36 05
							29 01 00 00 00 00 02 37 00
							29 01 00 00 00 00 02 38 3C
							29 01 00 00 00 00 02 39 00
							29 01 00 00 00 00 02 3A 40
							29 01 00 00 00 00 02 3B 40
							29 01 00 00 00 00 02 3C 00
							29 01 00 00 00 00 02 3D 00
							29 01 00 00 00 00 02 3E 00
							29 01 00 00 00 00 02 3F 00
							29 01 00 00 00 00 02 40 00
							29 01 00 00 00 00 02 41 00
							29 01 00 00 00 00 02 42 00
							29 01 00 00 00 00 02 43 00
							29 01 00 00 00 00 02 44 00
							29 01 00 00 00 00 02 50 01
							29 01 00 00 00 00 02 51 23
							29 01 00 00 00 00 02 52 45
							29 01 00 00 00 00 02 53 67
							29 01 00 00 00 00 02 54 89
							29 01 00 00 00 00 02 55 AB
							29 01 00 00 00 00 02 56 01
							29 01 00 00 00 00 02 57 23
							29 01 00 00 00 00 02 58 45
							29 01 00 00 00 00 02 59 67
							29 01 00 00 00 00 02 5A 89
							29 01 00 00 00 00 02 5B AB
							29 01 00 00 00 00 02 5C CD
							29 01 00 00 00 00 02 5D EF
							29 01 00 00 00 00 02 5E 01
							29 01 00 00 00 00 02 5F 14
							29 01 00 00 00 00 02 60 15
							29 01 00 00 00 00 02 61 0C
							29 01 00 00 00 00 02 62 0D
							29 01 00 00 00 00 02 63 0E
							29 01 00 00 00 00 02 64 0F
							29 01 00 00 00 00 02 65 10
							29 01 00 00 00 00 02 66 11
							29 01 00 00 00 00 02 67 08
							29 01 00 00 00 00 02 68 02
							29 01 00 00 00 00 02 69 0A
							29 01 00 00 00 00 02 6A 02
							29 01 00 00 00 00 02 6B 02
							29 01 00 00 00 00 02 6C 02
							29 01 00 00 00 00 02 6D 02
							29 01 00 00 00 00 02 6E 02
							29 01 00 00 00 00 02 6F 02
							29 01 00 00 00 00 02 70 02
							29 01 00 00 00 00 02 71 02
							29 01 00 00 00 00 02 72 06
							29 01 00 00 00 00 02 73 02
							29 01 00 00 00 00 02 74 02
							29 01 00 00 00 00 02 75 14
							29 01 00 00 00 00 02 76 15
							29 01 00 00 00 00 02 77 11
							29 01 00 00 00 00 02 78 10
							29 01 00 00 00 00 02 79 0F
							29 01 00 00 00 00 02 7A 0E
							29 01 00 00 00 00 02 7B 0D
							29 01 00 00 00 00 02 7C 0C
							29 01 00 00 00 00 02 7D 06
							29 01 00 00 00 00 02 7E 02
							29 01 00 00 00 00 02 7F 0A
							29 01 00 00 00 00 02 80 02
							29 01 00 00 00 00 02 81 02
							29 01 00 00 00 00 02 82 02
							29 01 00 00 00 00 02 83 02
							29 01 00 00 00 00 02 84 02
							29 01 00 00 00 00 02 85 02
							29 01 00 00 00 00 02 86 02
							29 01 00 00 00 00 02 87 02
							29 01 00 00 00 00 02 88 08
							29 01 00 00 00 00 02 89 02
							29 01 00 00 00 00 02 8A 02
							29 01 00 00 00 00 04 FF 98 81 04
							29 01 00 00 00 00 02 6C 15
							29 01 00 00 00 00 02 6E 3B
							29 01 00 00 00 00 02 b5 06
							29 01 00 00 00 00 02 31 75
							29 01 00 00 00 00 02 6F 57
							29 01 00 00 00 00 02 3A A4
							29 01 00 00 00 00 02 8D 15
							29 01 00 00 00 00 02 87 BA
							29 01 00 00 00 00 02 26 76
							29 01 00 00 00 00 02 B2 D1
							29 01 00 00 00 00 02 88 0B
							29 01 00 00 00 00 04 FF 98 81 01
							29 01 00 00 00 00 02 22 0A
							29 01 00 00 00 00 02 31 00
							29 01 00 00 00 00 02 53 8A
							29 01 00 00 00 00 02 55 88
							29 01 00 00 00 00 02 50 A0
							29 01 00 00 00 00 02 51 A0
							29 01 00 00 00 00 02 60 14
							29 01 00 00 00 00 02 A0 08
							29 01 00 00 00 00 02 A1 21
							29 01 00 00 00 00 02 A2 30
							29 01 00 00 00 00 02 A3 0F
							29 01 00 00 00 00 02 A4 11
							29 01 00 00 00 00 02 A5 27
							29 01 00 00 00 00 02 A6 1C
							29 01 00 00 00 00 02 A7 1E
							29 01 00 00 00 00 02 A8 8C
							29 01 00 00 00 00 02 A9 1B
							29 01 00 00 00 00 02 AA 28
							29 01 00 00 00 00 02 AB 74
							29 01 00 00 00 00 02 AC 1A
							29 01 00 00 00 00 02 AD 19
							29 01 00 00 00 00 02 AE 4D
							29 01 00 00 00 00 02 AF 21
							29 01 00 00 00 00 02 B0 28
							29 01 00 00 00 00 02 B1 4a
							29 01 00 00 00 00 02 B2 5b
							29 01 00 00 00 00 02 B3 2C
							29 01 00 00 00 00 02 C0 08
							29 01 00 00 00 00 02 C1 21
							29 01 00 00 00 00 02 C2 30
							29 01 00 00 00 00 02 C3 0F
							29 01 00 00 00 00 02 C4 11
							29 01 00 00 00 00 02 C5 27
							29 01 00 00 00 00 02 C6 1C
							29 01 00 00 00 00 02 C7 1E
							29 01 00 00 00 00 02 C8 8C
							29 01 00 00 00 00 02 C9 1B
							29 01 00 00 00 00 02 CA 28
							29 01 00 00 00 00 02 CB 74
							29 01 00 00 00 00 02 CC 1A
							29 01 00 00 00 00 02 CD 19
							29 01 00 00 00 00 02 CE 4D
							29 01 00 00 00 00 02 CF 21
							29 01 00 00 00 00 02 D0 28
							29 01 00 00 00 00 02 D1 4a
							29 01 00 00 00 00 02 D2 59
							29 01 00 00 00 00 02 D3 2C
							29 01 00 00 00 00 04 FF 98 81 02
							29 01 00 00 00 00 02 06 40
							29 01 00 00 00 00 02 07 05
							29 01 00 00 00 00 04 FF 98 81 00
							29 01 00 00 00 00 03 68 03 01
							29 01 00 00 00 00 03 51 00 00
							29 01 00 00 00 00 02 35 00
							29 01 00 00 00 00 02 53 2C
							29 01 00 00 00 00 02 55 80
							05 01 00 00 78 00 02 11 00
							05 01 00 00 14 00 02 29 00];
		hw,lcdkit-panel-on-command-state = "dsi_lp_mode";
		hw,lcdkit-panel-off-command = [05 01 00 00 20 00 02 28 00
					05 01 00 00 78 00 02 10 00];
		hw,lcdkit-panel-off-command-state = "dsi_lp_mode";
		hw,lcdkit-panel-backlight-command = [29 01 00 00 00 00 03 51 0F F0];
		hw,lcdkit-panel-backlight-command-state = "dsi_lp_mode";
		hw,lcdkit-panel-cabc-off-command = [15 01 00 00 0a 00 02 55 00];
		hw,lcdkit-panel-cabc-off-command-state = "dsi_lp_mode";
		hw,lcdkit-panel-cabc-ui-command = [15 01 00 00 0a 00 02 55 01
				  15 01 00 00 0a 00 02 53 2C];
		hw,lcdkit-panel-cabc-ui-command-state = "dsi_lp_mode";
		hw,lcdkit-panel-cabc-still-command = [15 01 00 00 0a 00 02 55 82
				     15 01 00 00 0a 00 02 53 2C];
		hw,lcdkit-panel-cabc-still-command-state = "dsi_lp_mode";
		hw,lcdkit-panel-cabc-moving-command = [15 01 00 00 0a 00 02 55 03
				      15 01 00 00 0a 00 02 53 2C];
		hw,lcdkit-panel-cabc-moving-command-state = "dsi_lp_mode";
		hw,lcdkit-panel-cabc-support = <1>;
		hw,lcdkit-panel-inversion-support = <0>;
		hw,lcdkit-panel-scan-support = <0>;
		hw,lcdkit-panel-display-region-support = <0>;
		hw,lcdkit-panel-checksum-support = <0>;
		hw,lcdkit-panel-esd-reg-command = [06 01 00 00 0a 00 01 0a
				     06 01 00 00 0a 00 01 0b];
		hw,lcdkit-panel-esd-reg-command-state = "dsi_lp_mode";
		hw,lcdkit-panel-esd-value = [9c 00];
		hw,lcdkit-panel-esd-support = <1>;
		hw,lcdkit-panel-check-reg-support = <0>;
		hw,lcdkit-panel-mipi-detect-support = <0>;
		hw,lcdkit-panel-shutdown-sleep-support = <0>;
		hw,lcdkit-dsi-bpp = <24>;
		hw,lcdkit-panel-cmd-type = <0>;
		hw,lcdkit-pixel-packing = <0>;
		hw,lcdkit-underflow-color = <0x00>;
		hw,lcdkit-border-color = <0>;
		hw,lcdkit-panel-orientation = <0>;
		hw,lcdkit-brightness-max-level = <255>;
		hw,lcdkit-bl-min-level = <3>;
		hw,lcdkit-bl-max-level = <255>;
		hw,lcdkit-interleave-mode = <0>;
		hw,lcdkit-te-using-te-pin;
		hw,lcdkit-h-sync-pulse = <1>;
		hw,lcdkit-bllp-power-mode;
		hw,lcdkit-bllp-eof-power-mode;
		hw,lcdkit-traffic-mode = "burst_mode";
		hw,lcdkit-te-dcs-command = <1>;
		hw,lcdkit-te-pin-select = <1>;
		hw,lcdkit-virtual-channel-id = <0>;
		hw,lcdkit-color-order = "rgb_swap_rgb";
		hw,lcdkit-lane-0-state;
		hw,lcdkit-lane-1-state;
		hw,lcdkit-lane-2-state;
		hw,lcdkit-lane-3-state;
		hw,lcdkit-h-left-border = <0>;
		hw,lcdkit-h-right-border = <0>;
		hw,lcdkit-v-top-border = <0>;
		hw,lcdkit-v-bottom-border = <0>;
		hw,lcdkit-panel-framerate = <60>;
		hw,lcdkit-panel-clockrate = <431030000>;
		hw,lcdkit-panel-timings = [7A 1A 12 00 40 42 16 1E 14 03 04 00];
		hw,lcdkit-t-clk-pre = <0x1A>;
		hw,lcdkit-t-clk-post = <0x04>;
		hw,lcdkit-tx-eot-append;
		hw,lcdkit-stream = <0>;
		hw,lcdkit-lp11-init;
		hw,lcdkit-mdp-trigger = "none";
		hw,lcdkit-dma-trigger = "trigger_sw";
		hw,lcdkit-bl-pmic-control-type = "bl_ctrl_dcs";
		qcom,panel-supply-entries = <&dsi_panel_pwr_supply>;
		hw,lcdkit-lane-map = "lane_map_0123";
		hw,lcdkit-delay-before-bl = <0>;
		hw,lcdkit-mipi-regulator-mode = <0>;
		hw,lcdkit-bl-en-gpio = <0>;
		hw,lcdkit-delay-af-rst-off = <20>;
		hw,lcdkit-delay-af-blic-init = <0>;
		hw,lcdkit-bl-level-limit-percent = <100>;
		hw,lcdkit-use-second-ic-for-esd = <0>;
		hw,lcdkit-esd-check-num = <3>;
		hw,lcdkit-h-back-porch = <95>;
		hw,lcdkit-h-front-porch = <96>;
		hw,lcdkit-h-pulse-width = <10>;
		hw,lcdkit-v-back-porch = <10>;
		hw,lcdkit-v-pulse-width = <4>;
		hw,lcdkit-v-front-porch = <6>;
		hw,lcdkit-h-sync-skew = <0>;
		hw,lcdkit-lcd-type = <0>;
		hw,lcdkit-panel-pt-test-support = <1>;
		hw,lcdkit-bias-power-ctrl-mode = <0x02>;
		hw,lcdkit-iovcc-power-ctrl-mode = <0x01>;
		hw,lcdkit-vci-power-ctrl-mode = <0x02>;
		hw,lcdkit-id0-gpio = <59>;
		hw,lcdkit-id1-gpio = <66>;
		hw,lcdkit-reset-gpio = <60>;
		hw,lcdkit-te-gpio = <0>;
		hw,lcdkit-vsp-gpio = <46>;
		hw,lcdkit-vsn-gpio = <45>;
		hw,lcdkit-iovcc-gpio = <0>;
		hw,lcdkit-vci-gpio = <0>;
		hw,lcdkit-bl-gpio = <0>;
		hw,lcdkit-iovcc-on-is-need-reset = <0>;
		hw,lcdkit-vsn-on-is-need-reset = <0>;
		hw,lcdkit-lcd-vsp = <5500000>;
		hw,lcdkit-lcd-vsn = <5500000>;
		hw,lcdkit-lcd-rst-first-high = <20>;
		hw,lcdkit-lcd-rst-low = <2>;
		hw,lcdkit-lcd-rst-second-high = <20>;
		hw,lcdkit-delay-af-vci-on = <0>;
		hw,lcdkit-delay-af-iovcc-on = <0>;
		hw,lcdkit-delay-af-bias-on = <0>;
		hw,lcdkit-delay-af-vsp-on = <20>;
		hw,lcdkit-delay-af-vsn-on = <20>;
		hw,lcdkit-delay-af-lp11 = <0>;
		hw,lcdkit-delay-af-tp-reset = <25>;
		hw,lcdkit-delay-af-vsn-off = <3>;
		hw,lcdkit-delay-af-vsp-off = <0>;
		hw,lcdkit-delay-af-bias-off = <0>;
		hw,lcdkit-delay-af-iovcc-off = <0>;
		hw,lcdkit-delay-af-vci-off = <0>;
		hw,lcdkit-panel-off-reset-high = <0>;
    };
};