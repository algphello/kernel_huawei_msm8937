/*---------------------------------------------------------------------------
 * This file is autogenerated file using huawei LCD parser. Please do not edit it.
 * Update input XML file to add a new entry or update variable in this file
 * Parser location: vendor/huawei/chipset_common/devkit/lcdkit/tools 
 *---------------------------------------------------------------------------*/


#include "atu_l11_va_auo_otm1901a_5p2_1080p_video_default.dtsi"
#include "atu_l11_va_djn_cpt_ili9881c_5p7_hd_video.dtsi"
#include "atu_l11_va_djn_inx_ili9881c_5p7_hd_video.dtsi"
#include "atu_l11_va_ofilm_inx_ili9881c_5p7_hd_video.dtsi"
#include "atu_l11_va_tcl_csot_ft8613_5p7_hd_video.dtsi"
#include "atu_l11_va_txd_hsd_hx8394f_5p7_hd_video.dtsi"
#include "atu_l11_va_txd_inx_hx8394f_5p7_hd_video.dtsi"