/*---------------------------------------------------------------------------
 * This file is autogenerated file using huawei LCD parser. Please do not edit it.
 * Update input XML file to add a new entry or update variable in this file
 * Parser location: vendor/huawei/chipset_common/devkit/lcdkit/tools 
 *---------------------------------------------------------------------------*/


#include "aum_al20_vb_auo_otm1901a_5p2_1080p_video_default.dtsi"
#include "aum_al20_vb_djn_cpt_ili9881c_5p7_hd_video.dtsi"
#include "aum_al20_vb_djn_inx_ili9881c_5p7_hd_video.dtsi"
#include "aum_al20_vb_ofilm_inx_ili9881c_5p7_hd_video.dtsi"
#include "aum_al20_vb_tcl_csot_ft8613_5p7_hd_video.dtsi"
#include "aum_al20_vb_txd_hsd_hx8394f_5p7_hd_video.dtsi"
#include "aum_al20_vb_txd_inx_hx8394f_5p7_hd_video.dtsi"