/* Copyright (c) 2013, The Linux Foundation. All rights reserved.
 *
 * This program is free software; you can redistribute it and/or modify
 * it under the terms of the GNU General Public License version 2 and
 * only version 2 as published by the Free Software Foundation.
 *
 * This program is distributed in the hope that it will be useful,
 * but WITHOUT ANY WARRANTY; without even the implied warranty of
 * MERCHANTABILITY or FITNESS FOR A PARTICULAR PURPOSE.  See the
 * GNU General Public License for more details.
 */

/*-------------------------------------------------------------------------
 * This file is autogenerated file using gcdb parser. Please do not edit it.
 * Update input XML file to add a new entry or update variable in this file
 * VERSION = 1.1
 *-----------------------------------------------------------------------*/
/ {
	dsi_atu_l22_va_tcl_csot_ft8613_5p7_hd_video: lcdkit_atu_l22_va_tcl_csot_ft8613_5p7_hd_video {
		compatible = "tcl_csot_ft8613_5p7_hd_video";
		hw,lcdkit-panel-name = "TCL_FT8613 5P7 VIDEO CSOT 720 x 1440";
		hw,lcdkit-panel-type = <0x01>;
		hw,lcdkit-panel-xres = <720>;
		hw,lcdkit-panel-yres = <1440>;
		hw,lcdkit-panel-width = <67>;
		hw,lcdkit-panel-height = <135>;
		hw,lcdkit-panel-on-command = [39 01 00 00 00 00 02 00 00
						39 01 00 00 00 00 04 ff 87 16 01
						39 01 00 00 00 00 02 00 80
						39 01 00 00 00 00 03 ff 87 16
						39 01 00 00 00 00 02 00 80
						39 01 00 00 00 00 10 C0 00 A5 00 10 10 00 A5 10 10 00 A5 00 10 10 00
						39 01 00 00 00 00 02 00 80
						39 01 00 00 00 00 02 F3 70
						39 01 00 00 00 00 02 00 90
						39 01 00 00 00 00 02 C5 55
						39 01 00 00 00 00 02 00 A0
						39 01 00 00 00 00 08 C0 0D 01 01 01 01 24 09
						39 01 00 00 00 00 02 00 D0
						39 01 00 00 00 00 08 C0 0D 01 01 01 01 24 09
						39 01 00 00 00 00 02 00 A8
						39 01 00 00 00 00 02 F5 22
						39 01 00 00 00 00 02 00 82
						39 01 00 00 00 00 04 A5 00 00 0C
						39 01 00 00 00 00 02 00 87
						39 01 00 00 00 00 05 A5 00 07 77 00
						39 01 00 00 00 00 02 00 A0
						39 01 00 00 00 00 09 CE 00 05 01 01 01 01 3F 0A
						39 01 00 00 00 00 02 00 A0
						39 01 00 00 00 00 02 B3 32
						39 01 00 00 00 00 02 00 A6
						39 01 00 00 00 00 02 B3 58
						39 01 00 00 00 00 02 00 80
						39 01 00 00 00 00 0D C2 82 00 00 81 81 00 00 81 83 00 3f B0
						39 01 00 00 00 00 02 00 B0
						39 01 00 00 00 00 10 C2 82 00 00 07 88 81 01 00 07 88 00 02 00 07 88
						39 01 00 00 00 00 02 00 C0
						39 01 00 00 00 00 06 C2 01 03 00 07 88
						39 01 00 00 00 00 02 00 DA
						39 01 00 00 00 00 03 C2 33 33
						39 01 00 00 00 00 02 00 82
						39 01 00 00 00 00 04 a5 00 00 00
						39 01 00 00 00 00 02 00 87
						39 01 00 00 00 00 05 a5 00 07 77 77
						39 01 00 00 00 00 02 00 88
						39 01 00 00 00 00 03 c3 22 22
						39 01 00 00 00 00 02 00 98
						39 01 00 00 00 00 03 c3 22 22
						39 01 00 00 00 00 02 00 AA
						39 01 00 00 00 00 03 C3 99 9C
						39 01 00 00 00 00 02 00 90
						39 01 00 00 00 00 02 C5 55
						39 01 00 00 00 00 02 00 80
						39 01 00 00 00 00 0A CE 25 00 74 00 78 FF 00 00 05
						39 01 00 00 00 00 02 00 90
						39 01 00 00 00 00 09 CE 00 5C 0C E4 00 5C 00 00
						39 01 00 00 00 00 02 00 B0
						39 01 00 00 00 00 07 CE 00 00 60 60 00 60
						39 01 00 00 00 00 02 00 80
						39 01 00 00 00 00 0D CC 02 03 06 07 08 09 0A 0B 0C 0D 0E 0F
						39 01 00 00 00 00 02 00 90
						39 01 00 00 00 00 0D CC 03 02 09 08 07 06 0F 0E 0D 0C 0B 0A
						39 01 00 00 00 00 02 00 A0
						39 01 00 00 00 00 10 CC 1A 1B 1C 1D 1E 1F 18 19 20 21 14 15 16 17 04
						39 01 00 00 00 00 02 00 B0
						39 01 00 00 00 00 06 CC 22 22 22 22 22
						39 01 00 00 00 00 02 00 80
						39 01 00 00 00 00 09 CB 00 00 00 00 00 00 00 00
						39 01 00 00 00 00 02 00 90
						39 01 00 00 00 00 10 CB 00 00 00 00 00 00 00 00 00 00 00 00 00 00 00
						39 01 00 00 00 00 02 00 A0
						39 01 00 00 00 00 10 CB 00 00 00 00 00 00 00 00 00 00 00 00 00 00 00
						39 01 00 00 00 00 02 00 B0
						39 01 00 00 00 00 03 CB 00 00
						39 01 00 00 00 00 02 00 C0
						39 01 00 00 00 00 10 CB 05 05 05 05 05 05 00 00 00 00 00 00 05 05 05
						39 01 00 00 00 00 02 00 D0
						39 01 00 00 00 00 10 CB 00 00 00 05 05 00 00 00 00 00 00 0A 00 00 00
						39 01 00 00 00 00 02 00 E0
						39 01 00 00 00 00 03 CB 00 00
						39 01 00 00 00 00 02 00 F0
						39 01 00 00 00 00 09 CB FF 0F 00 3F 30 30 30 00
						39 01 00 00 00 00 02 00 80
						39 01 00 00 00 00 10 CD 22 22 22 22 22 01 13 14 1B 05 03 17 18 18 22
						39 01 00 00 00 00 02 00 90
						39 01 00 00 00 00 04 CD 0F 0E 0D
						39 01 00 00 00 00 02 00 A0
						39 01 00 00 00 00 10 CD 22 22 22 22 22 02 13 14 1B 06 04 17 18 18 22
						39 01 00 00 00 00 02 00 B0
						39 01 00 00 00 00 04 CD 0F 0E 0D
						39 01 00 00 00 00 02 00 81
						39 01 00 00 00 00 0D F3 40 89 C0 40 89 C0 40 81 C0 40 81 C0
						39 01 00 00 00 00 02 00 00
						39 01 00 00 00 00 19 E1 00 06 18 2A 36 41 54 63 6A 72 7D 87 70 68 65 5E 51 45 37 2D 25 16 08 07
						39 01 00 00 00 00 02 00 00
						39 01 00 00 00 00 19 E2 00 06 18 2A 36 41 54 63 6A 72 7D 87 70 68 65 5E 51 45 37 2D 25 16 08 07
						39 01 00 00 00 00 02 00 80
						39 01 00 00 00 00 0B C5 00 C1 DD C4 14 1E 00 55 50 05
						39 01 00 00 00 00 02 00 90
						39 01 00 00 00 00 0B C5 77 1E 14 00 88 10 4C 53 55 50
						39 01 00 00 00 00 02 00 00
						39 01 00 00 00 00 03 D8 31 31
						39 01 00 00 00 00 02 00 00
						39 01 00 00 00 00 06 D9 80 8E 8E 8E 8E
						39 01 00 00 00 00 02 00 d1
						39 01 00 00 00 00 0D cf 02 04 00 0A 00 14 02 04 00 0C 00 12
						39 01 00 00 00 00 02 00 c0
						39 01 00 00 00 00 03 c0 11 11
						39 01 00 00 00 00 02 00 00
						39 01 00 00 00 00 05 2a 00 00 02 cf
						39 01 00 00 00 00 02 00 00
						39 01 00 00 00 00 05 2b 00 00 05 9f
						39 01 00 00 00 00 02 00 a1
						39 01 00 00 00 00 05 b3 02 d0 05 a0
						39 01 00 00 05 00 02 00 92
						39 01 00 00 05 00 03 ff 20 02
						39 01 00 00 05 00 02 00 B0
						39 01 00 00 05 00 03 CA 05 05
						39 01 00 00 00 00 02 00 00
						39 01 00 00 00 00 03 D1 00 01
						39 01 00 00 00 00 02 00 8d
						39 01 00 00 00 00 02 f5 21
						39 01 00 00 00 00 02 00 00
						39 01 00 00 00 00 04 ff 00 00 00
						39 01 00 00 00 00 02 00 80
						39 01 00 00 00 00 03 ff 00 00
						39 01 00 00 05 00 02 55 00
						39 01 00 00 00 00 02 53 2C
						39 01 00 00 78 00 02 11 00
						39 01 00 00 14 00 02 29 00];
		hw,lcdkit-panel-on-command-state = "dsi_lp_mode";
		hw,lcdkit-panel-display-on-command = [05 01 00 00 14 00 02 29 00];
		hw,lcdkit-panel-off-command = [05 01 00 00 14 00 02 28 00
					05 01 00 00 78 00 02 10 00];
		hw,lcdkit-panel-off-command-state = "dsi_hs_mode";
		hw,lcdkit-panel-backlight-command = [15 01 00 00 00 00 02 51 00];
		hw,lcdkit-panel-backlight-command-state = "dsi_lp_mode";
		hw,lcdkit-panel-cabc-off-command = [15 01 00 00 0a 00 02 55 00];
		hw,lcdkit-panel-cabc-off-command-state = "dsi_lp_mode";
		hw,lcdkit-panel-cabc-ui-command = [15 01 00 00 0a 00 02 55 01
					15 01 00 00 0a 00 02 53 24];
		hw,lcdkit-panel-cabc-ui-command-state = "dsi_lp_mode";
		hw,lcdkit-panel-cabc-still-command = [15 01 00 00 0a 00 02 55 02
					15 01 00 00 0a 00 02 53 24];
		hw,lcdkit-panel-cabc-still-command-state = "dsi_lp_mode";
		hw,lcdkit-panel-cabc-moving-command = [15 01 00 00 0a 00 02 55 03
					15 01 00 00 0a 00 02 53 24];
		hw,lcdkit-panel-cabc-moving-command-state = "dsi_lp_mode";
		hw,lcdkit-panel-cabc-support = <0>;
		hw,lcdkit-panel-dot-inversion-command = [29 01 00 00 00 00 02 00 00
								29 01 00 00 00 00 04 ff 87 16 01
								29 01 00 00 00 00 02 00 80
								29 01 00 00 00 00 03 ff 87 16
								29 01 00 00 00 00 02 00 b3
								29 01 00 00 00 00 02 c0 99
								29 01 00 00 00 00 02 00 00
								29 01 00 00 00 00 04 ff 00 00 00
								29 01 00 00 00 00 02 00 80
								29 01 00 00 00 00 03 ff 00 00];
		hw,lcdkit-panel-dot-inversion-command-state = "dsi_lp_mode";
		hw,lcdkit-panel-column-inversion-command = [29 01 00 00 00 00 02 00 00
								29 01 00 00 00 00 04 ff 87 16 01
								29 01 00 00 00 00 02 00 80
								29 01 00 00 00 00 03 ff 87 16
								29 01 00 00 00 00 02 00 b3
								29 01 00 00 00 00 02 c0 88
								29 01 00 00 00 00 02 00 00
								29 01 00 00 00 00 04 ff 00 00 00
								29 01 00 00 00 00 02 00 80
								29 01 00 00 00 00 03 ff 00 00];
		hw,lcdkit-panel-column-inversion-command-state = "dsi_lp_mode";
		hw,lcdkit-panel-inversion-support = <1>;
		hw,lcdkit-panel-forword-scan-command = [29 01 00 00 00 00 02 00 00
								29 01 00 00 00 00 04 ff 87 16 01
								29 01 00 00 00 00 02 00 80
								29 01 00 00 00 00 03 ff 87 16
								29 01 00 00 00 00 02 00 b4
								29 01 00 00 00 00 02 c0 00
								29 01 00 00 00 00 02 00 00
								29 01 00 00 00 00 04 ff 00 00 00
								29 01 00 00 00 00 02 00 80
								29 01 00 00 00 00 03 ff 00 00];
		hw,lcdkit-panel-forword-scan-command-state = "dsi_lp_mode";
		hw,lcdkit-panel-revert-scan-command = [29 01 00 00 00 00 02 00 00
								29 01 00 00 00 00 04 ff 87 16 01
								29 01 00 00 00 00 02 00 80
								29 01 00 00 00 00 03 ff 87 16
								29 01 00 00 00 00 02 00 b4
								29 01 00 00 00 00 02 c0 50
								29 01 00 00 00 00 02 00 00
								29 01 00 00 00 00 04 ff 00 00 00
								29 01 00 00 00 00 02 00 80
								29 01 00 00 00 00 03 ff 00 00];
		hw,lcdkit-panel-revert-scan-command-state = "dsi_lp_mode";
		hw,lcdkit-panel-scan-support = <1>;
		hw,lcdkit-panel-display-region-support = <0>;
		hw,lcdkit-panel-checksum-support = <0>;
		hw,lcdkit-panel-esd-reg-command = [06 01 00 01 0a 00 01 0a];
		hw,lcdkit-panel-esd-reg-command-state = "dsi_lp_mode";
		hw,lcdkit-panel-esd-value = [9c];
		hw,lcdkit-panel-esd-support = <0>;
		hw,lcdkit-panel-check-reg-command = [06 01 00 00 0a 00 01 0a];
		hw,lcdkit-panel-check-reg-value = [9c];
		hw,lcdkit-panel-check-reg-command-state = "dsi_lp_mode";
		hw,lcdkit-panel-check-reg-support = <1>;
		hw,lcdkit-panel-mipi-detect-support = <0>;
		hw,lcdkit-panel-shutdown-sleep-support = <0>;
		hw,lcdkit-dsi-bpp = <24>;
		hw,lcdkit-panel-cmd-type = <0>;
		hw,lcdkit-pixel-packing = <0>;
		hw,lcdkit-underflow-color = <0x00>;
		hw,lcdkit-border-color = <0>;
		hw,lcdkit-panel-orientation = <0>;
		hw,lcdkit-brightness-max-level = <255>;
		hw,lcdkit-bl-min-level = <2>;
		hw,lcdkit-bl-max-level = <255>;
		hw,lcdkit-interleave-mode = <0>;
		hw,lcdkit-te-check-enable;
		hw,lcdkit-te-using-te-pin;
		hw,lcdkit-h-sync-pulse = <1>;
		hw,lcdkit-bllp-power-mode;
		hw,lcdkit-bllp-eof-power-mode;
		hw,lcdkit-traffic-mode = "burst_mode";
		hw,lcdkit-te-dcs-command = <1>;
		hw,lcdkit-te-pin-select = <1>;
		hw,lcdkit-virtual-channel-id = <0>;
		hw,lcdkit-color-order = "rgb_swap_rgb";
		hw,lcdkit-lane-0-state;
		hw,lcdkit-lane-1-state;
		hw,lcdkit-lane-2-state;
		hw,lcdkit-h-left-border = <0>;
		hw,lcdkit-h-right-border = <0>;
		hw,lcdkit-v-top-border = <0>;
		hw,lcdkit-v-bottom-border = <0>;
		hw,lcdkit-panel-framerate = <60>;
		hw,lcdkit-panel-clockrate = <667000000>;
		hw,lcdkit-panel-timings = [B4 2A 1C 00 54 58 20 2E 20 03 04 00];
		hw,lcdkit-t-clk-pre = <0x23>;
		hw,lcdkit-t-clk-post = <0x03>;
		hw,lcdkit-tx-eot-append;
		hw,lcdkit-stream = <0>;
		hw,lcdkit-lp11-init;
		hw,lcdkit-mdp-trigger = "none";
		hw,lcdkit-dma-trigger = "trigger_sw";
		hw,lcdkit-bl-pmic-control-type = "bl_ctrl_dcs";
		qcom,panel-supply-entries = <&dsi_panel_pwr_supply>;
		hw,lcdkit-lane-map = "lane_map_0123";
		hw,lcdkit-delay-before-bl = <0>;
		hw,lcdkit-mipi-regulator-mode = <1>;
		qcom,suspend-ulps-enabled;
		hw,lcdkit-delay-af-rst-off = <20>;
		hw,lcdkit-delay-af-blic-init = <0>;
		hw,lcdkit-bl-level-limit-percent = <100>;
		hw,lcdkit-use-second-ic-for-esd = <0>;
		hw,lcdkit-esd-check-num = <3>;
		hw,lcdkit-h-back-porch = <108>;
		hw,lcdkit-h-front-porch = <110>;
		hw,lcdkit-h-pulse-width = <4>;
		hw,lcdkit-v-back-porch = <16>;
		hw,lcdkit-v-pulse-width = <4>;
		hw,lcdkit-v-front-porch = <16>;
		hw,lcdkit-h-sync-skew = <0>;
		hw,lcdkit-lcd-type = <2>;
		hw,lcdkit-panel-pt-test-support = <1>;
		hw,lcdkit-bias-power-ctrl-mode = <0x04>;
		hw,lcdkit-iovcc-power-ctrl-mode = <0x01>;
		hw,lcdkit-vci-power-ctrl-mode = <0x01>;
		hw,lcdkit-id0-gpio = <59>;
		hw,lcdkit-id1-gpio = <48>;
		hw,lcdkit-reset-gpio = <60>;
		hw,lcdkit-te-gpio = <0>;
		hw,lcdkit-vsp-gpio = <124>;
		hw,lcdkit-vsn-gpio = <127>;
		hw,lcdkit-iovcc-gpio = <0>;
		hw,lcdkit-vci-gpio = <0>;
		hw,lcdkit-bl-gpio = <98>;
		hw,lcdkit-iovcc-on-is-need-reset = <0>;
		hw,lcdkit-vsn-on-is-need-reset = <0>;
		hw,lcdkit-lcd-vsp = <5500000>;
		hw,lcdkit-lcd-vsn = <5500000>;
		hw,lcdkit-lcd-rst-first-high = <5>;
		hw,lcdkit-lcd-rst-low = <2>;
		hw,lcdkit-lcd-rst-second-high = <5>;
		hw,lcdkit-delay-af-vci-on = <0>;
		hw,lcdkit-delay-af-iovcc-on = <0>;
		hw,lcdkit-delay-af-bias-on = <0>;
		hw,lcdkit-delay-af-vsp-on = <11>;
		hw,lcdkit-delay-af-vsn-on = <2>;
		hw,lcdkit-delay-af-lp11 = <0>;
		hw,lcdkit-delay-af-tp-reset = <25>;
		hw,lcdkit-delay-af-vsn-off = <0>;
		hw,lcdkit-delay-af-vsp-off = <0>;
		hw,lcdkit-delay-af-bias-off = <0>;
		hw,lcdkit-delay-af-iovcc-off = <0>;
		hw,lcdkit-delay-af-vci-off = <0>;
		hw,lcdkit-panel-off-reset-high = <0>;
		hw_sm5109,lcdkit-bias-type = <0x0c>;
		hw_sm5109,lcdkit-bias-vpos-reg = <0x00>;
		hw_sm5109,lcdkit-bias-vneg-reg = <0x01>;
		hw_sm5109,lcdkit-bias-vpos-val = <0x32>;
		hw_sm5109,lcdkit-bias-vneg-val = <0x12>;
		hw_sm5109,lcdkit-bias-vpos-mask = <0x3f>;
		hw_sm5109,lcdkit-bias-vneg-mask = <0x1f>;
		hw_sm5109,lcdkit-bias-state-reg = <0x03>;
		hw_sm5109,lcdkit-bias-state-val = <0x43>;
		hw_sm5109,lcdkit-bias-state-mask = <0x43>;
		hw_ocp2131,lcdkit-bias-type = <0x06>;
		hw_ocp2131,lcdkit-bias-vpos-reg = <0x00>;
		hw_ocp2131,lcdkit-bias-vneg-reg = <0x01>;
		hw_ocp2131,lcdkit-bias-vpos-val = <0x12>;
		hw_ocp2131,lcdkit-bias-vneg-val = <0x12>;
		hw_ocp2131,lcdkit-bias-vpos-mask = <0x1f>;
		hw_ocp2131,lcdkit-bias-vneg-mask = <0x1f>;
		hw_ocp2131,lcdkit-bias-state-reg = <0x00>;
		hw_ocp2131,lcdkit-bias-state-val = <0x00>;
		hw_ocp2131,lcdkit-bias-state-mask = <0x00>;
    };
};