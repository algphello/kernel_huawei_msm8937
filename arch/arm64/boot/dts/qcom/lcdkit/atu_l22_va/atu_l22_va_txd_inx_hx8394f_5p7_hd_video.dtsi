/* Copyright (c) 2013, The Linux Foundation. All rights reserved.
 *
 * This program is free software; you can redistribute it and/or modify
 * it under the terms of the GNU General Public License version 2 and
 * only version 2 as published by the Free Software Foundation.
 *
 * This program is distributed in the hope that it will be useful,
 * but WITHOUT ANY WARRANTY; without even the implied warranty of
 * MERCHANTABILITY or FITNESS FOR A PARTICULAR PURPOSE.  See the
 * GNU General Public License for more details.
 */

/*-------------------------------------------------------------------------
 * This file is autogenerated file using gcdb parser. Please do not edit it.
 * Update input XML file to add a new entry or update variable in this file
 * VERSION = 1.1
 *-----------------------------------------------------------------------*/
/ {
	dsi_atu_l22_va_txd_inx_hx8394f_5p7_hd_video: lcdkit_atu_l22_va_txd_inx_hx8394f_5p7_hd_video {
		compatible = "txd_inx_hx8394f_5p7_hd_video";
		hw,lcdkit-panel-name = "TXD_HX8394F 5P7 VIDEO INX 720 x 1440";
		hw,lcdkit-panel-type = <0x01>;
		hw,lcdkit-panel-xres = <720>;
		hw,lcdkit-panel-yres = <1440>;
		hw,lcdkit-panel-width = <67>;
		hw,lcdkit-panel-height = <135>;
		hw,lcdkit-panel-on-command = [39 01 00 00 00 00 04 B9 FF 83 94
					39 01 00 00 00 00 07 BA 62 03 68 6B B2 C0
					39 01 00 00 00 00 0B B1 48 16 76 09 32 54 71 51 57 43
					39 01 00 00 00 00 07 B2 00 80 78 0C 0D 22
					39 01 00 00 00 00 16 B4 69 6A 69 6A 69 6A 01 0C 7C 55 00 3F 69 6A 69 6A 69 6A 01 0C 7C
					39 01 00 00 00 00 03 B6 6E 6E
					39 01 00 00 00 00 02 D2 99
					39 01 00 00 00 00 22 D3 00 00 07 07 40 07 0C 00 08 10 08 00 08 54 15 AA 05 AA 02 15 06 05 06 47 44 0A 0A 4B 10 07 07 0C 40
					39 01 00 00 00 00 2D D5 1C 1C 1D 1D 00 01 02 03 04 05 06 07 08 09 0A 0B 24 25 18 18 26 27 18 18 18 18 18 18 18 18 18 18 18 18 18 18 18 18 20 21 18 18 18 18
					39 01 00 00 00 00 2D D6 1C 1C 1D 1D 0B 0A 09 08 07 06 05 04 03 02 01 00 21 20 18 18 27 26 18 18 18 18 18 18 18 18 18 18 18 18 18 18 18 18 25 24 18 18 18 18
					39 01 00 00 00 00 3B E0 00 03 08 0D 0F 12 16 14 29 39 49 47 4E 5D 60 63 70 74 71 81 92 49 47 4B 4E 51 55 58 7F 00 03 08 0D 0F 12 16 14 29 39 49 47 4D 5D 5F 62 6F 72 70 81 93 49 48 4B 4E 51 56 59 7F
					39 01 00 00 00 00 03 C0 1F 31
					39 01 00 00 00 00 02 CC 0B
					39 01 00 00 00 00 02 D4 02
					39 01 00 00 00 00 02 BD 02
					39 01 00 00 00 00 0D D8 FF FF FF FF FF FF FF FF FF FF FF FF
					39 01 00 00 00 00 02 BD 00
					39 01 00 00 00 00 02 BD 01
					39 01 00 00 00 00 02 B1 00
					39 01 00 00 00 00 02 BD 00
					39 01 00 00 00 00 02 C6 ED
					39 01 00 00 05 00 08 C9 0B 01 AA 1E B1 1E 00
					39 01 00 00 05 00 02 55 00
					39 01 00 00 00 00 02 53 2C
					05 01 00 00 78 00 02 11 00
					05 01 00 00 14 00 02 29 00];
		hw,lcdkit-panel-on-command-state = "dsi_lp_mode";
		hw,lcdkit-panel-display-on-command = [05 01 00 00 14 00 02 29 00];
		hw,lcdkit-panel-off-command = [05 01 00 00 14 00 02 28 00
					39 01 00 00 00 00 0B B1 48 16 76 09 32 54 71 51 57 0D
					05 01 00 00 78 00 02 10 00];
		hw,lcdkit-panel-off-command-state = "dsi_hs_mode";
		hw,lcdkit-panel-backlight-command = [15 01 00 00 00 00 02 51 00];
		hw,lcdkit-panel-backlight-command-state = "dsi_lp_mode";
		hw,lcdkit-panel-cabc-off-command = [15 01 00 00 0a 00 02 55 00];
		hw,lcdkit-panel-cabc-off-command-state = "dsi_lp_mode";
		hw,lcdkit-panel-cabc-ui-command = [15 01 00 00 0a 00 02 55 01
					15 01 00 00 0a 00 02 53 2C];
		hw,lcdkit-panel-cabc-ui-command-state = "dsi_lp_mode";
		hw,lcdkit-panel-cabc-still-command = [15 01 00 00 0a 00 02 55 02
					15 01 00 00 0a 00 02 53 2C];
		hw,lcdkit-panel-cabc-still-command-state = "dsi_lp_mode";
		hw,lcdkit-panel-cabc-moving-command = [15 01 00 00 0a 00 02 55 03
					15 01 00 00 0a 00 02 53 2C];
		hw,lcdkit-panel-cabc-moving-command-state = "dsi_lp_mode";
		hw,lcdkit-panel-cabc-support = <0>;
		hw,lcdkit-panel-dot-inversion-command = [29 01 00 00 00 00 01 b2 01];
		hw,lcdkit-panel-dot-inversion-command-state = "dsi_lp_mode";
		hw,lcdkit-panel-column-inversion-command = [29 01 00 00 00 00 01 b2 00];
		hw,lcdkit-panel-column-inversion-command-state = "dsi_lp_mode";
		hw,lcdkit-panel-inversion-support = <1>;
		hw,lcdkit-panel-forword-scan-command = [29 01 00 00 00 00 02 cc 0b];
		hw,lcdkit-panel-forword-scan-command-state = "dsi_lp_mode";
		hw,lcdkit-panel-revert-scan-command = [29 01 00 00 00 00 02 cc 07];
		hw,lcdkit-panel-revert-scan-command-state = "dsi_lp_mode";
		hw,lcdkit-panel-scan-support = <1>;
		hw,lcdkit-panel-display-region-command = [];
		hw,lcdkit-panel-display-region-command-state = "dsi_lp_mode";
		hw,lcdkit-panel-display-region-support = <0>;
		hw,lcdkit-panel-checksum-enter-command = [];
		hw,lcdkit-panel-checksum-enter-command-state = "dsi_lp_mode";
		hw,lcdkit-panel-checksum-command = [];
		hw,lcdkit-panel-checksum-command-state = "dsi_lp_mode";
		hw,lcdkit-panel-checksum-exit-command = [];
		hw,lcdkit-panel-checksum-exit-command-state = "dsi_lp_mode";
		hw,lcdkit-panel-checksum-value = [];
		hw,lcdkit-panel-checksum-support = <0>;
		hw,lcdkit-panel-esd-reg-command = [14 01 00 01 0a 00 01 0a
		14 01 00 01 0a 00 01 0d
		14 01 00 01 0a 00 01 0c];
		hw,lcdkit-panel-esd-reg-command-state = "dsi_lp_mode";
		hw,lcdkit-panel-esd-value = [1c 00 77];
		hw,lcdkit-panel-esd-support = <1>;
		hw,lcdkit-panel-check-reg-command = [14 01 00 00 0a 00 01 0a];
		hw,lcdkit-panel-check-reg-value = [1c];
		hw,lcdkit-panel-check-reg-command-state = "dsi_lp_mode";
		hw,lcdkit-panel-check-reg-support = <1>;
		hw,lcdkit-panel-mipi-detect-command = [];
		hw,lcdkit-panel-mipi-detect-value = [];
		hw,lcdkit-panel-mipi-detect-mask = [];
		hw,lcdkit-panel-mipi-detect-command-state = "dsi_lp_mode";
		hw,lcdkit-panel-mipi-detect-support = <0>;
		hw,lcdkit-panel-shutdown-sleep-support = <0>;
		hw,lcdkit-dsi-bpp = <24>;
		hw,lcdkit-panel-cmd-type = <0>;
		hw,lcdkit-pixel-packing = <0>;
		hw,lcdkit-underflow-color = <0x00>;
		hw,lcdkit-border-color = <0>;
		hw,lcdkit-panel-orientation = <0>;
		hw,lcdkit-brightness-max-level = <255>;
		hw,lcdkit-bl-min-level = <2>;
		hw,lcdkit-bl-max-level = <255>;
		hw,lcdkit-interleave-mode = <0>;
		hw,lcdkit-te-check-enable;
		hw,lcdkit-te-using-te-pin;
		hw,lcdkit-h-sync-pulse = <1>;
		hw,lcdkit-bllp-power-mode;
		hw,lcdkit-bllp-eof-power-mode;
		hw,lcdkit-traffic-mode = "burst_mode";
		hw,lcdkit-te-dcs-command = <1>;
		hw,lcdkit-te-pin-select = <1>;
		hw,lcdkit-virtual-channel-id = <0>;
		hw,lcdkit-color-order = "rgb_swap_rgb";
		hw,lcdkit-lane-0-state;
		hw,lcdkit-lane-1-state;
		hw,lcdkit-lane-2-state;
		hw,lcdkit-h-left-border = <0>;
		hw,lcdkit-h-right-border = <0>;
		hw,lcdkit-v-top-border = <0>;
		hw,lcdkit-v-bottom-border = <0>;
		hw,lcdkit-panel-framerate = <60>;
		hw,lcdkit-panel-clockrate = <667000000>;
		hw,lcdkit-panel-timings = [B4 2A 1C 00 54 58 20 2E 20 03 04 00];
		hw,lcdkit-t-clk-pre = <0x23>;
		hw,lcdkit-t-clk-post = <0x03>;
		hw,lcdkit-tx-eot-append;
		hw,lcdkit-stream = <0>;
		hw,lcdkit-lp11-init;
		hw,lcdkit-mdp-trigger = "none";
		hw,lcdkit-dma-trigger = "trigger_sw";
		hw,lcdkit-bl-pmic-control-type = "bl_ctrl_dcs";
		qcom,panel-supply-entries = <&dsi_panel_pwr_supply>;
		hw,lcdkit-lane-map = "lane_map_0123";
		hw,lcdkit-delay-before-bl = <0>;
		hw,lcdkit-mipi-regulator-mode = <1>;
		qcom,suspend-ulps-enabled;
		hw,lcdkit-delay-af-rst-off = <20>;
		hw,lcdkit-delay-af-blic-init = <0>;
		hw,lcdkit-bl-level-limit-percent = <100>;
		hw,lcdkit-use-second-ic-for-esd = <0>;
		hw,lcdkit-esd-check-num = <3>;
		hw,lcdkit-h-back-porch = <35>;
		hw,lcdkit-h-front-porch = <170>;
		hw,lcdkit-h-pulse-width = <20>;
		hw,lcdkit-v-back-porch = <12>;
		hw,lcdkit-v-pulse-width = <4>;
		hw,lcdkit-v-front-porch = <16>;
		hw,lcdkit-h-sync-skew = <0>;
		hw,lcdkit-lcd-type = <0>;
		hw,lcdkit-panel-pt-test-support = <1>;
		hw,lcdkit-bias-power-ctrl-mode = <0x04>;
		hw,lcdkit-iovcc-power-ctrl-mode = <0x01>;
		hw,lcdkit-vci-power-ctrl-mode = <0x01>;
		hw,lcdkit-id0-gpio = <59>;
		hw,lcdkit-id1-gpio = <48>;
		hw,lcdkit-reset-gpio = <60>;
		hw,lcdkit-te-gpio = <0>;
		hw,lcdkit-vsp-gpio = <124>;
		hw,lcdkit-vsn-gpio = <127>;
		hw,lcdkit-iovcc-gpio = <0>;
		hw,lcdkit-vci-gpio = <0>;
		hw,lcdkit-bl-gpio = <98>;
		hw,lcdkit-iovcc-on-is-need-reset = <0>;
		hw,lcdkit-vsn-on-is-need-reset = <0>;
		hw,lcdkit-lcd-vsp = <5500000>;
		hw,lcdkit-lcd-vsn = <5500000>;
		hw,lcdkit-lcd-rst-first-high = <2>;
		hw,lcdkit-lcd-rst-low = <2>;
		hw,lcdkit-lcd-rst-second-high = <10>;
		hw,lcdkit-delay-af-vci-on = <0>;
		hw,lcdkit-delay-af-iovcc-on = <0>;
		hw,lcdkit-delay-af-bias-on = <0>;
		hw,lcdkit-delay-af-vsp-on = <2>;
		hw,lcdkit-delay-af-vsn-on = <2>;
		hw,lcdkit-delay-af-lp11 = <0>;
		hw,lcdkit-delay-af-tp-reset = <25>;
		hw,lcdkit-delay-af-vsn-off = <2>;
		hw,lcdkit-delay-af-vsp-off = <2>;
		hw,lcdkit-delay-af-bias-off = <0>;
		hw,lcdkit-delay-af-iovcc-off = <0>;
		hw,lcdkit-delay-af-vci-off = <0>;
		hw,lcdkit-panel-off-reset-high = <0>;
		hw_sm5109,lcdkit-bias-type = <0x0c>;
		hw_sm5109,lcdkit-bias-vpos-reg = <0x00>;
		hw_sm5109,lcdkit-bias-vneg-reg = <0x01>;
		hw_sm5109,lcdkit-bias-vpos-val = <0x31>;
		hw_sm5109,lcdkit-bias-vneg-val = <0x11>;
		hw_sm5109,lcdkit-bias-vpos-mask = <0x3f>;
		hw_sm5109,lcdkit-bias-vneg-mask = <0x1f>;
		hw_sm5109,lcdkit-bias-state-reg = <0x03>;
		hw_sm5109,lcdkit-bias-state-val = <0x43>;
		hw_sm5109,lcdkit-bias-state-mask = <0x43>;
		hw_ocp2131,lcdkit-bias-type = <0x06>;
		hw_ocp2131,lcdkit-bias-vpos-reg = <0x00>;
		hw_ocp2131,lcdkit-bias-vneg-reg = <0x01>;
		hw_ocp2131,lcdkit-bias-vpos-val = <0x11>;
		hw_ocp2131,lcdkit-bias-vneg-val = <0x11>;
		hw_ocp2131,lcdkit-bias-vpos-mask = <0x1f>;
		hw_ocp2131,lcdkit-bias-vneg-mask = <0x1f>;
		hw_ocp2131,lcdkit-bias-state-reg = <0x00>;
		hw_ocp2131,lcdkit-bias-state-val = <0x00>;
		hw_ocp2131,lcdkit-bias-state-mask = <0x00>;
    };
};