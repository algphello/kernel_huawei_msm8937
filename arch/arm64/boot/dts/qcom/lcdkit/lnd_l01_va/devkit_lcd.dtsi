/*---------------------------------------------------------------------------
 * This file is autogenerated file using huawei LCD parser. Please do not edit it.
 * Update input XML file to add a new entry or update variable in this file
 * Parser location: vendor/huawei/chipset_common/devkit/lcdkit/tools 
 *---------------------------------------------------------------------------*/


#include "lnd_l01_va_djn_ili9881c_5p99_720p_video.dtsi"
#include "lnd_l01_va_djn_nt35596_5p99_720p_video.dtsi"
#include "lnd_l01_va_hlt_hx83102b_5p99_720p_video.dtsi"
#include "lnd_l01_va_hlt_hx8394f_5p99_720p_video.dtsi"
#include "lnd_l01_va_hsd_hx8394f_5p99_720p_video.dtsi"
#include "lnd_l01_va_inx_ili9881c_5p99_720p_video.dtsi"
#include "lnd_l01_va_txd_ili9881c_5p99_720p_video.dtsi"
#include "lnd_l01_va_txd_nt36525_5p99_720p_video.dtsi"