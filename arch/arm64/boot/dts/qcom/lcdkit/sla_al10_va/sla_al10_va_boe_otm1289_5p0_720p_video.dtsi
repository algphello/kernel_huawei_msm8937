/* Copyright (c) 2013, The Linux Foundation. All rights reserved.
 *
 * This program is free software; you can redistribute it and/or modify
 * it under the terms of the GNU General Public License version 2 and
 * only version 2 as published by the Free Software Foundation.
 *
 * This program is distributed in the hope that it will be useful,
 * but WITHOUT ANY WARRANTY; without even the implied warranty of
 * MERCHANTABILITY or FITNESS FOR A PARTICULAR PURPOSE.  See the
 * GNU General Public License for more details.
 */

/*-------------------------------------------------------------------------
 * This file is autogenerated file using gcdb parser. Please do not edit it.
 * Update input XML file to add a new entry or update variable in this file
 * VERSION = 1.1
 *-----------------------------------------------------------------------*/
/ {
	dsi_sla_al10_va_boe_otm1289_5p0_720p_video: lcdkit_sla_al10_va_boe_otm1289_5p0_720p_video {
		compatible = "boe_otm1289_5p0_720p_video";
		hw,lcdkit-panel-name = "BOE_OTM1289 5.0' VIDEO TFT 720 x 1280";
		hw,lcdkit-panel-type = <0x01>;
		hw,lcdkit-panel-xres = <720>;
		hw,lcdkit-panel-yres = <1280>;
		hw,lcdkit-panel-width = <68>;
		hw,lcdkit-panel-height = <121>;
		hw,lcdkit-panel-on-command = [29 01 00 00 00 00 02 00 00
							29 01 00 00 00 00 04 ff 12 89 01
							29 01 00 00 00 00 02 00 80
							29 01 00 00 00 00 03 ff 12 89
							29 01 00 00 00 00 02 00 90
							29 01 00 00 00 00 02 ff b0
							29 01 00 00 00 00 02 00 80
							29 01 00 00 00 00 09 c0 4a 00 10 10 96 01 68 40
							29 01 00 00 00 00 02 00 90
							29 01 00 00 00 00 04 c0 3b 01 09
							29 01 00 00 00 00 02 00 8c
							29 01 00 00 00 00 02 c0 00
							29 01 00 00 00 00 02 00 80
							29 01 00 00 00 00 02 c1 33
							29 01 00 00 00 00 02 00 85
							29 01 00 00 00 00 04 c5 0a 0a 46
							29 01 00 00 00 00 02 00 00
							29 01 00 00 00 00 03 d8 27 27
							29 01 00 00 00 00 02 00 84
							29 01 00 00 00 00 02 C4 02
							29 01 00 00 00 00 02 00 93
							29 01 00 00 00 00 02 C4 04
							29 01 00 00 00 00 02 00 96
							29 01 00 00 00 00 02 F5 E7
							29 01 00 00 00 00 02 00 A0
							29 01 00 00 00 00 02 F5 4A
							29 01 00 00 00 00 02 00 8a
							29 01 00 00 00 00 02 c0 11
							29 01 00 00 00 00 02 00 83
							29 01 00 00 00 00 02 F5 81
							29 01 00 00 00 00 02 00 90
							29 01 00 00 00 00 03 c4 96 05
							29 01 00 00 00 00 02 00 80
							29 01 00 00 00 00 10 cb 14 14 14 14 14 00 00 00 00 00 00 00 00 00 00
							29 01 00 00 00 00 02 00 90
							29 01 00 00 00 00 08 cb FC FC FC 00 14 14 14
							29 01 00 00 00 00 02 00 80
							29 01 00 00 00 00 0F cc 02 0A 0C 0E 10 00 00 00 00 00 00 00 00 00
							29 01 00 00 00 00 02 00 90
							29 01 00 00 00 00 10 cc 00 00 00 00 1E 1D 06 01 09 0B 0d 0F 00 00 00
							29 01 00 00 00 00 02 00 a0
							29 01 00 00 00 00 0E cc 00 00 00 00 00 00 00 00 00 00 1E 1D 05
							29 01 00 00 00 00 02 00 b0
							29 01 00 00 00 00 0F cc 05 0F 0D 0B 09 00 00 00 00 00 00 00 00 00
							29 01 00 00 00 00 02 00 c0
							29 01 00 00 00 00 10 cc 00 00 00 00 1D 1E 01 06 10 0E 0C 0A 00 00 00
							29 01 00 00 00 00 02 00 d0
							29 01 00 00 00 00 0E cc 00 00 00 00 00 00 00 00 00 00 1D 1E 02
							29 01 00 00 00 00 02 00 80
							29 01 00 00 00 00 07 ce 87 03 10 86 00 00
							29 01 00 00 00 00 02 00 90
							29 01 00 00 00 00 0A ce 34 ff 10 05 00 00 00 00 00
							29 01 00 00 00 00 02 00 a0
							29 01 00 00 00 00 10 ce 30 83 88 00 20 00 82 87 00 81 86 00 80 85 00
							29 01 00 00 00 00 02 00 b0
							29 01 00 00 00 00 10 ce 30 00 84 00 20 00 01 83 00 02 82 00 03 81 00
							29 01 00 00 00 00 02 00 E0
							29 01 00 00 00 00 09 CE 0A 04 FC 00 00 0A 04 FC
							29 01 00 00 00 00 02 00 F0
							29 01 00 00 00 00 07 CE 01 20 01 01 00 00
							29 01 00 00 00 00 02 00 00
							29 01 00 00 00 00 11 E1 05 1F 2E 41 4D 6B 6B 83 71 5B 63 4A 32 1E 10 01
							29 01 00 00 00 00 02 00 00
							29 01 00 00 00 00 11 E2 05 1F 2E 41 4D 6B 6B 83 71 5B 63 4A 32 1E 10 01
							29 01 00 00 00 00 02 00 B3
							29 01 00 00 00 00 02 CA 04
							29 01 00 00 00 00 02 00 00
							29 01 00 00 00 00 02 91 83
							29 01 00 00 00 00 02 00 00
							29 01 00 00 00 00 04 ff ff ff ff
							29 01 00 00 00 00 02 53 2C
							29 01 00 00 00 00 02 55 01
							29 01 00 00 78 00 02 11 00
							29 01 00 00 14 00 02 29 00];
		hw,lcdkit-panel-on-command-state = "dsi_lp_mode";
		hw,lcdkit-panel-off-command = [05 01 00 00 20 00 02 28 00
				  05 01 00 00 78 00 02 10 00];
		hw,lcdkit-panel-off-command-state = "dsi_lp_mode";
		hw,lcdkit-panel-backlight-command = [29 01 00 00 00 00 02 51 FF];
		hw,lcdkit-panel-backlight-command-state = "dsi_lp_mode";
		hw,lcdkit-panel-cabc-off-command = [15 01 00 00 0a 00 02 55 00];
		hw,lcdkit-panel-cabc-off-command-state = "dsi_lp_mode";
		hw,lcdkit-panel-cabc-ui-command = [15 01 00 00 0a 00 02 55 01
				  15 01 00 00 0a 00 02 53 2C];
		hw,lcdkit-panel-cabc-ui-command-state = "dsi_lp_mode";
		hw,lcdkit-panel-cabc-still-command = [15 01 00 00 0a 00 02 55 02
				     15 01 00 00 0a 00 02 53 2C];
		hw,lcdkit-panel-cabc-still-command-state = "dsi_lp_mode";
		hw,lcdkit-panel-cabc-moving-command = [15 01 00 00 0a 00 02 55 03
				      15 01 00 00 0a 00 02 53 2C];
		hw,lcdkit-panel-cabc-moving-command-state = "dsi_lp_mode";
		hw,lcdkit-panel-cabc-support = <1>;
		hw,lcdkit-panel-inversion-support = <0>;
		hw,lcdkit-panel-scan-support = <0>;
		hw,lcdkit-panel-display-region-support = <0>;
		hw,lcdkit-panel-checksum-support = <0>;
		hw,lcdkit-panel-esd-reg-command = [06 01 00 00 0a 00 01 0a];
		hw,lcdkit-panel-esd-reg-command-state = "dsi_lp_mode";
		hw,lcdkit-panel-esd-value = [9c];
		hw,lcdkit-panel-esd-support = <1>;
		hw,lcdkit-panel-check-reg-support = <0>;
		hw,lcdkit-panel-mipi-detect-support = <0>;
		hw,lcdkit-panel-shutdown-sleep-support = <0>;
		hw,lcdkit-dsi-bpp = <24>;
		hw,lcdkit-panel-cmd-type = <0>;
		hw,lcdkit-pixel-packing = <0>;
		hw,lcdkit-underflow-color = <0x00>;
		hw,lcdkit-border-color = <0>;
		hw,lcdkit-panel-orientation = <0>;
		hw,lcdkit-brightness-max-level = <255>;
		hw,lcdkit-bl-min-level = <1>;
		hw,lcdkit-bl-max-level = <255>;
		hw,lcdkit-interleave-mode = <0>;
		hw,lcdkit-te-using-te-pin;
		hw,lcdkit-h-sync-pulse = <1>;
		hw,lcdkit-bllp-power-mode;
		hw,lcdkit-bllp-eof-power-mode;
		hw,lcdkit-traffic-mode = "burst_mode";
		hw,lcdkit-te-dcs-command = <1>;
		hw,lcdkit-te-pin-select = <1>;
		hw,lcdkit-virtual-channel-id = <0>;
		hw,lcdkit-color-order = "rgb_swap_rgb";
		hw,lcdkit-lane-0-state;
		hw,lcdkit-lane-1-state;
		hw,lcdkit-lane-2-state;
		hw,lcdkit-lane-3-state;
		hw,lcdkit-h-left-border = <0>;
		hw,lcdkit-h-right-border = <0>;
		hw,lcdkit-v-top-border = <0>;
		hw,lcdkit-v-bottom-border = <0>;
		hw,lcdkit-panel-framerate = <60>;
		hw,lcdkit-panel-clockrate = <406840000>;
		hw,lcdkit-panel-timings = [7A 1A 12 00 40 42 16 1E 14 03 04 00];
		hw,lcdkit-t-clk-pre = <0x1A>;
		hw,lcdkit-t-clk-post = <0x04>;
		hw,lcdkit-tx-eot-append;
		hw,lcdkit-stream = <0>;
		hw,lcdkit-lp11-init;
		hw,lcdkit-mdp-trigger = "none";
		hw,lcdkit-dma-trigger = "trigger_sw";
		hw,lcdkit-bl-pmic-control-type = "bl_ctrl_dcs";
		qcom,panel-supply-entries = <&dsi_panel_pwr_supply>;
		hw,lcdkit-lane-map = "lane_map_0123";
		hw,lcdkit-delay-before-bl = <0>;
		hw,lcdkit-mipi-regulator-mode = <0>;
		hw,lcdkit-bl-en-gpio = <0>;
		hw,lcdkit-delay-af-rst-off = <20>;
		hw,lcdkit-delay-af-blic-init = <0>;
		hw,lcdkit-bl-level-limit-percent = <100>;
		hw,lcdkit-use-second-ic-for-esd = <0>;
		hw,lcdkit-esd-check-num = <3>;
		hw,lcdkit-h-back-porch = <50>;
		hw,lcdkit-h-front-porch = <50>;
		hw,lcdkit-h-pulse-width = <8>;
		hw,lcdkit-v-back-porch = <20>;
		hw,lcdkit-v-pulse-width = <10>;
		hw,lcdkit-v-front-porch = <20>;
		hw,lcdkit-h-sync-skew = <0>;
		hw,lcdkit-lcd-type = <0>;
		hw,lcdkit-panel-pt-test-support = <1>;
		hw,lcdkit-bias-power-ctrl-mode = <0x02>;
		hw,lcdkit-iovcc-power-ctrl-mode = <0x01>;
		hw,lcdkit-vci-power-ctrl-mode = <0x02>;
		hw,lcdkit-id0-gpio = <59>;
		hw,lcdkit-id1-gpio = <66>;
		hw,lcdkit-reset-gpio = <60>;
		hw,lcdkit-te-gpio = <0>;
		hw,lcdkit-vsp-gpio = <46>;
		hw,lcdkit-vsn-gpio = <45>;
		hw,lcdkit-iovcc-gpio = <0>;
		hw,lcdkit-vci-gpio = <0>;
		hw,lcdkit-bl-gpio = <0>;
		hw,lcdkit-iovcc-on-is-need-reset = <0>;
		hw,lcdkit-vsn-on-is-need-reset = <0>;
		hw,lcdkit-lcd-vsp = <5500000>;
		hw,lcdkit-lcd-vsn = <5500000>;
		hw,lcdkit-lcd-rst-first-high = <20>;
		hw,lcdkit-lcd-rst-low = <2>;
		hw,lcdkit-lcd-rst-second-high = <20>;
		hw,lcdkit-delay-af-vci-on = <0>;
		hw,lcdkit-delay-af-iovcc-on = <0>;
		hw,lcdkit-delay-af-bias-on = <0>;
		hw,lcdkit-delay-af-vsp-on = <20>;
		hw,lcdkit-delay-af-vsn-on = <20>;
		hw,lcdkit-delay-af-lp11 = <0>;
		hw,lcdkit-delay-af-tp-reset = <25>;
		hw,lcdkit-delay-af-vsn-off = <3>;
		hw,lcdkit-delay-af-vsp-off = <0>;
		hw,lcdkit-delay-af-bias-off = <0>;
		hw,lcdkit-delay-af-iovcc-off = <0>;
		hw,lcdkit-delay-af-vci-off = <0>;
		hw,lcdkit-panel-off-reset-high = <0>;
    };
};