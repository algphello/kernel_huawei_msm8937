/* Copyright (c) 2013, The Linux Foundation. All rights reserved.
 *
 * This program is free software; you can redistribute it and/or modify
 * it under the terms of the GNU General Public License version 2 and
 * only version 2 as published by the Free Software Foundation.
 *
 * This program is distributed in the hope that it will be useful,
 * but WITHOUT ANY WARRANTY; without even the implied warranty of
 * MERCHANTABILITY or FITNESS FOR A PARTICULAR PURPOSE.  See the
 * GNU General Public License for more details.
 */

/*-------------------------------------------------------------------------
 * This file is autogenerated file using gcdb parser. Please do not edit it.
 * Update input XML file to add a new entry or update variable in this file
 * VERSION = 1.1
 *-----------------------------------------------------------------------*/
/ {
	dsi_sla_al10_va_ofilm_nt35521s_5p0_720p_video: lcdkit_sla_al10_va_ofilm_nt35521s_5p0_720p_video {
		compatible = "ofilm_nt35521s_5p0_720p_video";
		hw,lcdkit-panel-name = "OFILM_NT35521S 5.0' VIDEO TFT 720 x 1280";
		hw,lcdkit-panel-type = <0x01>;
		hw,lcdkit-panel-xres = <720>;
		hw,lcdkit-panel-yres = <1280>;
		hw,lcdkit-panel-width = <68>;
		hw,lcdkit-panel-height = <121>;
		hw,lcdkit-panel-on-command = [29 01 00 00 00 00 05 FF AA 55 25 01
				29 01 00 00 00 00 02 FC 08
				29 01 00 00 00 00 02 FC 00
				29 01 00 00 00 00 02 6F 21
				29 01 00 00 00 00 02 F7 01
				29 01 00 00 00 00 02 6F 21
				29 01 00 00 00 00 02 F7 00
				29 01 00 00 00 00 02 6F 1A
				29 01 00 00 00 00 02 F7 05
				29 01 00 00 00 00 05 FF AA 55 25 00
				29 01 00 00 00 00 06 F0 55 AA 52 08 00
				29 01 00 00 00 00 03 D6 11 11
				29 01 00 00 00 00 04 D9 01 02 00
				29 01 00 00 00 00 0D CE 10 10 10 10 10 10 10 10 10 10 10 10
				29 01 00 00 00 00 02 6F 03
				29 01 00 00 00 00 04 CC 00 00 00
				29 01 00 00 00 00 05 B8 01 02 0C 02
				29 01 00 00 00 00 03 BB 11 11
				29 01 00 00 00 00 03 BC 00 00
				29 01 00 00 00 00 02 B6 04
				29 01 00 00 00 00 02 C8 80
				29 01 00 00 00 00 06 F0 55 AA 52 08 01
				29 01 00 00 00 00 03 B0 09 09
				29 01 00 00 00 00 03 B1 09 09
				29 01 00 00 00 00 03 BC 88 00
				29 01 00 00 00 00 03 BD 88 00
				29 01 00 00 00 00 02 CA 00
				29 01 00 00 00 00 02 C0 0C
				29 01 00 00 00 00 03 B5 03 03
				29 01 00 00 00 00 02 BE 3E
				29 01 00 00 00 00 03 B3 19 19
				29 01 00 00 00 00 03 B4 19 19
				29 01 00 00 00 00 03 B9 26 26
				29 01 00 00 00 00 03 BA 24 24
				29 01 00 00 00 00 06 F0 55 AA 52 08 02
				29 01 00 00 00 00 02 EE 01
				29 01 00 00 00 00 11 B0 00 00 00 0A 00 1D 00 2F 00 3E 00 5C 00 76 00 A2
				29 01 00 00 00 00 11 B1 00 C6 01 04 01 36 01 85 01 C7 01 C8 02 03 02 46
				29 01 00 00 00 00 11 B2 02 71 02 AE 02 D8 03 11 03 37 03 68 03 89 03 B0
				29 01 00 00 00 00 05 B3 03 DD 03 FF
				29 01 00 00 00 00 06 F0 55 AA 52 08 06
				29 01 00 00 00 00 03 B0 10 12
				29 01 00 00 00 00 03 B1 14 16
				29 01 00 00 00 00 03 B2 00 02
				29 01 00 00 00 00 03 B3 31 31
				29 01 00 00 00 00 03 B4 31 34
				29 01 00 00 00 00 03 B5 34 34
				29 01 00 00 00 00 03 B6 34 31
				29 01 00 00 00 00 03 B7 31 31
				29 01 00 00 00 00 03 B8 31 31
				29 01 00 00 00 00 03 B9 2D 2E
				29 01 00 00 00 00 03 BA 2E 2D
				29 01 00 00 00 00 03 BB 31 31
				29 01 00 00 00 00 03 BC 31 31
				29 01 00 00 00 00 03 BD 31 34
				29 01 00 00 00 00 03 BE 34 34
				29 01 00 00 00 00 03 BF 34 31
				29 01 00 00 00 00 03 C0 31 31
				29 01 00 00 00 00 03 C1 03 01
				29 01 00 00 00 00 03 C2 17 15
				29 01 00 00 00 00 03 C3 13 11
				29 01 00 00 00 00 03 E5 31 31
				29 01 00 00 00 00 03 C4 17 15
				29 01 00 00 00 00 03 C5 13 11
				29 01 00 00 00 00 03 C6 03 01
				29 01 00 00 00 00 03 C7 31 31
				29 01 00 00 00 00 03 C8 31 34
				29 01 00 00 00 00 03 C9 34 34
				29 01 00 00 00 00 03 CA 34 31
				29 01 00 00 00 00 03 CB 31 31
				29 01 00 00 00 00 03 CC 31 31
				29 01 00 00 00 00 03 CD 2E 2D
				29 01 00 00 00 00 03 CE 2D 2E
				29 01 00 00 00 00 03 CF 31 31
				29 01 00 00 00 00 03 D0 31 31
				29 01 00 00 00 00 03 D1 31 34
				29 01 00 00 00 00 03 D2 34 31
				29 01 00 00 00 00 03 D3 34 31
				29 01 00 00 00 00 03 D4 31 31
				29 01 00 00 00 00 03 D5 00 02
				29 01 00 00 00 00 03 D6 10 12
				29 01 00 00 00 00 03 D7 14 16
				29 01 00 00 00 00 03 E6 32 32
				29 01 00 00 00 00 06 D8 00 00 00 00 00
				29 01 00 00 00 00 06 D9 00 00 00 00 00
				29 01 00 00 00 00 02 E7 00
				29 01 00 00 00 00 06 F0 55 AA 52 08 05
				29 01 00 00 00 00 02 ED 30
				29 01 00 00 00 00 03 B0 17 06
				29 01 00 00 00 00 02 B8 00
				29 01 00 00 00 00 02 C0 0D
				29 01 00 00 00 00 02 C1 0B
				29 01 00 00 00 00 02 C2 23
				29 01 00 00 00 00 02 C3 40
				29 01 00 00 00 00 02 C4 84
				29 01 00 00 00 00 02 C5 82
				29 01 00 00 00 00 02 C6 82
				29 01 00 00 00 00 02 C7 80
				29 01 00 00 00 00 03 C8 0B 30
				29 01 00 00 00 00 03 C9 05 10
				29 01 00 00 00 00 03 CA 01 10
				29 01 00 00 00 00 03 CB 01 10
				29 01 00 00 00 00 06 D1 03 05 05 07 00
				29 01 00 00 00 00 06 D2 03 05 09 03 00
				29 01 00 00 00 00 06 D3 00 00 6A 07 10
				29 01 00 00 00 00 06 D4 30 00 6A 07 10
				29 01 00 00 00 00 06 F0 55 AA 52 08 03
				29 01 00 00 00 00 03 B0 00 00
				29 01 00 00 00 00 03 B1 00 00
				29 01 00 00 00 00 06 B2 05 00 0A 00 00
				29 01 00 00 00 00 06 B3 05 00 0A 00 00
				29 01 00 00 00 00 06 B4 05 00 0A 00 00
				29 01 00 00 00 00 06 B5 05 00 0A 00 00
				29 01 00 00 00 00 06 B6 02 00 0A 00 00
				29 01 00 00 00 00 06 B7 02 00 0A 00 00
				29 01 00 00 00 00 06 B8 02 00 0A 00 00
				29 01 00 00 00 00 06 B9 02 00 0A 00 00
				29 01 00 00 00 00 06 BA 53 00 0A 00 00
				29 01 00 00 00 00 06 BB 53 00 0A 00 00
				29 01 00 00 00 00 06 BC 53 00 0A 00 00
				29 01 00 00 00 00 06 BD 53 00 0A 00 00
				29 01 00 00 00 00 02 C4 60
				29 01 00 00 00 00 02 C5 40
				29 01 00 00 00 00 02 C6 64
				29 01 00 00 00 00 02 C7 44
				29 01 00 00 00 00 02 53 2C
				29 01 00 00 00 00 02 55 82
				05 01 00 00 78 00 02 11 00
				05 01 00 00 14 00 02 29 00];
		hw,lcdkit-panel-on-command-state = "dsi_lp_mode";
		hw,lcdkit-panel-off-command = [05 01 00 00 20 00 02 28 00
					05 01 00 00 78 00 02 10 00];
		hw,lcdkit-panel-off-command-state = "dsi_lp_mode";
		hw,lcdkit-panel-backlight-command = [15 01 00 00 00 00 02 51 00];
		hw,lcdkit-panel-backlight-command-state = "dsi_lp_mode";
		hw,lcdkit-panel-cabc-off-command = [15 01 00 00 0a 00 02 55 00];
		hw,lcdkit-panel-cabc-off-command-state = "dsi_lp_mode";
		hw,lcdkit-panel-cabc-ui-command = [15 01 00 00 0a 00 02 55 01
				  15 01 00 00 0a 00 02 53 2C];
		hw,lcdkit-panel-cabc-ui-command-state = "dsi_lp_mode";
		hw,lcdkit-panel-cabc-still-command = [15 01 00 00 0a 00 02 55 82
				     15 01 00 00 0a 00 02 53 2C];
		hw,lcdkit-panel-cabc-still-command-state = "dsi_lp_mode";
		hw,lcdkit-panel-cabc-moving-command = [15 01 00 00 0a 00 02 55 03
				      15 01 00 00 0a 00 02 53 2C];
		hw,lcdkit-panel-cabc-moving-command-state = "dsi_lp_mode";
		hw,lcdkit-panel-cabc-support = <1>;
		hw,lcdkit-panel-inversion-support = <0>;
		hw,lcdkit-panel-scan-support = <0>;
		hw,lcdkit-panel-display-region-support = <0>;
		hw,lcdkit-panel-checksum-support = <0>;
		hw,lcdkit-panel-esd-reg-command = [06 01 00 00 0a 00 01 0a];
		hw,lcdkit-panel-esd-reg-command-state = "dsi_lp_mode";
		hw,lcdkit-panel-esd-value = [9c];
		hw,lcdkit-panel-esd-support = <1>;
		hw,lcdkit-panel-check-reg-support = <0>;
		hw,lcdkit-panel-mipi-detect-support = <0>;
		hw,lcdkit-panel-shutdown-sleep-support = <0>;
		hw,lcdkit-dsi-bpp = <24>;
		hw,lcdkit-panel-cmd-type = <0>;
		hw,lcdkit-pixel-packing = <0>;
		hw,lcdkit-underflow-color = <0x00>;
		hw,lcdkit-border-color = <0>;
		hw,lcdkit-panel-orientation = <0>;
		hw,lcdkit-brightness-max-level = <255>;
		hw,lcdkit-bl-min-level = <4>;
		hw,lcdkit-bl-max-level = <255>;
		hw,lcdkit-interleave-mode = <0>;
		hw,lcdkit-te-using-te-pin;
		hw,lcdkit-h-sync-pulse = <1>;
		hw,lcdkit-bllp-power-mode;
		hw,lcdkit-bllp-eof-power-mode;
		hw,lcdkit-traffic-mode = "burst_mode";
		hw,lcdkit-te-dcs-command = <1>;
		hw,lcdkit-te-pin-select = <1>;
		hw,lcdkit-virtual-channel-id = <0>;
		hw,lcdkit-color-order = "rgb_swap_rgb";
		hw,lcdkit-lane-0-state;
		hw,lcdkit-lane-1-state;
		hw,lcdkit-lane-2-state;
		hw,lcdkit-lane-3-state;
		hw,lcdkit-h-left-border = <0>;
		hw,lcdkit-h-right-border = <0>;
		hw,lcdkit-v-top-border = <0>;
		hw,lcdkit-v-bottom-border = <0>;
		hw,lcdkit-panel-framerate = <60>;
		hw,lcdkit-panel-clockrate = <431180000>;
		hw,lcdkit-panel-timings = [7A 1A 12 00 40 42 16 1E 14 03 04 00];
		hw,lcdkit-t-clk-pre = <0x1A>;
		hw,lcdkit-t-clk-post = <0x04>;
		hw,lcdkit-tx-eot-append;
		hw,lcdkit-stream = <0>;
		hw,lcdkit-lp11-init;
		hw,lcdkit-mdp-trigger = "none";
		hw,lcdkit-dma-trigger = "trigger_sw";
		hw,lcdkit-bl-pmic-control-type = "bl_ctrl_dcs";
		qcom,panel-supply-entries = <&dsi_panel_pwr_supply>;
		hw,lcdkit-lane-map = "lane_map_0123";
		hw,lcdkit-delay-before-bl = <0>;
		hw,lcdkit-mipi-regulator-mode = <0>;
		hw,lcdkit-bl-en-gpio = <0>;
		hw,lcdkit-delay-af-rst-off = <20>;
		hw,lcdkit-delay-af-blic-init = <0>;
		hw,lcdkit-bl-level-limit-percent = <100>;
		hw,lcdkit-use-second-ic-for-esd = <0>;
		hw,lcdkit-esd-check-num = <3>;
		hw,lcdkit-h-back-porch = <80>;
		hw,lcdkit-h-front-porch = <86>;
		hw,lcdkit-h-pulse-width = <20>;
		hw,lcdkit-v-back-porch = <12>;
		hw,lcdkit-v-pulse-width = <8>;
		hw,lcdkit-v-front-porch = <22>;
		hw,lcdkit-h-sync-skew = <0>;
		hw,lcdkit-lcd-type = <0>;
		hw,lcdkit-panel-pt-test-support = <1>;
		hw,lcdkit-bias-power-ctrl-mode = <0x02>;
		hw,lcdkit-iovcc-power-ctrl-mode = <0x01>;
		hw,lcdkit-vci-power-ctrl-mode = <0x02>;
		hw,lcdkit-id0-gpio = <59>;
		hw,lcdkit-id1-gpio = <66>;
		hw,lcdkit-reset-gpio = <60>;
		hw,lcdkit-te-gpio = <0>;
		hw,lcdkit-vsp-gpio = <46>;
		hw,lcdkit-vsn-gpio = <45>;
		hw,lcdkit-iovcc-gpio = <0>;
		hw,lcdkit-vci-gpio = <0>;
		hw,lcdkit-bl-gpio = <0>;
		hw,lcdkit-iovcc-on-is-need-reset = <0>;
		hw,lcdkit-vsn-on-is-need-reset = <0>;
		hw,lcdkit-lcd-vsp = <5500000>;
		hw,lcdkit-lcd-vsn = <5500000>;
		hw,lcdkit-lcd-rst-first-high = <20>;
		hw,lcdkit-lcd-rst-low = <2>;
		hw,lcdkit-lcd-rst-second-high = <20>;
		hw,lcdkit-delay-af-vci-on = <0>;
		hw,lcdkit-delay-af-iovcc-on = <0>;
		hw,lcdkit-delay-af-bias-on = <0>;
		hw,lcdkit-delay-af-vsp-on = <20>;
		hw,lcdkit-delay-af-vsn-on = <20>;
		hw,lcdkit-delay-af-lp11 = <0>;
		hw,lcdkit-delay-af-tp-reset = <25>;
		hw,lcdkit-delay-af-vsn-off = <3>;
		hw,lcdkit-delay-af-vsp-off = <0>;
		hw,lcdkit-delay-af-bias-off = <0>;
		hw,lcdkit-delay-af-iovcc-off = <0>;
		hw,lcdkit-delay-af-vci-off = <0>;
		hw,lcdkit-panel-off-reset-high = <0>;
    };
};