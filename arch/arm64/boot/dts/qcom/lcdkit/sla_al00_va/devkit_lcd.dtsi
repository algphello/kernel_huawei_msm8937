/*---------------------------------------------------------------------------
 * This file is autogenerated file using huawei LCD parser. Please do not edit it.
 * Update input XML file to add a new entry or update variable in this file
 * Parser location: vendor/huawei/chipset_common/devkit/lcdkit/tools 
 *---------------------------------------------------------------------------*/


#include "sla_al00_va_boe_otm1289_5p0_720p_video.dtsi"
#include "sla_al00_va_djn_ili9881cs_5p0_720p_video.dtsi"
#include "sla_al00_va_ofilm_nt35521s_5p0_720p_video.dtsi"
#include "sla_al00_va_ofilm_nt35521sb_5p0_720p_video.dtsi"
#include "sla_al00_va_txd_ili9881cs_5p0_720p_video.dtsi"