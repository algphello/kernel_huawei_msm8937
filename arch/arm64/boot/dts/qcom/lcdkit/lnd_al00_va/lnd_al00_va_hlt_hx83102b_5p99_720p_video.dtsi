/* Copyright (c) 2013, The Linux Foundation. All rights reserved.
 *
 * This program is free software; you can redistribute it and/or modify
 * it under the terms of the GNU General Public License version 2 and
 * only version 2 as published by the Free Software Foundation.
 *
 * This program is distributed in the hope that it will be useful,
 * but WITHOUT ANY WARRANTY; without even the implied warranty of
 * MERCHANTABILITY or FITNESS FOR A PARTICULAR PURPOSE.  See the
 * GNU General Public License for more details.
 */

/*-------------------------------------------------------------------------
 * This file is autogenerated file using gcdb parser. Please do not edit it.
 * Update input XML file to add a new entry or update variable in this file
 * VERSION = 1.1
 *-----------------------------------------------------------------------*/
/ {
	dsi_lnd_al00_va_hlt_hx83102b_5p99_720p_video: lcdkit_lnd_al00_va_hlt_hx83102b_5p99_720p_video {
		compatible = "hlt-hx83102b-5p99-720p-video";
		hw,lcdkit-panel-name = "HLT_HX83102B 5P99 VIDEO TFT 720 x 1440";
		hw,lcdkit-panel-type = <0x01>;
		hw,lcdkit-panel-xres = <720>;
		hw,lcdkit-panel-yres = <1440>;
		hw,lcdkit-panel-width = <68>;
		hw,lcdkit-panel-height = <136>;
		hw,lcdkit-panel-on-command = [39 01 00 00 00 00 04 B9 83 10 2B
				39 01 00 00 00 00 0e B1 04 2A 27 27 33 7A 02 83 03 AF 43 CC 33
				39 01 00 00 00 00 0f B2 00 00 78 00 10 C8 7E 00 00 00 00 14 60 D7
				39 01 00 00 00 00 0f B4 69 50 69 50 69 50 69 50 03 60 01 20 00 FF
				39 01 00 00 00 00 02 CC 02
				39 01 00 00 00 00 28 D3 00 00 01 01 01 01 01 01 01 00 08 00 47 00 44 47 0B 0B 00 00 32 10 09 00 09 32 10 07 00 07 32 10 08 00 00 00 00 00 00
				39 01 00 00 00 00 2d D5 18 18 3A 3A 18 18 04 05 06 07 00 01 02 03 18 18 BA BA 19 19 20 21 22 23 18 18 18 18 18 18 18 18 18 18 18 18 18 18 18 18 18 18 18 18
				39 01 00 00 00 00 2d D6 18 18 3A 3A 19 19 03 02 01 00 07 06 05 04 18 18 3A 3A 18 18 23 22 21 20 18 18 18 18 18 18 18 18 18 18 18 18 18 18 18 18 18 18 18 18
				39 01 00 00 00 00 1c E7 14 14 12 82 10 82 00 00 00 00 00 00 FF 0F 14 14 32 B9 23 B9 00 00 28 00 00 00 07
				39 01 00 00 00 00 02 BD 01
				39 01 00 00 00 00 0a E7 01 07 40 01 40 13 44 14 01
				39 01 00 00 00 00 02 BD 00
				39 01 00 00 00 00 04 B6 9E 9E E0
				39 01 00 00 00 00 02 C1 01
				39 01 00 00 00 00 02 BD 01              
				39 01 00 00 00 00 3a C1 00 11 21 2C 35 3D 43 4D 51 54 58 5B 5D 60 62 65 67 69 6B 6E 72 75 79 7C 7F 83 86 8A 8D 91 96 9A 9F A4 AA B1 B8 C1 CC DA E4 EA F1 F9 FF 37 84 30 EC 53 61 88 F2 64 91 03 00
				39 01 00 00 00 00 02 BD 02
				39 01 00 00 00 00 3a C1 00 11 21 2C 35 3D 43 4D 51 54 58 5B 5D 60 62 65 67 69 6B 6E 72 75 79 7C 7F 83 86 8A 8D 91 96 9A 9F A4 AA B1 B8 C1 CC DA E4 EA F1 F9 FF 37 84 30 EC 53 61 88 F2 64 91 03 00
				39 01 00 00 00 00 02 BD 03
				39 01 00 00 00 00 3a C1 00 11 21 2C 35 3D 43 4D 51 54 58 5B 5D 60 62 65 67 69 6B 6E 72 75 79 7C 7F 83 86 8A 8D 91 96 9A 9F A4 AA B1 B8 C1 CC DA E4 EA F1 F9 FF 37 84 30 EC 53 61 88 F2 64 91 03 00
				39 01 00 00 00 00 02 BD 00
				39 01 00 00 00 00 02 BD 02
				39 01 00 00 00 00 07 B4 C0 00 9B 1B 00 88
				39 01 00 00 00 00 02 BD 00
				39 01 00 00 00 00 08 C8 00 00 00 00 00 00 00
				39 01 00 00 00 00 06 BF 00 00 00 04 83
				39 01 00 00 00 00 0b C7 00 C2 30 02 42 00 00 00 00 08
				39 01 00 00 00 00 02 D9 02
				39 01 00 00 78 00 02 11 00
				39 01 00 00 14 00 02 29 00];
		hw,lcdkit-panel-on-command-state = "dsi_lp_mode";
		hw,lcdkit-panel-display-on-command = [39 01 00 00 78 00 02 11 00
				39 01 00 00 14 00 02 29 00];
		hw,lcdkit-panel-off-command = [05 01 00 00 0A 00 02 28 00
                05 01 00 00 78 00 02 10 00];
		hw,lcdkit-panel-off-command-state = "dsi_hs_mode";
		hw,lcdkit-panel-backlight-command = [39 01 00 00 00 00 02 51 00];
		hw,lcdkit-panel-backlight-command-state = "dsi_lp_mode";
		hw,lcdkit-panel-cabc-off-command = [15 01 00 00 0a 00 02 55 00];
		hw,lcdkit-panel-cabc-off-command-state = "dsi_lp_mode";
		hw,lcdkit-panel-cabc-ui-command = [15 01 00 00 0a 00 02 55 01
				  15 01 00 00 0a 00 02 53 2C];
		hw,lcdkit-panel-cabc-ui-command-state = "dsi_lp_mode";
		hw,lcdkit-panel-cabc-still-command = [15 01 00 00 0a 00 02 55 02
				     15 01 00 00 0a 00 02 53 2C];
		hw,lcdkit-panel-cabc-still-command-state = "dsi_lp_mode";
		hw,lcdkit-panel-cabc-moving-command = [15 01 00 00 0a 00 02 55 03
				      15 01 00 00 0a 00 02 53 2C];
		hw,lcdkit-panel-cabc-moving-command-state = "dsi_lp_mode";
		hw,lcdkit-panel-cabc-support = <0>;
		hw,lcdkit-panel-dot-inversion-command = [39 01 00 00 00 00 0f B2 01 00 78 00 10 C8 7E 00 00 00 00 14 60 D7];
		hw,lcdkit-panel-dot-inversion-command-state = "dsi_lp_mode";
		hw,lcdkit-panel-column-inversion-command = [39 01 00 00 00 00 0f B2 00 00 78 00 10 C8 7E 00 00 00 00 14 60 D7];
		hw,lcdkit-panel-column-inversion-command-state = "dsi_lp_mode";
		hw,lcdkit-panel-inversion-support = <1>;
		hw,lcdkit-panel-forword-scan-command = [39 01 00 00 00 00 02 CC 0e];
		hw,lcdkit-panel-forword-scan-command-state = "dsi_lp_mode";
		hw,lcdkit-panel-revert-scan-command = [39 01 00 00 00 00 02 CC 02];
		hw,lcdkit-panel-revert-scan-command-state = "dsi_lp_mode";
		hw,lcdkit-panel-scan-support = <1>;
		hw,lcdkit-panel-display-region-support = <0>;
		hw,lcdkit-panel-checksum-support = <0>;
		hw,lcdkit-panel-esd-reg-command = [14 01 00 00 0a 00 01 0a];
		hw,lcdkit-panel-esd-reg-command-state = "dsi_lp_mode";
		hw,lcdkit-panel-esd-value = [9d];
		hw,lcdkit-panel-esd-support = <1>;
		hw,lcdkit-panel-check-reg-command = [14 01 00 00 0a 00 01 0a];
		hw,lcdkit-panel-check-reg-value = [9d];
		hw,lcdkit-panel-check-reg-command-state = "dsi_lp_mode";
		hw,lcdkit-panel-check-reg-support = <1>;
		hw,lcdkit-panel-mipi-detect-support = <0>;
		hw,lcdkit-panel-shutdown-sleep-support = <0>;
		hw,lcdkit-dsi-bpp = <24>;
		hw,lcdkit-panel-cmd-type = <0>;
		hw,lcdkit-pixel-packing = <0>;
		hw,lcdkit-underflow-color = <0x00>;
		hw,lcdkit-border-color = <0>;
		hw,lcdkit-panel-orientation = <0>;
		hw,lcdkit-brightness-max-level = <4095>;
		hw,lcdkit-bl-min-level = <24>;
		hw,lcdkit-bl-max-level = <4095>;
		hw,lcdkit-interleave-mode = <0>;
		hw,lcdkit-h-sync-pulse = <1>;
		hw,lcdkit-bllp-power-mode;
		hw,lcdkit-bllp-eof-power-mode;
		hw,lcdkit-traffic-mode = "burst_mode";
		hw,lcdkit-te-dcs-command = <0>;
		hw,lcdkit-te-pin-select = <0>;
		hw,lcdkit-virtual-channel-id = <0>;
		hw,lcdkit-color-order = "rgb_swap_rgb";
		hw,lcdkit-lane-0-state;
		hw,lcdkit-lane-1-state;
		hw,lcdkit-lane-2-state;
		hw,lcdkit-lane-3-state;
		hw,lcdkit-h-left-border = <0>;
		hw,lcdkit-h-right-border = <0>;
		hw,lcdkit-v-top-border = <0>;
		hw,lcdkit-v-bottom-border = <0>;
		hw,lcdkit-panel-framerate = <60>;
		hw,lcdkit-panel-clockrate = <505680000>;
		hw,lcdkit-panel-timings = [8c 20 14 00 46 48 1a 22 18 03 04 00];
		hw,lcdkit-t-clk-pre = <0x28>;
		hw,lcdkit-t-clk-post = <0x04>;
		hw,lcdkit-tx-eot-append;
		hw,lcdkit-stream = <0>;
		hw,lcdkit-lp11-init;
		hw,lcdkit-mdp-trigger = "none";
		hw,lcdkit-dma-trigger = "trigger_sw";
		hw,lcdkit-bl-pmic-control-type = "bl_ctrl_wled";
		qcom,panel-supply-entries = <&dsi_panel_pwr_supply>;
		hw,lcdkit-lane-map = "lane_map_0123";
		hw,lcdkit-delay-before-bl = <0>;
		hw,lcdkit-mipi-regulator-mode = <1>;
		hw,lcdkit-bl-en-gpio = <0>;
		hw,lcdkit-delay-af-rst-off = <20>;
		hw,lcdkit-delay-af-blic-init = <0>;
		hw,lcdkit-bl-level-limit-percent = <100>;
		hw,lcdkit-use-second-ic-for-esd = <0>;
		hw,lcdkit-esd-check-num = <3>;
		hw,lcdkit-h-back-porch = <40>;
		hw,lcdkit-h-front-porch = <40>;
		hw,lcdkit-h-pulse-width = <20>;
		hw,lcdkit-v-back-porch = <16>;
		hw,lcdkit-v-pulse-width = <2>;
		hw,lcdkit-v-front-porch = <255>;
		hw,lcdkit-h-sync-skew = <0>;
		hw,lcdkit-lcd-type = <2>;
		hw,lcdkit-panel-pt-test-support = <1>;
		hw,lcdkit-bias-power-ctrl-mode = <0x01>;
		hw,lcdkit-iovcc-power-ctrl-mode = <0x01>;
		hw,lcdkit-vci-power-ctrl-mode = <0x01>;
		hw,lcdkit-id0-gpio = <59>;
		hw,lcdkit-id1-gpio = <48>;
		hw,lcdkit-reset-gpio = <60>;
		hw,lcdkit-te-gpio = <0>;
		hw,lcdkit-vsp-gpio = <0>;
		hw,lcdkit-vsn-gpio = <0>;
		hw,lcdkit-iovcc-gpio = <0>;
		hw,lcdkit-vci-gpio = <0>;
		hw,lcdkit-bl-gpio = <0>;
		hw,lcdkit-iovcc-on-is-need-reset = <0>;
		hw,lcdkit-vsn-on-is-need-reset = <0>;
		hw,lcdkit-lcd-vsp = <6000000>;
		hw,lcdkit-lcd-vsn = <6000000>;
		hw,lcdkit-lcd-rst-first-high = <5>;
		hw,lcdkit-lcd-rst-low = <5>;
		hw,lcdkit-lcd-rst-second-high = <50>;
		hw,lcdkit-delay-af-vci-on = <0>;
		hw,lcdkit-delay-af-iovcc-on = <0>;
		hw,lcdkit-delay-af-bias-on = <0>;
		hw,lcdkit-delay-af-vsp-on = <5>;
		hw,lcdkit-delay-af-vsn-on = <5>;
		hw,lcdkit-delay-af-lp11 = <0>;
		hw,lcdkit-delay-af-tp-reset = <25>;
		hw,lcdkit-delay-af-vsn-off = <3>;
		hw,lcdkit-delay-af-vsp-off = <5>;
		hw,lcdkit-delay-af-bias-off = <0>;
		hw,lcdkit-delay-af-iovcc-off = <0>;
		hw,lcdkit-delay-af-vci-off = <0>;
		hw,lcdkit-panel-off-reset-high = <0>;
    };
};