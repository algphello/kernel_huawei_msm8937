/* Copyright (c) 2013, The Linux Foundation. All rights reserved.
 *
 * This program is free software; you can redistribute it and/or modify
 * it under the terms of the GNU General Public License version 2 and
 * only version 2 as published by the Free Software Foundation.
 *
 * This program is distributed in the hope that it will be useful,
 * but WITHOUT ANY WARRANTY; without even the implied warranty of
 * MERCHANTABILITY or FITNESS FOR A PARTICULAR PURPOSE.  See the
 * GNU General Public License for more details.
 */

/*-------------------------------------------------------------------------
 * This file is autogenerated file using gcdb parser. Please do not edit it.
 * Update input XML file to add a new entry or update variable in this file
 * VERSION = 1.1
 *-----------------------------------------------------------------------*/
/ {
	dsi_lnd_al00_va_djn_nt35596_5p99_720p_video: lcdkit_lnd_al00_va_djn_nt35596_5p99_720p_video {
		compatible = "djn-nt35596-5p99-720p-video";
		hw,lcdkit-panel-name = "DJN_NT35596 5P99 VIDEO TFT 720 x 1440";
		hw,lcdkit-panel-type = <0x01>;
		hw,lcdkit-panel-xres = <720>;
		hw,lcdkit-panel-yres = <1440>;
		hw,lcdkit-panel-width = <68>;
		hw,lcdkit-panel-height = <136>;
		hw,lcdkit-panel-on-command = [39 01 00 00 00 00 02 FF EE
                    39 01 00 00 0A 00 02 18 40
                    39 01 00 00 14 00 02 18 00
                    39 01 00 00 00 00 02 FF 01
                    39 01 00 00 00 00 02 00 01
                    39 01 00 00 00 00 02 01 55
                    39 01 00 00 00 00 02 02 40
                    39 01 00 00 00 00 02 05 50
                    39 01 00 00 00 00 02 06 4A
                    39 01 00 00 00 00 02 07 29
                    39 01 00 00 00 00 02 08 0C
                    39 01 00 00 00 00 02 0B 9B
                    39 01 00 00 00 00 02 0C 9B
                    39 01 00 00 00 00 02 0E B0
                    39 01 00 00 00 00 02 0F AE
                    39 01 00 00 00 00 02 13 03
                    39 01 00 00 00 00 02 14 4A
                    39 01 00 00 00 00 02 15 12
                    39 01 00 00 00 00 02 16 12
                    39 01 00 00 00 00 02 58 82
                    39 01 00 00 00 00 02 59 02
                    39 01 00 00 00 00 02 5A 02
                    39 01 00 00 00 00 02 5B 02
                    39 01 00 00 00 00 02 5C 82
                    39 01 00 00 00 00 02 5D 82
                    39 01 00 00 00 00 02 5E 02
                    39 01 00 00 00 00 02 5F 02
                    39 01 00 00 00 00 02 72 31
                    39 01 00 00 00 00 02 FB 01
                    39 01 00 00 00 00 02 FF 05
                    39 01 00 00 00 00 02 00 01
                    39 01 00 00 00 00 02 01 0B
                    39 01 00 00 00 00 02 02 0C
                    39 01 00 00 00 00 02 03 09
                    39 01 00 00 00 00 02 04 0A
                    39 01 00 00 00 00 02 05 1A
                    39 01 00 00 00 00 02 06 10
                    39 01 00 00 00 00 02 07 00
                    39 01 00 00 00 00 02 08 1A
                    39 01 00 00 00 00 02 09 00
                    39 01 00 00 00 00 02 0A 00
                    39 01 00 00 00 00 02 0B 00
                    39 01 00 00 00 00 02 0C 00
                    39 01 00 00 00 00 02 0D 13
                    39 01 00 00 00 00 02 0E 15
                    39 01 00 00 00 00 02 0F 17
                    39 01 00 00 00 00 02 10 01
                    39 01 00 00 00 00 02 11 0B
                    39 01 00 00 00 00 02 12 0C
                    39 01 00 00 00 00 02 13 09
                    39 01 00 00 00 00 02 14 0A
                    39 01 00 00 00 00 02 15 1A
                    39 01 00 00 00 00 02 16 10
                    39 01 00 00 00 00 02 17 10
                    39 01 00 00 00 00 02 18 1A
                    39 01 00 00 00 00 02 19 00
                    39 01 00 00 00 00 02 1A 00
                    39 01 00 00 00 00 02 1B 00
                    39 01 00 00 00 00 02 1C 00
                    39 01 00 00 00 00 02 1D 13
                    39 01 00 00 00 00 02 1E 15
                    39 01 00 00 00 00 02 1F 17
                    39 01 00 00 00 00 02 20 00
                    39 01 00 00 00 00 02 21 03
                    39 01 00 00 00 00 02 22 01
                    39 01 00 00 00 00 02 23 4D
                    39 01 00 00 00 00 02 24 4D
                    39 01 00 00 00 00 02 25 6D
                    39 01 00 00 00 00 02 29 D8
                    39 01 00 00 00 00 02 2A 2A
                    39 01 00 00 00 00 02 2B 00
                    39 01 00 00 00 00 02 B6 92
                    39 01 00 00 00 00 02 B7 B4
                    39 01 00 00 00 00 02 B8 05
                    39 01 00 00 00 00 02 4B 04
                    39 01 00 00 00 00 02 4C 14
                    39 01 00 00 00 00 02 4D 00
                    39 01 00 00 00 00 02 4E 22
                    39 01 00 00 00 00 02 4F 22
                    39 01 00 00 00 00 02 50 00
                    39 01 00 00 00 00 02 51 61
                    39 01 00 00 00 00 02 52 01
                    39 01 00 00 00 00 02 53 01
                    39 01 00 00 00 00 02 54 A0
                    39 01 00 00 00 00 02 55 6D
                    39 01 00 00 00 00 02 5B 44
                    39 01 00 00 00 00 02 5C 00
                    39 01 00 00 00 00 02 5F 74
                    39 01 00 00 00 00 02 60 75
                    39 01 00 00 00 00 02 63 FF
                    39 01 00 00 00 00 02 64 00
                    39 01 00 00 00 00 02 67 04
                    39 01 00 00 00 00 02 68 04
                    39 01 00 00 00 00 02 6C 00
                    39 01 00 00 00 00 02 7A 80
                    39 01 00 00 00 00 02 7B A3
                    39 01 00 00 00 00 02 7C D8
                    39 01 00 00 00 00 02 7D 60
                    39 01 00 00 00 00 02 7E 0E
                    39 01 00 00 00 00 02 7F 23
                    39 01 00 00 00 00 02 80 00
                    39 01 00 00 00 00 02 81 07
                    39 01 00 00 00 00 02 83 00
                    39 01 00 00 00 00 02 84 07
                    39 01 00 00 00 00 02 85 07
                    39 01 00 00 00 00 02 90 38
                    39 01 00 00 00 00 02 92 A9
                    39 01 00 00 00 00 02 93 06
                    39 01 00 00 00 00 02 94 06
                    39 01 00 00 00 00 02 8A 33
                    39 01 00 00 00 00 02 9B 0F
                    39 01 00 00 00 00 02 9D B0
                    39 01 00 00 00 00 02 A4 0F
                    39 01 00 00 00 00 02 E7 80
                    39 01 00 00 00 00 02 FB 01
                    39 01 00 00 00 00 02 FF 00
                    39 01 00 00 00 00 02 D3 06
                    39 01 00 00 00 00 02 D4 06
                    39 01 00 00 00 00 02 35 00
                    29 01 00 00 64 00 02 11 00
                    29 01 00 00 28 00 02 29 00];
		hw,lcdkit-panel-on-command-state = "dsi_lp_mode";
		hw,lcdkit-panel-display-on-command = [29 01 00 00 64 00 02 11 00
				29 01 00 00 28 00 02 29 00];
		hw,lcdkit-panel-off-command = [29 01 00 00 14 00 02 28 00
				29 01 00 00 78 00 02 10 00];
		hw,lcdkit-panel-off-command-state = "dsi_hs_mode";
		hw,lcdkit-panel-backlight-command = [39 01 00 00 00 00 02 51 00];
		hw,lcdkit-panel-backlight-command-state = "dsi_lp_mode";
		hw,lcdkit-panel-cabc-off-command = [15 01 00 00 0a 00 02 55 00];
		hw,lcdkit-panel-cabc-off-command-state = "dsi_lp_mode";
		hw,lcdkit-panel-cabc-ui-command = [15 01 00 00 0a 00 02 55 01
				  15 01 00 00 0a 00 02 53 2C];
		hw,lcdkit-panel-cabc-ui-command-state = "dsi_lp_mode";
		hw,lcdkit-panel-cabc-still-command = [15 01 00 00 0a 00 02 55 02
				     15 01 00 00 0a 00 02 53 2C];
		hw,lcdkit-panel-cabc-still-command-state = "dsi_lp_mode";
		hw,lcdkit-panel-cabc-moving-command = [15 01 00 00 0a 00 02 55 03
				      15 01 00 00 0a 00 02 53 2C];
		hw,lcdkit-panel-cabc-moving-command-state = "dsi_lp_mode";
		hw,lcdkit-panel-cabc-support = <0>;
		hw,lcdkit-panel-dot-inversion-command = [29 01 00 00 00 00 02 ff 05
			29 01 00 00 00 00 02 9b 00
			29 01 00 00 00 00 02 ff 00];
		hw,lcdkit-panel-dot-inversion-command-state = "dsi_lp_mode";
		hw,lcdkit-panel-column-inversion-command = [29 01 00 00 00 00 02 ff 05
			29 01 00 00 00 00 02 9b 0f
			29 01 00 00 00 00 02 ff 00];
		hw,lcdkit-panel-column-inversion-command-state = "dsi_lp_mode";
		hw,lcdkit-panel-inversion-support = <1>;
		hw,lcdkit-panel-forword-scan-command = [29 01 00 00 00 00 02 ff 05
			29 01 00 00 00 00 02 9D B6
			29 01 00 00 00 00 02 ff 00];
		hw,lcdkit-panel-forword-scan-command-state = "dsi_lp_mode";
		hw,lcdkit-panel-revert-scan-command = [29 01 00 00 00 00 02 ff 05
			29 01 00 00 00 00 02 9D B0
			29 01 00 00 00 00 02 ff 00];
		hw,lcdkit-panel-revert-scan-command-state = "dsi_lp_mode";
		hw,lcdkit-panel-scan-support = <1>;
		hw,lcdkit-panel-display-region-support = <0>;
		hw,lcdkit-panel-checksum-support = <0>;
		hw,lcdkit-panel-esd-reg-command = [06 01 00 00 0a 00 01 0a];
		hw,lcdkit-panel-esd-reg-command-state = "dsi_lp_mode";
		hw,lcdkit-panel-esd-value = [9c];
		hw,lcdkit-panel-esd-support = <0>;
		hw,lcdkit-panel-check-reg-command = [06 01 00 00 0a 00 01 0a];
		hw,lcdkit-panel-check-reg-value = [9c];
		hw,lcdkit-panel-check-reg-command-state = "dsi_lp_mode";
		hw,lcdkit-panel-check-reg-support = <1>;
		hw,lcdkit-panel-mipi-detect-support = <0>;
		hw,lcdkit-panel-shutdown-sleep-support = <0>;
		hw,lcdkit-dsi-bpp = <24>;
		hw,lcdkit-panel-cmd-type = <0>;
		hw,lcdkit-pixel-packing = <0>;
		hw,lcdkit-underflow-color = <0x00>;
		hw,lcdkit-border-color = <0>;
		hw,lcdkit-panel-orientation = <0>;
		hw,lcdkit-brightness-max-level = <4095>;
		hw,lcdkit-bl-min-level = <24>;
		hw,lcdkit-bl-max-level = <4095>;
		hw,lcdkit-interleave-mode = <0>;
		hw,lcdkit-te-using-te-pin;
		hw,lcdkit-h-sync-pulse = <1>;
		hw,lcdkit-bllp-power-mode;
		hw,lcdkit-bllp-eof-power-mode;
		hw,lcdkit-traffic-mode = "burst_mode";
		hw,lcdkit-te-dcs-command = <1>;
		hw,lcdkit-te-pin-select = <1>;
		hw,lcdkit-virtual-channel-id = <0>;
		hw,lcdkit-color-order = "rgb_swap_rgb";
		hw,lcdkit-lane-0-state;
		hw,lcdkit-lane-1-state;
		hw,lcdkit-lane-2-state;
		hw,lcdkit-lane-3-state;
		hw,lcdkit-h-left-border = <0>;
		hw,lcdkit-h-right-border = <0>;
		hw,lcdkit-v-top-border = <0>;
		hw,lcdkit-v-bottom-border = <0>;
		hw,lcdkit-panel-framerate = <60>;
		hw,lcdkit-panel-clockrate = <428630000>;
		hw,lcdkit-panel-timings = [7A 1A 12 00 3E 42 16 1E 14 03 04 00];
		hw,lcdkit-t-clk-pre = <0x26>;
		hw,lcdkit-t-clk-post = <0x04>;
		hw,lcdkit-tx-eot-append;
		hw,lcdkit-stream = <0>;
		hw,lcdkit-lp11-init;
		hw,lcdkit-mdp-trigger = "none";
		hw,lcdkit-dma-trigger = "trigger_sw";
		hw,lcdkit-bl-pmic-control-type = "bl_ctrl_wled";
		qcom,panel-supply-entries = <&dsi_panel_pwr_supply>;
		hw,lcdkit-lane-map = "lane_map_0123";
		hw,lcdkit-delay-before-bl = <0>;
		hw,lcdkit-mipi-regulator-mode = <1>;
		hw,lcdkit-bl-en-gpio = <0>;
		hw,lcdkit-delay-af-rst-off = <20>;
		hw,lcdkit-delay-af-blic-init = <0>;
		hw,lcdkit-bl-level-limit-percent = <100>;
		hw,lcdkit-use-second-ic-for-esd = <0>;
		hw,lcdkit-esd-check-num = <3>;
		hw,lcdkit-h-back-porch = <40>;
		hw,lcdkit-h-front-porch = <52>;
		hw,lcdkit-h-pulse-width = <8>;
		hw,lcdkit-v-back-porch = <4>;
		hw,lcdkit-v-pulse-width = <2>;
		hw,lcdkit-v-front-porch = <6>;
		hw,lcdkit-h-sync-skew = <0>;
		hw,lcdkit-lcd-type = <0>;
		hw,lcdkit-panel-pt-test-support = <1>;
		hw,lcdkit-bias-power-ctrl-mode = <0x01>;
		hw,lcdkit-iovcc-power-ctrl-mode = <0x01>;
		hw,lcdkit-vci-power-ctrl-mode = <0x01>;
		hw,lcdkit-id0-gpio = <59>;
		hw,lcdkit-id1-gpio = <48>;
		hw,lcdkit-reset-gpio = <60>;
		hw,lcdkit-te-gpio = <0>;
		hw,lcdkit-vsp-gpio = <0>;
		hw,lcdkit-vsn-gpio = <0>;
		hw,lcdkit-iovcc-gpio = <0>;
		hw,lcdkit-vci-gpio = <0>;
		hw,lcdkit-bl-gpio = <0>;
		hw,lcdkit-iovcc-on-is-need-reset = <0>;
		hw,lcdkit-vsn-on-is-need-reset = <0>;
		hw,lcdkit-lcd-vsp = <5500000>;
		hw,lcdkit-lcd-vsn = <5500000>;
		hw,lcdkit-lcd-rst-first-high = <5>;
		hw,lcdkit-lcd-rst-low = <5>;
		hw,lcdkit-lcd-rst-second-high = <15>;
		hw,lcdkit-delay-af-vci-on = <0>;
		hw,lcdkit-delay-af-iovcc-on = <0>;
		hw,lcdkit-delay-af-bias-on = <0>;
		hw,lcdkit-delay-af-vsp-on = <2>;
		hw,lcdkit-delay-af-vsn-on = <12>;
		hw,lcdkit-delay-af-lp11 = <0>;
		hw,lcdkit-delay-af-tp-reset = <25>;
		hw,lcdkit-delay-af-vsn-off = <2>;
		hw,lcdkit-delay-af-vsp-off = <2>;
		hw,lcdkit-delay-af-bias-off = <0>;
		hw,lcdkit-delay-af-iovcc-off = <0>;
		hw,lcdkit-delay-af-vci-off = <0>;
		hw,lcdkit-panel-off-reset-high = <0>;
    };
};