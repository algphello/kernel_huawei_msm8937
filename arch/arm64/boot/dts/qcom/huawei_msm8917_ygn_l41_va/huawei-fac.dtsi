/{
		huawei_fac_info {
		compatible = "huawei,hw_fac_info";
		fac,product_name = "YGN-L41";
		fac,hardware_ver = "HL1YNGM";
		fac,software_ver = "YGN_L41_VA";
		fac,simcard_adapt = "support";
		status = "ok";
	};
};
