&spi_7 {
	status = "ok";
	fingerprint@0 {
		compatible = "fpc,fingerprint";
		reg = <0>;
		interrupt-parent = <&tlmm>;
		spi-max-frequency = <5000000>;
		interrupts = <48 0x0>;
		fingerprint,irq_gpio = <&tlmm 48 0>;
		fingerprint,reset_gpio = <&tlmm 140 0>;

		fingerprint,navigation_adjust1 = <0>;
		fingerprint,navigation_adjust2 = <90>;
		vdd-supply = <&pm8953_l6>;
		fingerprint,vdd = "vdd";
		avdd-supply = <&pm8953_l10>;
		fingerprint,avdd = "avdd";

		status = "ok";
	};
};
