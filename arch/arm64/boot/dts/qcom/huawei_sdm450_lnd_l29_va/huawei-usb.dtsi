&qusb_phy{
	qcom,qusb-phy-init-seq = <0xF8 0x80
		0x83 0x84
		0x83 0x88
		0xC5 0x8C
		0x14 0x9C
		0x30 0x08
		0x79 0x0C
		0x21 0x10
		0x00 0x90
		0x9F 0x1C
		0x00 0x18>;
	qcom,qusb-phy-host-init-seq = <0xF8 0x80
		0x83 0x84
		0x83 0x88
		0xC5 0x8C
		0x14 0x9C
		0x30 0x08
		0x79 0x0C
		0x21 0x10
		0x03 0x90
		0x9F 0x1C
		0x00 0x18>;
};

