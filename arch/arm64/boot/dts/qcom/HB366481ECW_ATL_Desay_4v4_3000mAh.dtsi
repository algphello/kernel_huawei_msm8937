
qcom,HB366481ECW_LG_Desay_4v4_3000mAh {
	/* #3092449_Huawei_London_desay_3000mAh_averaged_MasterSlave_Sept14th2017*/
	qcom,max-voltage-uv = <4400000>;
	qcom,nom-batt-capacity-mah = <3000>;
	qcom,batt-id-kohm = <200>;
	qcom,battery-beta = <3380>;
	qcom,battery-type = "HB366481ECW_LG_Desay_4v4_3000mAh";
	qcom,fg-cc-cv-threshold-mv = <4380>;
	qcom,chg-rslow-comp-c1 = <2591331>;
	qcom,chg-rslow-comp-c2 = <2694883>;
	qcom,chg-rs-to-rslow = <1505387>;
	qcom,chg-rslow-comp-thr = <0x99>;
	qcom,checksum = <0x0262>;
	qcom,gui-version = "PMI8950GUI - 2.0.0.16";
	qcom,fg-profile-data = [
		 2D 83 05 61 
		 4B 73 59 6C 
		 53 83 75 5A 
		 C7 79 16 7F 
		 0A 82 D0 99 
		 B5 BC B6 C9 
		 7D 0E 07 88 
		 5C 7E 7D 82 
		 2A 7D 76 83 
		 30 77 32 8B 
		 A8 95 5E 82 
		 01 98 2B B5 
		 77 C0 58 17 
		 9F 0B AA 58 
		 14 70 B2 FD 
		 8A 4C F6 3D 
		 23 49 00 00 
		 A9 45 52 28 
		 AE 35 00 00 
		 00 00 00 00 
		 00 00 00 00 
		 60 72 48 71 
		 36 68 ED 80 
		 E2 6F D3 58 
		 1A 64 39 72 
		 FA 6D 60 3E 
		 B0 6C 0C C3 
		 0C 10 61 2E 
		 5F A0 71 0C 
		 28 00 FF 36 
		 F0 11 30 03 
		 00 00 00 0C 
	];
};
