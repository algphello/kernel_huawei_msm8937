/*remove type-c support*/
&i2c_2 {
	/delete-node/ pericom-type-c@1d;
};

&usb_otg{
	qcom,hsusb-otg-mode = <3>;	/* enable otg mode */
	qcom,floated-charger-enable = <1>;
	qcom,hsusb-otg-phy-init-seq-host = <0x73 0x80 0x76 0x81 0x23 0x82 0x30 0x83 0xffffffff>;
	qcom,hsusb-otg-phy-init-seq = <0x33 0x80 0x76 0x81 0x23 0x82 0x30 0x83 0xffffffff>;
};

&android_usb {
	/*8937 does not support ipa ports*/
	qcom,no-support-ipa;
};

