## drivers/dev_detect/Kconfig
```kconfig
#
# device detect devices
#

menuconfig HUAWEI_DEV_DETECT
    bool "Huawei device detect support"
    default y
    help
      Say yes if you want device detect driver.
      This is for device connected version. If unsure, say N here.
```

## drivers/huawei_platform/Kconfig
```kconfig
config HUAWEI_DRIVERS
	bool "huawei drivers"
	default y
	help
	  Say Y here if you want to build the huawei drivers.
	  If unsure, say N here.
config HUAWEI_TOUCH_SCREEN
	bool "huawei touch screen driver"
	default y
	help
	  Say Y here if you have any touch device connected to your system and want
	  it to be available to applications. 
	  Say N here if you have no touch device in your system.If unsure, say Y.
	  To compile this driver as a module, choose M here: the  module will be called input.

#source "drivers/huawei_platform/log/Kconfig"
source "drivers/huawei_platform/touchscreen/Kconfig"
```

## drivers/hw_fac_info/Kconfig
```kconfig
config HUAWEI_FACTORY_INFO
	default n
	bool "HUAWEI Factory INFO"
	help
		Say yes if you want enable factory info driver.
		This is for distinguish the different product . If unsure, say Y here.
```

## drivers/hw_kharden_test/Kconfig
```kconfig
config HW_KHARDEN_DEBUG
	bool "Kernel harden test support"
	default n
	help
	  Say yes here to support the kernel harden debug
```

## drivers/net/wireless/drv_net_decoupled/Kconfig
```kconfig
config HUAWEI_QCOM_DECOUPLED
bool "huawei qcom kernel driver net decoupled"
default n
help
 choose y to open huawei qcom kernel driver net decoupled

if HUAWEI_QCOM_DECOUPLED
source "drivers/net/wireless/drv_net_decoupled/wireless/Kconfig"
endif
```

## drivers/net/wireless/drv_net_decoupled/wireless/Kconfig
```kconfig
config HUAWEI_QCOM_UNDECOUPLED
bool "huawei qcom decoupled"
default n
help
 choose y to open huawei qcom decoupled

if HUAWEI_QCOM_UNDECOUPLED
source "drivers/net/wireless/drv_net_decoupled/wireless/wcnss/Kconfig"
endif
```

## drivers/net/wireless/wcnss/wcnss_auto_nvbin/Kconfig
```kconfig
config CONFIG_HUAWEI_WIFI
	bool "Huawei auto load nv bin decoupled function support"
    default n
```

## drivers/soc/qcom/pil-q6v5-mss/Kconfig
```kconfig
#
# Huawei modem interface
#
config PIL_Q6V5_MSS
        bool "Huawei modem interface"
		depends on HUAWEI_KERNEL
        help
          Say y here to enable Huawei modem interface support. 

config PIL_Q6V5_MSS_LOG
        bool "Huawei modem crash log interface"
		depends on PIL_Q6V5_MSS
        help
          Say y here to enable Huawei modem crash log interface support. 
		  
config PIL_Q6V5_MSS_CTL
        tristate "Huawei modem ctl interface"
		depends on PIL_Q6V5_MSS
        help
          Say y here to enable Huawei modem ctl interface support. 
```

## net/ipv4/tmss/Kconfig
```kconfig
config HUAWEI_MSS_AUTO_CHANGE
	bool "Huawei MSS auto change undecoupled function support"
    default n
```

## sound/soc/codecs/tfa98xx/Kconfig
```kconfig
# NXP Smart Audio tfa98xx kernel driver
# Needed I2C and I2S bus support.

config SND_SOC_TFA98XX
	tristate "Build NXP TFA98XX ASoC CODEC drivers"
	depends on I2C
	help
	NXP Smart Audio tfa98xx kernel driver
```
